VERSION ""

NS_ :

BS_:

BU_: Vector__XXX

BO_ 2653655040 GPO_7: 8 Vector__XXX
SG_ GPO_7 : 7|32@0- (1,0) [0.00|1.00] "" Vector__XXX
SG_ Status : 63|8@0+ (1,0) [0|255] "" Vector__XXX

BO_ 2653671424 GPO_8: 8 Vector__XXX
SG_ GPO_8 : 7|32@0- (1,0) [0.00|1.00] "" Vector__XXX
SG_ Status : 63|8@0+ (1,0) [0|255] "" Vector__XXX

BO_ 2653687808 N2O_Enabled: 8 Vector__XXX
SG_ N2O_Enabled : 7|32@0- (1,0) [0.00|1.00] "" Vector__XXX
SG_ Status : 63|8@0+ (1,0) [0|255] "" Vector__XXX

BO_ 2653704192 N2O_Input_1: 8 Vector__XXX
SG_ N2O_Input_1 : 7|32@0- (1,0) [0.00|1.00] "" Vector__XXX
SG_ Status : 63|8@0+ (1,0) [0|255] "" Vector__XXX

BO_ 2653720576 N2O_Input_2: 8 Vector__XXX
SG_ N2O_Input_2 : 7|32@0- (1,0) [0.00|1.00] "" Vector__XXX
SG_ Status : 63|8@0+ (1,0) [0|255] "" Vector__XXX

BO_ 2653736960 N2O_Input_3: 8 Vector__XXX
SG_ N2O_Input_3 : 7|32@0- (1,0) [0.00|1.00] "" Vector__XXX
SG_ Status : 63|8@0+ (1,0) [0|255] "" Vector__XXX

BO_ 2653753344 N2O_Input_4: 8 Vector__XXX
SG_ N2O_Input_4 : 7|32@0- (1,0) [0.00|1.00] "" Vector__XXX
SG_ Status : 63|8@0+ (1,0) [0|255] "" Vector__XXX

BO_ 2653769728 N2O_Input_5: 8 Vector__XXX
SG_ N2O_Input_5 : 7|32@0- (1,0) [0.00|1.00] "" Vector__XXX
SG_ Status : 63|8@0+ (1,0) [0|255] "" Vector__XXX

BO_ 2653786112 N2O_Input_6: 8 Vector__XXX
SG_ N2O_Input_6 : 7|32@0- (1,0) [0.00|1.00] "" Vector__XXX
SG_ Status : 63|8@0+ (1,0) [0|255] "" Vector__XXX

BO_ 2653802496 N2O_Input_7: 8 Vector__XXX
SG_ N2O_Input_7 : 7|32@0- (1,0) [0.00|1.00] "" Vector__XXX
SG_ Status : 63|8@0+ (1,0) [0|255] "" Vector__XXX

BO_ 2653818880 N2O_Input_8: 8 Vector__XXX
SG_ N2O_Input_8 : 7|32@0- (1,0) [0.00|1.00] "" Vector__XXX
SG_ Status : 63|8@0+ (1,0) [0|255] "" Vector__XXX

BO_ 2653835264 N2O_Purge: 8 Vector__XXX
SG_ N2O_Purge : 7|32@0- (1,0) [0.00|1.00] "" Vector__XXX
SG_ Status : 63|8@0+ (1,0) [0|255] "" Vector__XXX

BO_ 2653851648 N2O_Lean_Cutoff: 8 Vector__XXX
SG_ N2O_Lean_Cutoff : 7|32@0- (1,0) [0.00|1.00] "" Vector__XXX
SG_ Status : 63|8@0+ (1,0) [0|255] "" Vector__XXX

BO_ 2653868032 N2O_Rich_Cutoff: 8 Vector__XXX
SG_ N2O_Rich_Cutoff : 7|32@0- (1,0) [0.00|1.00] "" Vector__XXX
SG_ Status : 63|8@0+ (1,0) [0|255] "" Vector__XXX

BO_ 2653884416 N2O_RPM_Cutoff: 8 Vector__XXX
SG_ N2O_RPM_Cutoff : 7|32@0- (1,0) [0.00|1.00] "" Vector__XXX
SG_ Status : 63|8@0+ (1,0) [0|255] "" Vector__XXX

BO_ 2653900800 N2O_MAP_Cutoff: 8 Vector__XXX
SG_ N2O_MAP_Cutoff : 7|32@0- (1,0) [0.00|1.00] "" Vector__XXX
SG_ Status : 63|8@0+ (1,0) [0|255] "" Vector__XXX

BO_ 2653917184 N2O_Purge_Output: 8 Vector__XXX
SG_ N2O_Purge_Output : 7|32@0- (1,0) [0.00|1.00] "" Vector__XXX
SG_ Status : 63|8@0+ (1,0) [0|255] "" Vector__XXX

BO_ 2653933568 N2O_Dry_Fuel_1: 8 Vector__XXX
SG_ N2O_Dry_Fuel_1 : 7|32@0- (1,0) [0.00|600.00] "lb/h" Vector__XXX
SG_ Status : 63|8@0+ (1,0) [0|255] "" Vector__XXX

BO_ 2653949952 N2O_Dry_Fuel_2: 8 Vector__XXX
SG_ N2O_Dry_Fuel_2 : 7|32@0- (1,0) [0.00|600.00] "lb/h" Vector__XXX
SG_ Status : 63|8@0+ (1,0) [0|255] "" Vector__XXX

BO_ 2653966336 N2O_Dry_Fuel_3: 8 Vector__XXX
SG_ N2O_Dry_Fuel_3 : 7|32@0- (1,0) [0.00|600.00] "lb/h" Vector__XXX
SG_ Status : 63|8@0+ (1,0) [0|255] "" Vector__XXX

BO_ 2653982720 N2O_Dry_Fuel_4: 8 Vector__XXX
SG_ N2O_Dry_Fuel_4 : 7|32@0- (1,0) [0.00|600.00] "lb/h" Vector__XXX
SG_ Status : 63|8@0+ (1,0) [0|255] "" Vector__XXX

BO_ 2653999104 N2O_Dry_Fuel_5: 8 Vector__XXX
SG_ N2O_Dry_Fuel_5 : 7|32@0- (1,0) [0.00|600.00] "lb/h" Vector__XXX
SG_ Status : 63|8@0+ (1,0) [0|255] "" Vector__XXX

BO_ 2654015488 N2O_Dry_Fuel_6: 8 Vector__XXX
SG_ N2O_Dry_Fuel_6 : 7|32@0- (1,0) [0.00|600.00] "lb/h" Vector__XXX
SG_ Status : 63|8@0+ (1,0) [0|255] "" Vector__XXX

BO_ 2654031872 N2O_Dry_Fuel_7: 8 Vector__XXX
SG_ N2O_Dry_Fuel_7 : 7|32@0- (1,0) [0.00|600.00] "lb/h" Vector__XXX
SG_ Status : 63|8@0+ (1,0) [0|255] "" Vector__XXX

BO_ 2654048256 N2O_Dry_Fuel_8: 8 Vector__XXX
SG_ N2O_Dry_Fuel_8 : 7|32@0- (1,0) [0.00|600.00] "lb/h" Vector__XXX
SG_ Status : 63|8@0+ (1,0) [0|255] "" Vector__XXX

BO_ 2654064640 N2O_Tmg_Mod_1: 8 Vector__XXX
SG_ N2O_Tmg_Mod_1 : 7|32@0- (1,0) [-10.00|60.00] "°" Vector__XXX
SG_ Status : 63|8@0+ (1,0) [0|255] "" Vector__XXX

BO_ 2654081024 N2O_Tmg_Mod_2: 8 Vector__XXX
SG_ N2O_Tmg_Mod_2 : 7|32@0- (1,0) [-10.00|60.00] "°" Vector__XXX
SG_ Status : 63|8@0+ (1,0) [0|255] "" Vector__XXX

BO_ 2654097408 N2O_Tmg_Mod_3: 8 Vector__XXX
SG_ N2O_Tmg_Mod_3 : 7|32@0- (1,0) [-10.00|60.00] "°" Vector__XXX
SG_ Status : 63|8@0+ (1,0) [0|255] "" Vector__XXX

BO_ 2654113792 N2O_Tmg_Mod_4: 8 Vector__XXX
SG_ N2O_Tmg_Mod_4 : 7|32@0- (1,0) [-10.00|60.00] "°" Vector__XXX
SG_ Status : 63|8@0+ (1,0) [0|255] "" Vector__XXX

BO_ 2654130176 N2O_Tmg_Mod_5: 8 Vector__XXX
SG_ N2O_Tmg_Mod_5 : 7|32@0- (1,0) [-10.00|60.00] "°" Vector__XXX
SG_ Status : 63|8@0+ (1,0) [0|255] "" Vector__XXX

BO_ 2654146560 N2O_Tmg_Mod_6: 8 Vector__XXX
SG_ N2O_Tmg_Mod_6 : 7|32@0- (1,0) [-10.00|60.00] "°" Vector__XXX
SG_ Status : 63|8@0+ (1,0) [0|255] "" Vector__XXX

BO_ 2654162944 N2O_Tmg_Mod_7: 8 Vector__XXX
SG_ N2O_Tmg_Mod_7 : 7|32@0- (1,0) [-10.00|60.00] "°" Vector__XXX
SG_ Status : 63|8@0+ (1,0) [0|255] "" Vector__XXX

BO_ 2654179328 N2O_Tmg_Mod_8: 8 Vector__XXX
SG_ N2O_Tmg_Mod_8 : 7|32@0- (1,0) [-10.00|60.00] "°" Vector__XXX
SG_ Status : 63|8@0+ (1,0) [0|255] "" Vector__XXX

BO_ 2654195712 N2O_Timer_1: 8 Vector__XXX
SG_ N2O_Timer_1 : 7|32@0- (1,0) [0.00|999.00] "s" Vector__XXX
SG_ Status : 63|8@0+ (1,0) [0|255] "" Vector__XXX

BO_ 2654212096 N2O_Timer_2: 8 Vector__XXX
SG_ N2O_Timer_2 : 7|32@0- (1,0) [0.00|999.00] "s" Vector__XXX
SG_ Status : 63|8@0+ (1,0) [0|255] "" Vector__XXX

BO_ 2654228480 N2O_Timer_3: 8 Vector__XXX
SG_ N2O_Timer_3 : 7|32@0- (1,0) [0.00|999.00] "s" Vector__XXX
SG_ Status : 63|8@0+ (1,0) [0|255] "" Vector__XXX

BO_ 2654244864 N2O_Timer_4: 8 Vector__XXX
SG_ N2O_Timer_4 : 7|32@0- (1,0) [0.00|999.00] "s" Vector__XXX
SG_ Status : 63|8@0+ (1,0) [0|255] "" Vector__XXX

BO_ 2654261248 N2O_Timer_5: 8 Vector__XXX
SG_ N2O_Timer_5 : 7|32@0- (1,0) [0.00|999.00] "s" Vector__XXX
SG_ Status : 63|8@0+ (1,0) [0|255] "" Vector__XXX

BO_ 2654277632 N2O_Timer_6: 8 Vector__XXX
SG_ N2O_Timer_6 : 7|32@0- (1,0) [0.00|999.00] "s" Vector__XXX
SG_ Status : 63|8@0+ (1,0) [0|255] "" Vector__XXX

BO_ 2654294016 N2O_Timer_7: 8 Vector__XXX
SG_ N2O_Timer_7 : 7|32@0- (1,0) [0.00|999.00] "s" Vector__XXX
SG_ Status : 63|8@0+ (1,0) [0|255] "" Vector__XXX

BO_ 2654310400 N2O_Timer_8: 8 Vector__XXX
SG_ N2O_Timer_8 : 7|32@0- (1,0) [0.00|999.00] "s" Vector__XXX
SG_ Status : 63|8@0+ (1,0) [0|255] "" Vector__XXX

BO_ 2654392320 Gear: 8 Vector__XXX
SG_ Gear : 7|32@0- (1,0) [0.00|8.00] "None" Vector__XXX
SG_ Status : 63|8@0+ (1,0) [0|255] "" Vector__XXX

BO_ 2654408704 Speed: 8 Vector__XXX
SG_ Speed : 7|32@0- (1,0) [0.00|300.00] "mph" Vector__XXX
SG_ Status : 63|8@0+ (1,0) [0|255] "" Vector__XXX

BO_ 2654425088 Line_Pressure: 8 Vector__XXX
SG_ Line_Pressure : 7|32@0- (1,0) [0.00|100.00] "%" Vector__XXX
SG_ Status : 63|8@0+ (1,0) [0|255] "" Vector__XXX

BO_ 2654441472 Input_Shaft_Speed: 8 Vector__XXX
SG_ Input_Shaft_Speed : 7|32@0- (1,0) [0.00|20000.00] "RPM" Vector__XXX
SG_ Status : 63|8@0+ (1,0) [0|255] "" Vector__XXX

BO_ 2654457856 Accum_Pressure: 8 Vector__XXX
SG_ Accum_Pressure : 7|32@0- (1,0) [0.00|250.00] "PSIa" Vector__XXX
SG_ Status : 63|8@0+ (1,0) [0|255] "" Vector__XXX

BO_ 2654474240 TCC_Duty_Cycle: 8 Vector__XXX
SG_ TCC_Duty_Cycle : 7|32@0- (1,0) [0.00|100.00] "%" Vector__XXX
SG_ Status : 63|8@0+ (1,0) [0|255] "" Vector__XXX

BO_ 2654490624 Line_Temp: 8 Vector__XXX
SG_ Line_Temp : 7|32@0- (1,0) [-50.00|500.00] "°F" Vector__XXX
SG_ Status : 63|8@0+ (1,0) [0|255] "" Vector__XXX

BO_ 2654507008 Torque_Time: 8 Vector__XXX
SG_ Torque_Time : 7|32@0- (1,0) [0.00|999.00] "s" Vector__XXX
SG_ Status : 63|8@0+ (1,0) [0|255] "" Vector__XXX

BO_ 2654523392 Trans_Man_US_Input: 8 Vector__XXX
SG_ Trans_Man_US_Input : 7|32@0- (1,0) [0.00|1.00] "" Vector__XXX
SG_ Status : 63|8@0+ (1,0) [0|255] "" Vector__XXX

BO_ 2654539776 Trans_Man_DS_Input: 8 Vector__XXX
SG_ Trans_Man_DS_Input : 7|32@0- (1,0) [0.00|1.00] "" Vector__XXX
SG_ Status : 63|8@0+ (1,0) [0|255] "" Vector__XXX

BO_ 2654556160 Trans_AutoMan_In: 8 Vector__XXX
SG_ Trans_AutoMan_In : 7|32@0- (1,0) [0.00|1.00] "" Vector__XXX
SG_ Status : 63|8@0+ (1,0) [0|255] "" Vector__XXX

BO_ 2654572544 Trans_Switch_Position: 8 Vector__XXX
SG_ Trans_Switch_Position : 7|32@0- (1,0) [-2.00|4.00] "None" Vector__XXX
SG_ Status : 63|8@0+ (1,0) [0|255] "" Vector__XXX

BO_ 2654605312 TB_TPS_1: 8 Vector__XXX
SG_ TB_TPS_1 : 7|32@0- (1,0) [0.00|5.00] "V" Vector__XXX
SG_ Status : 63|8@0+ (1,0) [0|255] "" Vector__XXX

BO_ 2654621696 TB_TPS_2: 8 Vector__XXX
SG_ TB_TPS_2 : 7|32@0- (1,0) [0.00|5.00] "V" Vector__XXX
SG_ Status : 63|8@0+ (1,0) [0|255] "" Vector__XXX

BO_ 2654638080 Pedal_TPS_1: 8 Vector__XXX
SG_ Pedal_TPS_1 : 7|32@0- (1,0) [0.00|5.00] "V" Vector__XXX
SG_ Status : 63|8@0+ (1,0) [0|255] "" Vector__XXX

BO_ 2654654464 Pedal_TPS_2: 8 Vector__XXX
SG_ Pedal_TPS_2 : 7|32@0- (1,0) [0.00|5.00] "V" Vector__XXX
SG_ Status : 63|8@0+ (1,0) [0|255] "" Vector__XXX

BO_ 2654670848 TB2_TPS_1: 8 Vector__XXX
SG_ TB2_TPS_1 : 7|32@0- (1,0) [0.00|5.00] "V" Vector__XXX
SG_ Status : 63|8@0+ (1,0) [0|255] "" Vector__XXX

BO_ 2654687232 TB2_TPS_2: 8 Vector__XXX
SG_ TB2_TPS_2 : 7|32@0- (1,0) [0.00|5.00] "V" Vector__XXX
SG_ Status : 63|8@0+ (1,0) [0|255] "" Vector__XXX

BO_ 2654703616 TB_Position: 8 Vector__XXX
SG_ TB_Position : 7|32@0- (1,0) [0.00|100.00] "%" Vector__XXX
SG_ Status : 63|8@0+ (1,0) [0|255] "" Vector__XXX

BO_ 2654720000 TB2_Position: 8 Vector__XXX
SG_ TB2_Position : 7|32@0- (1,0) [0.00|100.00] "%" Vector__XXX
SG_ Status : 63|8@0+ (1,0) [0|255] "" Vector__XXX

BO_ 2654736384 Brake_Pedal: 8 Vector__XXX
SG_ Brake_Pedal : 7|32@0- (1,0) [0.00|1.00] "" Vector__XXX
SG_ Status : 63|8@0+ (1,0) [0|255] "" Vector__XXX

BO_ 2654769152 Diag_1: 8 Vector__XXX
SG_ Diag_1 : 7|32@0- (1,0) [-10000.00|10000.00] "None" Vector__XXX
SG_ Status : 63|8@0+ (1,0) [0|255] "" Vector__XXX

BO_ 2654785536 Diag_2: 8 Vector__XXX
SG_ Diag_2 : 7|32@0- (1,0) [-10000.00|10000.00] "None" Vector__XXX
SG_ Status : 63|8@0+ (1,0) [0|255] "" Vector__XXX

BO_ 2654801920 Diag_3: 8 Vector__XXX
SG_ Diag_3 : 7|32@0- (1,0) [-10000.00|10000.00] "None" Vector__XXX
SG_ Status : 63|8@0+ (1,0) [0|255] "" Vector__XXX

BO_ 2654818304 Diag_4: 8 Vector__XXX
SG_ Diag_4 : 7|32@0- (1,0) [-10000.00|10000.00] "None" Vector__XXX
SG_ Status : 63|8@0+ (1,0) [0|255] "" Vector__XXX

BO_ 2654834688 Diag_5: 8 Vector__XXX
SG_ Diag_5 : 7|32@0- (1,0) [-10000.00|10000.00] "None" Vector__XXX
SG_ Status : 63|8@0+ (1,0) [0|255] "" Vector__XXX

BO_ 2654851072 Diag_6: 8 Vector__XXX
SG_ Diag_6 : 7|32@0- (1,0) [-10000.00|10000.00] "None" Vector__XXX
SG_ Status : 63|8@0+ (1,0) [0|255] "" Vector__XXX

BO_ 2654867456 Diag_7: 8 Vector__XXX
SG_ Diag_7 : 7|32@0- (1,0) [-10000.00|10000.00] "None" Vector__XXX
SG_ Status : 63|8@0+ (1,0) [0|255] "" Vector__XXX

BO_ 2654883840 Diag_8: 8 Vector__XXX
SG_ Diag_8 : 7|32@0- (1,0) [-10000.00|10000.00] "None" Vector__XXX
SG_ Status : 63|8@0+ (1,0) [0|255] "" Vector__XXX

BO_ 2654900224 Diag_9: 8 Vector__XXX
SG_ Diag_9 : 7|32@0- (1,0) [-10000.00|10000.00] "None" Vector__XXX
SG_ Status : 63|8@0+ (1,0) [0|255] "" Vector__XXX

BO_ 2654916608 Diag_10: 8 Vector__XXX
SG_ Diag_10 : 7|32@0- (1,0) [-10000.00|10000.00] "None" Vector__XXX
SG_ Status : 63|8@0+ (1,0) [0|255] "" Vector__XXX

BO_ 2654932992 Diag_11: 8 Vector__XXX
SG_ Diag_11 : 7|32@0- (1,0) [-10000.00|10000.00] "None" Vector__XXX
SG_ Status : 63|8@0+ (1,0) [0|255] "" Vector__XXX

BO_ 2654949376 Diag_12: 8 Vector__XXX
SG_ Diag_12 : 7|32@0- (1,0) [-10000.00|10000.00] "None" Vector__XXX
SG_ Status : 63|8@0+ (1,0) [0|255] "" Vector__XXX

BO_ 2654965760 Diag_13: 8 Vector__XXX
SG_ Diag_13 : 7|32@0- (1,0) [-10000.00|10000.00] "None" Vector__XXX
SG_ Status : 63|8@0+ (1,0) [0|255] "" Vector__XXX

BO_ 2654982144 Diag_14: 8 Vector__XXX
SG_ Diag_14 : 7|32@0- (1,0) [-10000.00|10000.00] "None" Vector__XXX
SG_ Status : 63|8@0+ (1,0) [0|255] "" Vector__XXX

BO_ 2654998528 Diag_15: 8 Vector__XXX
SG_ Diag_15 : 7|32@0- (1,0) [-10000.00|10000.00] "None" Vector__XXX
SG_ Status : 63|8@0+ (1,0) [0|255] "" Vector__XXX

BO_ 2655014912 Diag_16: 8 Vector__XXX
SG_ Diag_16 : 7|32@0- (1,0) [-10000.00|10000.00] "None" Vector__XXX
SG_ Status : 63|8@0+ (1,0) [0|255] "" Vector__XXX

BO_ 2655031296 Diag_17: 8 Vector__XXX
SG_ Diag_17 : 7|32@0- (1,0) [-10000.00|10000.00] "None" Vector__XXX
SG_ Status : 63|8@0+ (1,0) [0|255] "" Vector__XXX

BO_ 2655047680 Diag_18: 8 Vector__XXX
SG_ Diag_18 : 7|32@0- (1,0) [-10000.00|10000.00] "None" Vector__XXX
SG_ Status : 63|8@0+ (1,0) [0|255] "" Vector__XXX

BO_ 2655064064 Diag_19: 8 Vector__XXX
SG_ Diag_19 : 7|32@0- (1,0) [-10000.00|10000.00] "None" Vector__XXX
SG_ Status : 63|8@0+ (1,0) [0|255] "" Vector__XXX

BO_ 2655080448 Diag_20: 8 Vector__XXX
SG_ Diag_20 : 7|32@0- (1,0) [-10000.00|10000.00] "None" Vector__XXX
SG_ Status : 63|8@0+ (1,0) [0|255] "" Vector__XXX

BO_ 2655096832 AT_Launch_Input: 8 Vector__XXX
SG_ AT_Launch_Input : 7|32@0- (1,0) [0.00|1.00] "" Vector__XXX
SG_ Status : 63|8@0+ (1,0) [0|255] "" Vector__XXX

BO_ 2655113216 AT_Shift_Input: 8 Vector__XXX
SG_ AT_Shift_Input : 7|32@0- (1,0) [0.00|1.00] "" Vector__XXX
SG_ Status : 63|8@0+ (1,0) [0|255] "" Vector__XXX

BO_ 2655129600 AT_Manual_Reset: 8 Vector__XXX
SG_ AT_Manual_Reset : 7|32@0- (1,0) [0.00|1.00] "" Vector__XXX
SG_ Status : 63|8@0+ (1,0) [0|255] "" Vector__XXX

BO_ 2655145984 AT_Gear: 8 Vector__XXX
SG_ AT_Gear : 7|32@0- (1,0) [0.00|8.00] "None" Vector__XXX
SG_ Status : 63|8@0+ (1,0) [0|255] "" Vector__XXX

BO_ 2655162368 AT_1D_1: 8 Vector__XXX
SG_ AT_1D_1 : 7|32@0- (1,0) [0.00|100.00] "None" Vector__XXX
SG_ Status : 63|8@0+ (1,0) [0|255] "" Vector__XXX

BO_ 2655178752 AT_1D_2: 8 Vector__XXX
SG_ AT_1D_2 : 7|32@0- (1,0) [0.00|100.00] "None" Vector__XXX
SG_ Status : 63|8@0+ (1,0) [0|255] "" Vector__XXX

BO_ 2655195136 AT_1D_3: 8 Vector__XXX
SG_ AT_1D_3 : 7|32@0- (1,0) [0.00|100.00] "None" Vector__XXX
SG_ Status : 63|8@0+ (1,0) [0|255] "" Vector__XXX

BO_ 2655211520 AT_1D_4: 8 Vector__XXX
SG_ AT_1D_4 : 7|32@0- (1,0) [0.00|100.00] "None" Vector__XXX
SG_ Status : 63|8@0+ (1,0) [0|255] "" Vector__XXX

BO_ 2655227904 AT_1D_5: 8 Vector__XXX
SG_ AT_1D_5 : 7|32@0- (1,0) [0.00|100.00] "None" Vector__XXX
SG_ Status : 63|8@0+ (1,0) [0|255] "" Vector__XXX

BO_ 2655244288 AT_1D_6: 8 Vector__XXX
SG_ AT_1D_6 : 7|32@0- (1,0) [0.00|100.00] "None" Vector__XXX
SG_ Status : 63|8@0+ (1,0) [0|255] "" Vector__XXX

BO_ 2655260672 AT_1D_7: 8 Vector__XXX
SG_ AT_1D_7 : 7|32@0- (1,0) [0.00|100.00] "None" Vector__XXX
SG_ Status : 63|8@0+ (1,0) [0|255] "" Vector__XXX

BO_ 2655277056 AT_1D_8: 8 Vector__XXX
SG_ AT_1D_8 : 7|32@0- (1,0) [0.00|100.00] "None" Vector__XXX
SG_ Status : 63|8@0+ (1,0) [0|255] "" Vector__XXX

BO_ 2655293440 AT_2D_1: 8 Vector__XXX
SG_ AT_2D_1 : 7|32@0- (1,0) [0.00|100.00] "None" Vector__XXX
SG_ Status : 63|8@0+ (1,0) [0|255] "" Vector__XXX

BO_ 2655309824 AT_2D_2: 8 Vector__XXX
SG_ AT_2D_2 : 7|32@0- (1,0) [0.00|100.00] "None" Vector__XXX
SG_ Status : 63|8@0+ (1,0) [0|255] "" Vector__XXX

BO_ 2655326208 AT_2D_3: 8 Vector__XXX
SG_ AT_2D_3 : 7|32@0- (1,0) [0.00|100.00] "None" Vector__XXX
SG_ Status : 63|8@0+ (1,0) [0|255] "" Vector__XXX

BO_ 2655342592 AT_2D_4: 8 Vector__XXX
SG_ AT_2D_4 : 7|32@0- (1,0) [0.00|100.00] "None" Vector__XXX
SG_ Status : 63|8@0+ (1,0) [0|255] "" Vector__XXX

BO_ 2655358976 AT_2D_5: 8 Vector__XXX
SG_ AT_2D_5 : 7|32@0- (1,0) [0.00|100.00] "None" Vector__XXX
SG_ Status : 63|8@0+ (1,0) [0|255] "" Vector__XXX

BO_ 2655375360 AT_2D_6: 8 Vector__XXX
SG_ AT_2D_6 : 7|32@0- (1,0) [0.00|100.00] "None" Vector__XXX
SG_ Status : 63|8@0+ (1,0) [0|255] "" Vector__XXX

BO_ 2655391744 AT_2D_7: 8 Vector__XXX
SG_ AT_2D_7 : 7|32@0- (1,0) [0.00|100.00] "None" Vector__XXX
SG_ Status : 63|8@0+ (1,0) [0|255] "" Vector__XXX

BO_ 2655408128 AT_2D_8: 8 Vector__XXX
SG_ AT_2D_8 : 7|32@0- (1,0) [0.00|100.00] "None" Vector__XXX
SG_ Status : 63|8@0+ (1,0) [0|255] "" Vector__XXX

BO_ 2655424512 AT_1D_Gear_1: 8 Vector__XXX
SG_ AT_1D_Gear_1 : 7|32@0- (1,0) [0.00|100.00] "None" Vector__XXX
SG_ Status : 63|8@0+ (1,0) [0|255] "" Vector__XXX

BO_ 2655440896 AT_1D_Gear_2: 8 Vector__XXX
SG_ AT_1D_Gear_2 : 7|32@0- (1,0) [0.00|100.00] "None" Vector__XXX
SG_ Status : 63|8@0+ (1,0) [0|255] "" Vector__XXX

BO_ 2655457280 AT_1D_Gear_3: 8 Vector__XXX
SG_ AT_1D_Gear_3 : 7|32@0- (1,0) [0.00|100.00] "None" Vector__XXX
SG_ Status : 63|8@0+ (1,0) [0|255] "" Vector__XXX

BO_ 2655473664 AT_1D_Gear_4: 8 Vector__XXX
SG_ AT_1D_Gear_4 : 7|32@0- (1,0) [0.00|100.00] "None" Vector__XXX
SG_ Status : 63|8@0+ (1,0) [0|255] "" Vector__XXX

BO_ 2655490048 AT_1D_Gear_5: 8 Vector__XXX
SG_ AT_1D_Gear_5 : 7|32@0- (1,0) [0.00|100.00] "None" Vector__XXX
SG_ Status : 63|8@0+ (1,0) [0|255] "" Vector__XXX

BO_ 2655506432 AT_1D_Gear_6: 8 Vector__XXX
SG_ AT_1D_Gear_6 : 7|32@0- (1,0) [0.00|100.00] "None" Vector__XXX
SG_ Status : 63|8@0+ (1,0) [0|255] "" Vector__XXX

BO_ 2655522816 AT_1D_Gear_7: 8 Vector__XXX
SG_ AT_1D_Gear_7 : 7|32@0- (1,0) [0.00|100.00] "None" Vector__XXX
SG_ Status : 63|8@0+ (1,0) [0|255] "" Vector__XXX

BO_ 2655539200 AT_1D_Gear_8: 8 Vector__XXX
SG_ AT_1D_Gear_8 : 7|32@0- (1,0) [0.00|100.00] "None" Vector__XXX
SG_ Status : 63|8@0+ (1,0) [0|255] "" Vector__XXX

BO_ 2655555584 AT_2D_Gear_1: 8 Vector__XXX
SG_ AT_2D_Gear_1 : 7|32@0- (1,0) [0.00|100.00] "None" Vector__XXX
SG_ Status : 63|8@0+ (1,0) [0|255] "" Vector__XXX

BO_ 2655571968 AT_2D_Gear_2: 8 Vector__XXX
SG_ AT_2D_Gear_2 : 7|32@0- (1,0) [0.00|100.00] "None" Vector__XXX
SG_ Status : 63|8@0+ (1,0) [0|255] "" Vector__XXX

BO_ 2655588352 AT_2D_Gear_3: 8 Vector__XXX
SG_ AT_2D_Gear_3 : 7|32@0- (1,0) [0.00|100.00] "None" Vector__XXX
SG_ Status : 63|8@0+ (1,0) [0|255] "" Vector__XXX

BO_ 2655604736 AT_2D_Gear_4: 8 Vector__XXX
SG_ AT_2D_Gear_4 : 7|32@0- (1,0) [0.00|100.00] "None" Vector__XXX
SG_ Status : 63|8@0+ (1,0) [0|255] "" Vector__XXX

BO_ 2655621120 AT_2D_Gear_5: 8 Vector__XXX
SG_ AT_2D_Gear_5 : 7|32@0- (1,0) [0.00|100.00] "None" Vector__XXX
SG_ Status : 63|8@0+ (1,0) [0|255] "" Vector__XXX

BO_ 2655637504 AT_2D_Gear_6: 8 Vector__XXX
SG_ AT_2D_Gear_6 : 7|32@0- (1,0) [0.00|100.00] "None" Vector__XXX
SG_ Status : 63|8@0+ (1,0) [0|255] "" Vector__XXX

BO_ 2655653888 AT_2D_Gear_7: 8 Vector__XXX
SG_ AT_2D_Gear_7 : 7|32@0- (1,0) [0.00|100.00] "None" Vector__XXX
SG_ Status : 63|8@0+ (1,0) [0|255] "" Vector__XXX

BO_ 2655670272 AT_2D_Gear_8: 8 Vector__XXX
SG_ AT_2D_Gear_8 : 7|32@0- (1,0) [0.00|100.00] "None" Vector__XXX
SG_ Status : 63|8@0+ (1,0) [0|255] "" Vector__XXX

BO_ 2655686656 Input_1: 8 Vector__XXX
SG_ Input_1 : 7|32@0- (1,0) [0.00|99999.00] "None" Vector__XXX
SG_ Status : 63|8@0+ (1,0) [0|255] "" Vector__XXX

BO_ 2655703040 Input_2: 8 Vector__XXX
SG_ Input_2 : 7|32@0- (1,0) [0.00|99999.00] "None" Vector__XXX
SG_ Status : 63|8@0+ (1,0) [0|255] "" Vector__XXX

BO_ 2655719424 Input_3: 8 Vector__XXX
SG_ Input_3 : 7|32@0- (1,0) [0.00|99999.00] "None" Vector__XXX
SG_ Status : 63|8@0+ (1,0) [0|255] "" Vector__XXX

BO_ 2655735808 Input_4: 8 Vector__XXX
SG_ Input_4 : 7|32@0- (1,0) [0.00|99999.00] "None" Vector__XXX
SG_ Status : 63|8@0+ (1,0) [0|255] "" Vector__XXX

BO_ 2655752192 Input_5: 8 Vector__XXX
SG_ Input_5 : 7|32@0- (1,0) [0.00|99999.00] "None" Vector__XXX
SG_ Status : 63|8@0+ (1,0) [0|255] "" Vector__XXX

BO_ 2655768576 Input_6: 8 Vector__XXX
SG_ Input_6 : 7|32@0- (1,0) [0.00|99999.00] "None" Vector__XXX
SG_ Status : 63|8@0+ (1,0) [0|255] "" Vector__XXX

BO_ 2655784960 Input_7: 8 Vector__XXX
SG_ Input_7 : 7|32@0- (1,0) [0.00|99999.00] "None" Vector__XXX
SG_ Status : 63|8@0+ (1,0) [0|255] "" Vector__XXX

BO_ 2655801344 Input_8: 8 Vector__XXX
SG_ Input_8 : 7|32@0- (1,0) [0.00|99999.00] "None" Vector__XXX
SG_ Status : 63|8@0+ (1,0) [0|255] "" Vector__XXX

BO_ 2655817728 Input_9: 8 Vector__XXX
SG_ Input_9 : 7|32@0- (1,0) [0.00|99999.00] "None" Vector__XXX
SG_ Status : 63|8@0+ (1,0) [0|255] "" Vector__XXX

BO_ 2655834112 Input_10: 8 Vector__XXX
SG_ Input_10 : 7|32@0- (1,0) [0.00|99999.00] "None" Vector__XXX
SG_ Status : 63|8@0+ (1,0) [0|255] "" Vector__XXX

BO_ 2655850496 Input_11: 8 Vector__XXX
SG_ Input_11 : 7|32@0- (1,0) [0.00|99999.00] "None" Vector__XXX
SG_ Status : 63|8@0+ (1,0) [0|255] "" Vector__XXX

BO_ 2655866880 Input_12: 8 Vector__XXX
SG_ Input_12 : 7|32@0- (1,0) [0.00|99999.00] "None" Vector__XXX
SG_ Status : 63|8@0+ (1,0) [0|255] "" Vector__XXX

BO_ 2655883264 Input_13: 8 Vector__XXX
SG_ Input_13 : 7|32@0- (1,0) [0.00|99999.00] "None" Vector__XXX
SG_ Status : 63|8@0+ (1,0) [0|255] "" Vector__XXX

BO_ 2655899648 Input_14: 8 Vector__XXX
SG_ Input_14 : 7|32@0- (1,0) [0.00|99999.00] "None" Vector__XXX
SG_ Status : 63|8@0+ (1,0) [0|255] "" Vector__XXX

BO_ 2655916032 Input_15: 8 Vector__XXX
SG_ Input_15 : 7|32@0- (1,0) [0.00|99999.00] "None" Vector__XXX
SG_ Status : 63|8@0+ (1,0) [0|255] "" Vector__XXX

BO_ 2655932416 Input_16: 8 Vector__XXX
SG_ Input_16 : 7|32@0- (1,0) [0.00|99999.00] "None" Vector__XXX
SG_ Status : 63|8@0+ (1,0) [0|255] "" Vector__XXX

BO_ 2655948800 Input_17: 8 Vector__XXX
SG_ Input_17 : 7|32@0- (1,0) [0.00|99999.00] "None" Vector__XXX
SG_ Status : 63|8@0+ (1,0) [0|255] "" Vector__XXX

BO_ 2655965184 Input_18: 8 Vector__XXX
SG_ Input_18 : 7|32@0- (1,0) [0.00|99999.00] "None" Vector__XXX
SG_ Status : 63|8@0+ (1,0) [0|255] "" Vector__XXX

BO_ 2655981568 Input_19: 8 Vector__XXX
SG_ Input_19 : 7|32@0- (1,0) [0.00|99999.00] "None" Vector__XXX
SG_ Status : 63|8@0+ (1,0) [0|255] "" Vector__XXX

BO_ 2655997952 Input_20: 8 Vector__XXX
SG_ Input_20 : 7|32@0- (1,0) [0.00|99999.00] "None" Vector__XXX
SG_ Status : 63|8@0+ (1,0) [0|255] "" Vector__XXX

BO_ 2656014336 Input_21: 8 Vector__XXX
SG_ Input_21 : 7|32@0- (1,0) [0.00|99999.00] "None" Vector__XXX
SG_ Status : 63|8@0+ (1,0) [0|255] "" Vector__XXX

BO_ 2656030720 Input_22: 8 Vector__XXX
SG_ Input_22 : 7|32@0- (1,0) [0.00|99999.00] "None" Vector__XXX
SG_ Status : 63|8@0+ (1,0) [0|255] "" Vector__XXX

BO_ 2656047104 Input_23: 8 Vector__XXX
SG_ Input_23 : 7|32@0- (1,0) [0.00|99999.00] "None" Vector__XXX
SG_ Status : 63|8@0+ (1,0) [0|255] "" Vector__XXX

BO_ 2656063488 Input_24: 8 Vector__XXX
SG_ Input_24 : 7|32@0- (1,0) [0.00|99999.00] "None" Vector__XXX
SG_ Status : 63|8@0+ (1,0) [0|255] "" Vector__XXX

BO_ 2656079872 Input_25: 8 Vector__XXX
SG_ Input_25 : 7|32@0- (1,0) [0.00|99999.00] "None" Vector__XXX
SG_ Status : 63|8@0+ (1,0) [0|255] "" Vector__XXX

BO_ 2656096256 Input_26: 8 Vector__XXX
SG_ Input_26 : 7|32@0- (1,0) [0.00|99999.00] "None" Vector__XXX
SG_ Status : 63|8@0+ (1,0) [0|255] "" Vector__XXX

BO_ 2656112640 Input_27: 8 Vector__XXX
SG_ Input_27 : 7|32@0- (1,0) [0.00|99999.00] "None" Vector__XXX
SG_ Status : 63|8@0+ (1,0) [0|255] "" Vector__XXX

BO_ 2656129024 Input_28: 8 Vector__XXX
SG_ Input_28 : 7|32@0- (1,0) [0.00|99999.00] "None" Vector__XXX
SG_ Status : 63|8@0+ (1,0) [0|255] "" Vector__XXX

BO_ 2656145408 Input_29: 8 Vector__XXX
SG_ Input_29 : 7|32@0- (1,0) [0.00|99999.00] "None" Vector__XXX
SG_ Status : 63|8@0+ (1,0) [0|255] "" Vector__XXX

BO_ 2656161792 Input_30: 8 Vector__XXX
SG_ Input_30 : 7|32@0- (1,0) [0.00|99999.00] "None" Vector__XXX
SG_ Status : 63|8@0+ (1,0) [0|255] "" Vector__XXX

BO_ 2656178176 Input_31: 8 Vector__XXX
SG_ Input_31 : 7|32@0- (1,0) [0.00|99999.00] "None" Vector__XXX
SG_ Status : 63|8@0+ (1,0) [0|255] "" Vector__XXX

BO_ 2656194560 Input_32: 8 Vector__XXX
SG_ Input_32 : 7|32@0- (1,0) [0.00|99999.00] "None" Vector__XXX
SG_ Status : 63|8@0+ (1,0) [0|255] "" Vector__XXX

BO_ 2656210944 Input_33: 8 Vector__XXX
SG_ Input_33 : 7|32@0- (1,0) [0.00|99999.00] "None" Vector__XXX
SG_ Status : 63|8@0+ (1,0) [0|255] "" Vector__XXX

BO_ 2656227328 Input_34: 8 Vector__XXX
SG_ Input_34 : 7|32@0- (1,0) [0.00|99999.00] "None" Vector__XXX
SG_ Status : 63|8@0+ (1,0) [0|255] "" Vector__XXX

BO_ 2656243712 Input_35: 8 Vector__XXX
SG_ Input_35 : 7|32@0- (1,0) [0.00|99999.00] "None" Vector__XXX
SG_ Status : 63|8@0+ (1,0) [0|255] "" Vector__XXX

BO_ 2656260096 Input_36: 8 Vector__XXX
SG_ Input_36 : 7|32@0- (1,0) [0.00|99999.00] "None" Vector__XXX
SG_ Status : 63|8@0+ (1,0) [0|255] "" Vector__XXX

BO_ 2656276480 Input_37: 8 Vector__XXX
SG_ Input_37 : 7|32@0- (1,0) [0.00|99999.00] "None" Vector__XXX
SG_ Status : 63|8@0+ (1,0) [0|255] "" Vector__XXX

BO_ 2656292864 Input_38: 8 Vector__XXX
SG_ Input_38 : 7|32@0- (1,0) [0.00|99999.00] "None" Vector__XXX
SG_ Status : 63|8@0+ (1,0) [0|255] "" Vector__XXX

BO_ 2656309248 Input_39: 8 Vector__XXX
SG_ Input_39 : 7|32@0- (1,0) [0.00|99999.00] "None" Vector__XXX
SG_ Status : 63|8@0+ (1,0) [0|255] "" Vector__XXX

BO_ 2656325632 Input_40: 8 Vector__XXX
SG_ Input_40 : 7|32@0- (1,0) [0.00|99999.00] "None" Vector__XXX
SG_ Status : 63|8@0+ (1,0) [0|255] "" Vector__XXX

BO_ 2656342016 Input_41: 8 Vector__XXX
SG_ Input_41 : 7|32@0- (1,0) [0.00|99999.00] "None" Vector__XXX
SG_ Status : 63|8@0+ (1,0) [0|255] "" Vector__XXX

BO_ 2656358400 Input_42: 8 Vector__XXX
SG_ Input_42 : 7|32@0- (1,0) [0.00|99999.00] "None" Vector__XXX
SG_ Status : 63|8@0+ (1,0) [0|255] "" Vector__XXX

BO_ 2656374784 Input_43: 8 Vector__XXX
SG_ Input_43 : 7|32@0- (1,0) [0.00|99999.00] "None" Vector__XXX
SG_ Status : 63|8@0+ (1,0) [0|255] "" Vector__XXX

BO_ 2656391168 Input_44: 8 Vector__XXX
SG_ Input_44 : 7|32@0- (1,0) [0.00|99999.00] "None" Vector__XXX
SG_ Status : 63|8@0+ (1,0) [0|255] "" Vector__XXX

BO_ 2656407552 Input_45: 8 Vector__XXX
SG_ Input_45 : 7|32@0- (1,0) [0.00|99999.00] "None" Vector__XXX
SG_ Status : 63|8@0+ (1,0) [0|255] "" Vector__XXX

BO_ 2656423936 Input_46: 8 Vector__XXX
SG_ Input_46 : 7|32@0- (1,0) [0.00|99999.00] "None" Vector__XXX
SG_ Status : 63|8@0+ (1,0) [0|255] "" Vector__XXX

BO_ 2656440320 Input_47: 8 Vector__XXX
SG_ Input_47 : 7|32@0- (1,0) [0.00|99999.00] "None" Vector__XXX
SG_ Status : 63|8@0+ (1,0) [0|255] "" Vector__XXX

BO_ 2656456704 Input_48: 8 Vector__XXX
SG_ Input_48 : 7|32@0- (1,0) [0.00|99999.00] "None" Vector__XXX
SG_ Status : 63|8@0+ (1,0) [0|255] "" Vector__XXX

BO_ 2656473088 Input_49: 8 Vector__XXX
SG_ Input_49 : 7|32@0- (1,0) [0.00|99999.00] "None" Vector__XXX
SG_ Status : 63|8@0+ (1,0) [0|255] "" Vector__XXX

BO_ 2656489472 Input_50: 8 Vector__XXX
SG_ Input_50 : 7|32@0- (1,0) [0.00|99999.00] "None" Vector__XXX
SG_ Status : 63|8@0+ (1,0) [0|255] "" Vector__XXX

VAL_ 2653655040 Status 0 "OK" 1 "Disabled" 2 "Initializing" 3 "Heating" 4 "WB_Active" 5 "Too Cold" 6 "Too Hot" 7 "Unplugged" 8 "Slow!" 9 "Uncal Yellow" 10 "Uncal Red" 11 "Replace" 12 "Disabled" 13 "Shorted" 14 "Open" 15 "Over Range" 16 "Under Range" 17 "Undefined" 18 "Error!" 19 "Low Error" 20 "High Error" 21 "Non Critical No LED" 27 "Critical Green LED" 32 "Stall!" 33 "Synchronized" 34 "Syncing" 35 "Error!" 36 "Error!" 37 "Uncalibrated" 38 "Open Loop" 39 "Closed Loop" 40 "Not Learn" 41 "Learning" 42 "Off" 43 "On" 44 "Not Rev Limiting" 45 "Rev Limit" 46 "No Cut Off" 47 "CutOff!" 48 "Off" 49 "Warning!" 50 "Caution!" 51 "No Timing modifier" 52 "Timing is being modified" 53 "Timing Value is being replaced" 54 "Acq Sat" 55 "No GPS" 56 "No Data" 22 "Non Critical Green LED" 23 "Non Critical Yellow LED" 24 "Non Critical Red LED" 25 "Non Critical Blue LED" 26 "Non Critical Grey LED" 28 "Critical Yellow LED" 29 "Critical Red LED" 30 "Critical Blue LED" 31 "Critical Grey LED";
VAL_ 2653671424 Status 0 "OK" 1 "Disabled" 2 "Initializing" 3 "Heating" 4 "WB_Active" 5 "Too Cold" 6 "Too Hot" 7 "Unplugged" 8 "Slow!" 9 "Uncal Yellow" 10 "Uncal Red" 11 "Replace" 12 "Disabled" 13 "Shorted" 14 "Open" 15 "Over Range" 16 "Under Range" 17 "Undefined" 18 "Error!" 19 "Low Error" 20 "High Error" 21 "Non Critical No LED" 27 "Critical Green LED" 32 "Stall!" 33 "Synchronized" 34 "Syncing" 35 "Error!" 36 "Error!" 37 "Uncalibrated" 38 "Open Loop" 39 "Closed Loop" 40 "Not Learn" 41 "Learning" 42 "Off" 43 "On" 44 "Not Rev Limiting" 45 "Rev Limit" 46 "No Cut Off" 47 "CutOff!" 48 "Off" 49 "Warning!" 50 "Caution!" 51 "No Timing modifier" 52 "Timing is being modified" 53 "Timing Value is being replaced" 54 "Acq Sat" 55 "No GPS" 56 "No Data" 22 "Non Critical Green LED" 23 "Non Critical Yellow LED" 24 "Non Critical Red LED" 25 "Non Critical Blue LED" 26 "Non Critical Grey LED" 28 "Critical Yellow LED" 29 "Critical Red LED" 30 "Critical Blue LED" 31 "Critical Grey LED";
VAL_ 2653687808 Status 0 "OK" 1 "Disabled" 2 "Initializing" 3 "Heating" 4 "WB_Active" 5 "Too Cold" 6 "Too Hot" 7 "Unplugged" 8 "Slow!" 9 "Uncal Yellow" 10 "Uncal Red" 11 "Replace" 12 "Disabled" 13 "Shorted" 14 "Open" 15 "Over Range" 16 "Under Range" 17 "Undefined" 18 "Error!" 19 "Low Error" 20 "High Error" 21 "Non Critical No LED" 27 "Critical Green LED" 32 "Stall!" 33 "Synchronized" 34 "Syncing" 35 "Error!" 36 "Error!" 37 "Uncalibrated" 38 "Open Loop" 39 "Closed Loop" 40 "Not Learn" 41 "Learning" 42 "Off" 43 "On" 44 "Not Rev Limiting" 45 "Rev Limit" 46 "No Cut Off" 47 "CutOff!" 48 "Off" 49 "Warning!" 50 "Caution!" 51 "No Timing modifier" 52 "Timing is being modified" 53 "Timing Value is being replaced" 54 "Acq Sat" 55 "No GPS" 56 "No Data" 22 "Non Critical Green LED" 23 "Non Critical Yellow LED" 24 "Non Critical Red LED" 25 "Non Critical Blue LED" 26 "Non Critical Grey LED" 28 "Critical Yellow LED" 29 "Critical Red LED" 30 "Critical Blue LED" 31 "Critical Grey LED";
VAL_ 2653704192 Status 0 "OK" 1 "Disabled" 2 "Initializing" 3 "Heating" 4 "WB_Active" 5 "Too Cold" 6 "Too Hot" 7 "Unplugged" 8 "Slow!" 9 "Uncal Yellow" 10 "Uncal Red" 11 "Replace" 12 "Disabled" 13 "Shorted" 14 "Open" 15 "Over Range" 16 "Under Range" 17 "Undefined" 18 "Error!" 19 "Low Error" 20 "High Error" 21 "Non Critical No LED" 27 "Critical Green LED" 32 "Stall!" 33 "Synchronized" 34 "Syncing" 35 "Error!" 36 "Error!" 37 "Uncalibrated" 38 "Open Loop" 39 "Closed Loop" 40 "Not Learn" 41 "Learning" 42 "Off" 43 "On" 44 "Not Rev Limiting" 45 "Rev Limit" 46 "No Cut Off" 47 "CutOff!" 48 "Off" 49 "Warning!" 50 "Caution!" 51 "No Timing modifier" 52 "Timing is being modified" 53 "Timing Value is being replaced" 54 "Acq Sat" 55 "No GPS" 56 "No Data" 22 "Non Critical Green LED" 23 "Non Critical Yellow LED" 24 "Non Critical Red LED" 25 "Non Critical Blue LED" 26 "Non Critical Grey LED" 28 "Critical Yellow LED" 29 "Critical Red LED" 30 "Critical Blue LED" 31 "Critical Grey LED";
VAL_ 2653720576 Status 0 "OK" 1 "Disabled" 2 "Initializing" 3 "Heating" 4 "WB_Active" 5 "Too Cold" 6 "Too Hot" 7 "Unplugged" 8 "Slow!" 9 "Uncal Yellow" 10 "Uncal Red" 11 "Replace" 12 "Disabled" 13 "Shorted" 14 "Open" 15 "Over Range" 16 "Under Range" 17 "Undefined" 18 "Error!" 19 "Low Error" 20 "High Error" 21 "Non Critical No LED" 27 "Critical Green LED" 32 "Stall!" 33 "Synchronized" 34 "Syncing" 35 "Error!" 36 "Error!" 37 "Uncalibrated" 38 "Open Loop" 39 "Closed Loop" 40 "Not Learn" 41 "Learning" 42 "Off" 43 "On" 44 "Not Rev Limiting" 45 "Rev Limit" 46 "No Cut Off" 47 "CutOff!" 48 "Off" 49 "Warning!" 50 "Caution!" 51 "No Timing modifier" 52 "Timing is being modified" 53 "Timing Value is being replaced" 54 "Acq Sat" 55 "No GPS" 56 "No Data" 22 "Non Critical Green LED" 23 "Non Critical Yellow LED" 24 "Non Critical Red LED" 25 "Non Critical Blue LED" 26 "Non Critical Grey LED" 28 "Critical Yellow LED" 29 "Critical Red LED" 30 "Critical Blue LED" 31 "Critical Grey LED";
VAL_ 2653736960 Status 0 "OK" 1 "Disabled" 2 "Initializing" 3 "Heating" 4 "WB_Active" 5 "Too Cold" 6 "Too Hot" 7 "Unplugged" 8 "Slow!" 9 "Uncal Yellow" 10 "Uncal Red" 11 "Replace" 12 "Disabled" 13 "Shorted" 14 "Open" 15 "Over Range" 16 "Under Range" 17 "Undefined" 18 "Error!" 19 "Low Error" 20 "High Error" 21 "Non Critical No LED" 27 "Critical Green LED" 32 "Stall!" 33 "Synchronized" 34 "Syncing" 35 "Error!" 36 "Error!" 37 "Uncalibrated" 38 "Open Loop" 39 "Closed Loop" 40 "Not Learn" 41 "Learning" 42 "Off" 43 "On" 44 "Not Rev Limiting" 45 "Rev Limit" 46 "No Cut Off" 47 "CutOff!" 48 "Off" 49 "Warning!" 50 "Caution!" 51 "No Timing modifier" 52 "Timing is being modified" 53 "Timing Value is being replaced" 54 "Acq Sat" 55 "No GPS" 56 "No Data" 22 "Non Critical Green LED" 23 "Non Critical Yellow LED" 24 "Non Critical Red LED" 25 "Non Critical Blue LED" 26 "Non Critical Grey LED" 28 "Critical Yellow LED" 29 "Critical Red LED" 30 "Critical Blue LED" 31 "Critical Grey LED";
VAL_ 2653753344 Status 0 "OK" 1 "Disabled" 2 "Initializing" 3 "Heating" 4 "WB_Active" 5 "Too Cold" 6 "Too Hot" 7 "Unplugged" 8 "Slow!" 9 "Uncal Yellow" 10 "Uncal Red" 11 "Replace" 12 "Disabled" 13 "Shorted" 14 "Open" 15 "Over Range" 16 "Under Range" 17 "Undefined" 18 "Error!" 19 "Low Error" 20 "High Error" 21 "Non Critical No LED" 27 "Critical Green LED" 32 "Stall!" 33 "Synchronized" 34 "Syncing" 35 "Error!" 36 "Error!" 37 "Uncalibrated" 38 "Open Loop" 39 "Closed Loop" 40 "Not Learn" 41 "Learning" 42 "Off" 43 "On" 44 "Not Rev Limiting" 45 "Rev Limit" 46 "No Cut Off" 47 "CutOff!" 48 "Off" 49 "Warning!" 50 "Caution!" 51 "No Timing modifier" 52 "Timing is being modified" 53 "Timing Value is being replaced" 54 "Acq Sat" 55 "No GPS" 56 "No Data" 22 "Non Critical Green LED" 23 "Non Critical Yellow LED" 24 "Non Critical Red LED" 25 "Non Critical Blue LED" 26 "Non Critical Grey LED" 28 "Critical Yellow LED" 29 "Critical Red LED" 30 "Critical Blue LED" 31 "Critical Grey LED";
VAL_ 2653769728 Status 0 "OK" 1 "Disabled" 2 "Initializing" 3 "Heating" 4 "WB_Active" 5 "Too Cold" 6 "Too Hot" 7 "Unplugged" 8 "Slow!" 9 "Uncal Yellow" 10 "Uncal Red" 11 "Replace" 12 "Disabled" 13 "Shorted" 14 "Open" 15 "Over Range" 16 "Under Range" 17 "Undefined" 18 "Error!" 19 "Low Error" 20 "High Error" 21 "Non Critical No LED" 27 "Critical Green LED" 32 "Stall!" 33 "Synchronized" 34 "Syncing" 35 "Error!" 36 "Error!" 37 "Uncalibrated" 38 "Open Loop" 39 "Closed Loop" 40 "Not Learn" 41 "Learning" 42 "Off" 43 "On" 44 "Not Rev Limiting" 45 "Rev Limit" 46 "No Cut Off" 47 "CutOff!" 48 "Off" 49 "Warning!" 50 "Caution!" 51 "No Timing modifier" 52 "Timing is being modified" 53 "Timing Value is being replaced" 54 "Acq Sat" 55 "No GPS" 56 "No Data" 22 "Non Critical Green LED" 23 "Non Critical Yellow LED" 24 "Non Critical Red LED" 25 "Non Critical Blue LED" 26 "Non Critical Grey LED" 28 "Critical Yellow LED" 29 "Critical Red LED" 30 "Critical Blue LED" 31 "Critical Grey LED";
VAL_ 2653786112 Status 0 "OK" 1 "Disabled" 2 "Initializing" 3 "Heating" 4 "WB_Active" 5 "Too Cold" 6 "Too Hot" 7 "Unplugged" 8 "Slow!" 9 "Uncal Yellow" 10 "Uncal Red" 11 "Replace" 12 "Disabled" 13 "Shorted" 14 "Open" 15 "Over Range" 16 "Under Range" 17 "Undefined" 18 "Error!" 19 "Low Error" 20 "High Error" 21 "Non Critical No LED" 27 "Critical Green LED" 32 "Stall!" 33 "Synchronized" 34 "Syncing" 35 "Error!" 36 "Error!" 37 "Uncalibrated" 38 "Open Loop" 39 "Closed Loop" 40 "Not Learn" 41 "Learning" 42 "Off" 43 "On" 44 "Not Rev Limiting" 45 "Rev Limit" 46 "No Cut Off" 47 "CutOff!" 48 "Off" 49 "Warning!" 50 "Caution!" 51 "No Timing modifier" 52 "Timing is being modified" 53 "Timing Value is being replaced" 54 "Acq Sat" 55 "No GPS" 56 "No Data" 22 "Non Critical Green LED" 23 "Non Critical Yellow LED" 24 "Non Critical Red LED" 25 "Non Critical Blue LED" 26 "Non Critical Grey LED" 28 "Critical Yellow LED" 29 "Critical Red LED" 30 "Critical Blue LED" 31 "Critical Grey LED";
VAL_ 2653802496 Status 0 "OK" 1 "Disabled" 2 "Initializing" 3 "Heating" 4 "WB_Active" 5 "Too Cold" 6 "Too Hot" 7 "Unplugged" 8 "Slow!" 9 "Uncal Yellow" 10 "Uncal Red" 11 "Replace" 12 "Disabled" 13 "Shorted" 14 "Open" 15 "Over Range" 16 "Under Range" 17 "Undefined" 18 "Error!" 19 "Low Error" 20 "High Error" 21 "Non Critical No LED" 27 "Critical Green LED" 32 "Stall!" 33 "Synchronized" 34 "Syncing" 35 "Error!" 36 "Error!" 37 "Uncalibrated" 38 "Open Loop" 39 "Closed Loop" 40 "Not Learn" 41 "Learning" 42 "Off" 43 "On" 44 "Not Rev Limiting" 45 "Rev Limit" 46 "No Cut Off" 47 "CutOff!" 48 "Off" 49 "Warning!" 50 "Caution!" 51 "No Timing modifier" 52 "Timing is being modified" 53 "Timing Value is being replaced" 54 "Acq Sat" 55 "No GPS" 56 "No Data" 22 "Non Critical Green LED" 23 "Non Critical Yellow LED" 24 "Non Critical Red LED" 25 "Non Critical Blue LED" 26 "Non Critical Grey LED" 28 "Critical Yellow LED" 29 "Critical Red LED" 30 "Critical Blue LED" 31 "Critical Grey LED";
VAL_ 2653818880 Status 0 "OK" 1 "Disabled" 2 "Initializing" 3 "Heating" 4 "WB_Active" 5 "Too Cold" 6 "Too Hot" 7 "Unplugged" 8 "Slow!" 9 "Uncal Yellow" 10 "Uncal Red" 11 "Replace" 12 "Disabled" 13 "Shorted" 14 "Open" 15 "Over Range" 16 "Under Range" 17 "Undefined" 18 "Error!" 19 "Low Error" 20 "High Error" 21 "Non Critical No LED" 27 "Critical Green LED" 32 "Stall!" 33 "Synchronized" 34 "Syncing" 35 "Error!" 36 "Error!" 37 "Uncalibrated" 38 "Open Loop" 39 "Closed Loop" 40 "Not Learn" 41 "Learning" 42 "Off" 43 "On" 44 "Not Rev Limiting" 45 "Rev Limit" 46 "No Cut Off" 47 "CutOff!" 48 "Off" 49 "Warning!" 50 "Caution!" 51 "No Timing modifier" 52 "Timing is being modified" 53 "Timing Value is being replaced" 54 "Acq Sat" 55 "No GPS" 56 "No Data" 22 "Non Critical Green LED" 23 "Non Critical Yellow LED" 24 "Non Critical Red LED" 25 "Non Critical Blue LED" 26 "Non Critical Grey LED" 28 "Critical Yellow LED" 29 "Critical Red LED" 30 "Critical Blue LED" 31 "Critical Grey LED";
VAL_ 2653835264 Status 0 "OK" 1 "Disabled" 2 "Initializing" 3 "Heating" 4 "WB_Active" 5 "Too Cold" 6 "Too Hot" 7 "Unplugged" 8 "Slow!" 9 "Uncal Yellow" 10 "Uncal Red" 11 "Replace" 12 "Disabled" 13 "Shorted" 14 "Open" 15 "Over Range" 16 "Under Range" 17 "Undefined" 18 "Error!" 19 "Low Error" 20 "High Error" 21 "Non Critical No LED" 27 "Critical Green LED" 32 "Stall!" 33 "Synchronized" 34 "Syncing" 35 "Error!" 36 "Error!" 37 "Uncalibrated" 38 "Open Loop" 39 "Closed Loop" 40 "Not Learn" 41 "Learning" 42 "Off" 43 "On" 44 "Not Rev Limiting" 45 "Rev Limit" 46 "No Cut Off" 47 "CutOff!" 48 "Off" 49 "Warning!" 50 "Caution!" 51 "No Timing modifier" 52 "Timing is being modified" 53 "Timing Value is being replaced" 54 "Acq Sat" 55 "No GPS" 56 "No Data" 22 "Non Critical Green LED" 23 "Non Critical Yellow LED" 24 "Non Critical Red LED" 25 "Non Critical Blue LED" 26 "Non Critical Grey LED" 28 "Critical Yellow LED" 29 "Critical Red LED" 30 "Critical Blue LED" 31 "Critical Grey LED";
VAL_ 2653851648 Status 0 "OK" 1 "Disabled" 2 "Initializing" 3 "Heating" 4 "WB_Active" 5 "Too Cold" 6 "Too Hot" 7 "Unplugged" 8 "Slow!" 9 "Uncal Yellow" 10 "Uncal Red" 11 "Replace" 12 "Disabled" 13 "Shorted" 14 "Open" 15 "Over Range" 16 "Under Range" 17 "Undefined" 18 "Error!" 19 "Low Error" 20 "High Error" 21 "Non Critical No LED" 27 "Critical Green LED" 32 "Stall!" 33 "Synchronized" 34 "Syncing" 35 "Error!" 36 "Error!" 37 "Uncalibrated" 38 "Open Loop" 39 "Closed Loop" 40 "Not Learn" 41 "Learning" 42 "Off" 43 "On" 44 "Not Rev Limiting" 45 "Rev Limit" 46 "No Cut Off" 47 "CutOff!" 48 "Off" 49 "Warning!" 50 "Caution!" 51 "No Timing modifier" 52 "Timing is being modified" 53 "Timing Value is being replaced" 54 "Acq Sat" 55 "No GPS" 56 "No Data" 22 "Non Critical Green LED" 23 "Non Critical Yellow LED" 24 "Non Critical Red LED" 25 "Non Critical Blue LED" 26 "Non Critical Grey LED" 28 "Critical Yellow LED" 29 "Critical Red LED" 30 "Critical Blue LED" 31 "Critical Grey LED";
VAL_ 2653868032 Status 0 "OK" 1 "Disabled" 2 "Initializing" 3 "Heating" 4 "WB_Active" 5 "Too Cold" 6 "Too Hot" 7 "Unplugged" 8 "Slow!" 9 "Uncal Yellow" 10 "Uncal Red" 11 "Replace" 12 "Disabled" 13 "Shorted" 14 "Open" 15 "Over Range" 16 "Under Range" 17 "Undefined" 18 "Error!" 19 "Low Error" 20 "High Error" 21 "Non Critical No LED" 27 "Critical Green LED" 32 "Stall!" 33 "Synchronized" 34 "Syncing" 35 "Error!" 36 "Error!" 37 "Uncalibrated" 38 "Open Loop" 39 "Closed Loop" 40 "Not Learn" 41 "Learning" 42 "Off" 43 "On" 44 "Not Rev Limiting" 45 "Rev Limit" 46 "No Cut Off" 47 "CutOff!" 48 "Off" 49 "Warning!" 50 "Caution!" 51 "No Timing modifier" 52 "Timing is being modified" 53 "Timing Value is being replaced" 54 "Acq Sat" 55 "No GPS" 56 "No Data" 22 "Non Critical Green LED" 23 "Non Critical Yellow LED" 24 "Non Critical Red LED" 25 "Non Critical Blue LED" 26 "Non Critical Grey LED" 28 "Critical Yellow LED" 29 "Critical Red LED" 30 "Critical Blue LED" 31 "Critical Grey LED";
VAL_ 2653884416 Status 0 "OK" 1 "Disabled" 2 "Initializing" 3 "Heating" 4 "WB_Active" 5 "Too Cold" 6 "Too Hot" 7 "Unplugged" 8 "Slow!" 9 "Uncal Yellow" 10 "Uncal Red" 11 "Replace" 12 "Disabled" 13 "Shorted" 14 "Open" 15 "Over Range" 16 "Under Range" 17 "Undefined" 18 "Error!" 19 "Low Error" 20 "High Error" 21 "Non Critical No LED" 27 "Critical Green LED" 32 "Stall!" 33 "Synchronized" 34 "Syncing" 35 "Error!" 36 "Error!" 37 "Uncalibrated" 38 "Open Loop" 39 "Closed Loop" 40 "Not Learn" 41 "Learning" 42 "Off" 43 "On" 44 "Not Rev Limiting" 45 "Rev Limit" 46 "No Cut Off" 47 "CutOff!" 48 "Off" 49 "Warning!" 50 "Caution!" 51 "No Timing modifier" 52 "Timing is being modified" 53 "Timing Value is being replaced" 54 "Acq Sat" 55 "No GPS" 56 "No Data" 22 "Non Critical Green LED" 23 "Non Critical Yellow LED" 24 "Non Critical Red LED" 25 "Non Critical Blue LED" 26 "Non Critical Grey LED" 28 "Critical Yellow LED" 29 "Critical Red LED" 30 "Critical Blue LED" 31 "Critical Grey LED";
VAL_ 2653900800 Status 0 "OK" 1 "Disabled" 2 "Initializing" 3 "Heating" 4 "WB_Active" 5 "Too Cold" 6 "Too Hot" 7 "Unplugged" 8 "Slow!" 9 "Uncal Yellow" 10 "Uncal Red" 11 "Replace" 12 "Disabled" 13 "Shorted" 14 "Open" 15 "Over Range" 16 "Under Range" 17 "Undefined" 18 "Error!" 19 "Low Error" 20 "High Error" 21 "Non Critical No LED" 27 "Critical Green LED" 32 "Stall!" 33 "Synchronized" 34 "Syncing" 35 "Error!" 36 "Error!" 37 "Uncalibrated" 38 "Open Loop" 39 "Closed Loop" 40 "Not Learn" 41 "Learning" 42 "Off" 43 "On" 44 "Not Rev Limiting" 45 "Rev Limit" 46 "No Cut Off" 47 "CutOff!" 48 "Off" 49 "Warning!" 50 "Caution!" 51 "No Timing modifier" 52 "Timing is being modified" 53 "Timing Value is being replaced" 54 "Acq Sat" 55 "No GPS" 56 "No Data" 22 "Non Critical Green LED" 23 "Non Critical Yellow LED" 24 "Non Critical Red LED" 25 "Non Critical Blue LED" 26 "Non Critical Grey LED" 28 "Critical Yellow LED" 29 "Critical Red LED" 30 "Critical Blue LED" 31 "Critical Grey LED";
VAL_ 2653917184 Status 0 "OK" 1 "Disabled" 2 "Initializing" 3 "Heating" 4 "WB_Active" 5 "Too Cold" 6 "Too Hot" 7 "Unplugged" 8 "Slow!" 9 "Uncal Yellow" 10 "Uncal Red" 11 "Replace" 12 "Disabled" 13 "Shorted" 14 "Open" 15 "Over Range" 16 "Under Range" 17 "Undefined" 18 "Error!" 19 "Low Error" 20 "High Error" 21 "Non Critical No LED" 27 "Critical Green LED" 32 "Stall!" 33 "Synchronized" 34 "Syncing" 35 "Error!" 36 "Error!" 37 "Uncalibrated" 38 "Open Loop" 39 "Closed Loop" 40 "Not Learn" 41 "Learning" 42 "Off" 43 "On" 44 "Not Rev Limiting" 45 "Rev Limit" 46 "No Cut Off" 47 "CutOff!" 48 "Off" 49 "Warning!" 50 "Caution!" 51 "No Timing modifier" 52 "Timing is being modified" 53 "Timing Value is being replaced" 54 "Acq Sat" 55 "No GPS" 56 "No Data" 22 "Non Critical Green LED" 23 "Non Critical Yellow LED" 24 "Non Critical Red LED" 25 "Non Critical Blue LED" 26 "Non Critical Grey LED" 28 "Critical Yellow LED" 29 "Critical Red LED" 30 "Critical Blue LED" 31 "Critical Grey LED";
VAL_ 2653933568 Status 0 "OK" 1 "Disabled" 2 "Initializing" 3 "Heating" 4 "WB_Active" 5 "Too Cold" 6 "Too Hot" 7 "Unplugged" 8 "Slow!" 9 "Uncal Yellow" 10 "Uncal Red" 11 "Replace" 12 "Disabled" 13 "Shorted" 14 "Open" 15 "Over Range" 16 "Under Range" 17 "Undefined" 18 "Error!" 19 "Low Error" 20 "High Error" 21 "Non Critical No LED" 27 "Critical Green LED" 32 "Stall!" 33 "Synchronized" 34 "Syncing" 35 "Error!" 36 "Error!" 37 "Uncalibrated" 38 "Open Loop" 39 "Closed Loop" 40 "Not Learn" 41 "Learning" 42 "Off" 43 "On" 44 "Not Rev Limiting" 45 "Rev Limit" 46 "No Cut Off" 47 "CutOff!" 48 "Off" 49 "Warning!" 50 "Caution!" 51 "No Timing modifier" 52 "Timing is being modified" 53 "Timing Value is being replaced" 54 "Acq Sat" 55 "No GPS" 56 "No Data" 22 "Non Critical Green LED" 23 "Non Critical Yellow LED" 24 "Non Critical Red LED" 25 "Non Critical Blue LED" 26 "Non Critical Grey LED" 28 "Critical Yellow LED" 29 "Critical Red LED" 30 "Critical Blue LED" 31 "Critical Grey LED";
VAL_ 2653949952 Status 0 "OK" 1 "Disabled" 2 "Initializing" 3 "Heating" 4 "WB_Active" 5 "Too Cold" 6 "Too Hot" 7 "Unplugged" 8 "Slow!" 9 "Uncal Yellow" 10 "Uncal Red" 11 "Replace" 12 "Disabled" 13 "Shorted" 14 "Open" 15 "Over Range" 16 "Under Range" 17 "Undefined" 18 "Error!" 19 "Low Error" 20 "High Error" 21 "Non Critical No LED" 27 "Critical Green LED" 32 "Stall!" 33 "Synchronized" 34 "Syncing" 35 "Error!" 36 "Error!" 37 "Uncalibrated" 38 "Open Loop" 39 "Closed Loop" 40 "Not Learn" 41 "Learning" 42 "Off" 43 "On" 44 "Not Rev Limiting" 45 "Rev Limit" 46 "No Cut Off" 47 "CutOff!" 48 "Off" 49 "Warning!" 50 "Caution!" 51 "No Timing modifier" 52 "Timing is being modified" 53 "Timing Value is being replaced" 54 "Acq Sat" 55 "No GPS" 56 "No Data" 22 "Non Critical Green LED" 23 "Non Critical Yellow LED" 24 "Non Critical Red LED" 25 "Non Critical Blue LED" 26 "Non Critical Grey LED" 28 "Critical Yellow LED" 29 "Critical Red LED" 30 "Critical Blue LED" 31 "Critical Grey LED";
VAL_ 2653966336 Status 0 "OK" 1 "Disabled" 2 "Initializing" 3 "Heating" 4 "WB_Active" 5 "Too Cold" 6 "Too Hot" 7 "Unplugged" 8 "Slow!" 9 "Uncal Yellow" 10 "Uncal Red" 11 "Replace" 12 "Disabled" 13 "Shorted" 14 "Open" 15 "Over Range" 16 "Under Range" 17 "Undefined" 18 "Error!" 19 "Low Error" 20 "High Error" 21 "Non Critical No LED" 27 "Critical Green LED" 32 "Stall!" 33 "Synchronized" 34 "Syncing" 35 "Error!" 36 "Error!" 37 "Uncalibrated" 38 "Open Loop" 39 "Closed Loop" 40 "Not Learn" 41 "Learning" 42 "Off" 43 "On" 44 "Not Rev Limiting" 45 "Rev Limit" 46 "No Cut Off" 47 "CutOff!" 48 "Off" 49 "Warning!" 50 "Caution!" 51 "No Timing modifier" 52 "Timing is being modified" 53 "Timing Value is being replaced" 54 "Acq Sat" 55 "No GPS" 56 "No Data" 22 "Non Critical Green LED" 23 "Non Critical Yellow LED" 24 "Non Critical Red LED" 25 "Non Critical Blue LED" 26 "Non Critical Grey LED" 28 "Critical Yellow LED" 29 "Critical Red LED" 30 "Critical Blue LED" 31 "Critical Grey LED";
VAL_ 2653982720 Status 0 "OK" 1 "Disabled" 2 "Initializing" 3 "Heating" 4 "WB_Active" 5 "Too Cold" 6 "Too Hot" 7 "Unplugged" 8 "Slow!" 9 "Uncal Yellow" 10 "Uncal Red" 11 "Replace" 12 "Disabled" 13 "Shorted" 14 "Open" 15 "Over Range" 16 "Under Range" 17 "Undefined" 18 "Error!" 19 "Low Error" 20 "High Error" 21 "Non Critical No LED" 27 "Critical Green LED" 32 "Stall!" 33 "Synchronized" 34 "Syncing" 35 "Error!" 36 "Error!" 37 "Uncalibrated" 38 "Open Loop" 39 "Closed Loop" 40 "Not Learn" 41 "Learning" 42 "Off" 43 "On" 44 "Not Rev Limiting" 45 "Rev Limit" 46 "No Cut Off" 47 "CutOff!" 48 "Off" 49 "Warning!" 50 "Caution!" 51 "No Timing modifier" 52 "Timing is being modified" 53 "Timing Value is being replaced" 54 "Acq Sat" 55 "No GPS" 56 "No Data" 22 "Non Critical Green LED" 23 "Non Critical Yellow LED" 24 "Non Critical Red LED" 25 "Non Critical Blue LED" 26 "Non Critical Grey LED" 28 "Critical Yellow LED" 29 "Critical Red LED" 30 "Critical Blue LED" 31 "Critical Grey LED";
VAL_ 2653999104 Status 0 "OK" 1 "Disabled" 2 "Initializing" 3 "Heating" 4 "WB_Active" 5 "Too Cold" 6 "Too Hot" 7 "Unplugged" 8 "Slow!" 9 "Uncal Yellow" 10 "Uncal Red" 11 "Replace" 12 "Disabled" 13 "Shorted" 14 "Open" 15 "Over Range" 16 "Under Range" 17 "Undefined" 18 "Error!" 19 "Low Error" 20 "High Error" 21 "Non Critical No LED" 27 "Critical Green LED" 32 "Stall!" 33 "Synchronized" 34 "Syncing" 35 "Error!" 36 "Error!" 37 "Uncalibrated" 38 "Open Loop" 39 "Closed Loop" 40 "Not Learn" 41 "Learning" 42 "Off" 43 "On" 44 "Not Rev Limiting" 45 "Rev Limit" 46 "No Cut Off" 47 "CutOff!" 48 "Off" 49 "Warning!" 50 "Caution!" 51 "No Timing modifier" 52 "Timing is being modified" 53 "Timing Value is being replaced" 54 "Acq Sat" 55 "No GPS" 56 "No Data" 22 "Non Critical Green LED" 23 "Non Critical Yellow LED" 24 "Non Critical Red LED" 25 "Non Critical Blue LED" 26 "Non Critical Grey LED" 28 "Critical Yellow LED" 29 "Critical Red LED" 30 "Critical Blue LED" 31 "Critical Grey LED";
VAL_ 2654015488 Status 0 "OK" 1 "Disabled" 2 "Initializing" 3 "Heating" 4 "WB_Active" 5 "Too Cold" 6 "Too Hot" 7 "Unplugged" 8 "Slow!" 9 "Uncal Yellow" 10 "Uncal Red" 11 "Replace" 12 "Disabled" 13 "Shorted" 14 "Open" 15 "Over Range" 16 "Under Range" 17 "Undefined" 18 "Error!" 19 "Low Error" 20 "High Error" 21 "Non Critical No LED" 27 "Critical Green LED" 32 "Stall!" 33 "Synchronized" 34 "Syncing" 35 "Error!" 36 "Error!" 37 "Uncalibrated" 38 "Open Loop" 39 "Closed Loop" 40 "Not Learn" 41 "Learning" 42 "Off" 43 "On" 44 "Not Rev Limiting" 45 "Rev Limit" 46 "No Cut Off" 47 "CutOff!" 48 "Off" 49 "Warning!" 50 "Caution!" 51 "No Timing modifier" 52 "Timing is being modified" 53 "Timing Value is being replaced" 54 "Acq Sat" 55 "No GPS" 56 "No Data" 22 "Non Critical Green LED" 23 "Non Critical Yellow LED" 24 "Non Critical Red LED" 25 "Non Critical Blue LED" 26 "Non Critical Grey LED" 28 "Critical Yellow LED" 29 "Critical Red LED" 30 "Critical Blue LED" 31 "Critical Grey LED";
VAL_ 2654031872 Status 0 "OK" 1 "Disabled" 2 "Initializing" 3 "Heating" 4 "WB_Active" 5 "Too Cold" 6 "Too Hot" 7 "Unplugged" 8 "Slow!" 9 "Uncal Yellow" 10 "Uncal Red" 11 "Replace" 12 "Disabled" 13 "Shorted" 14 "Open" 15 "Over Range" 16 "Under Range" 17 "Undefined" 18 "Error!" 19 "Low Error" 20 "High Error" 21 "Non Critical No LED" 27 "Critical Green LED" 32 "Stall!" 33 "Synchronized" 34 "Syncing" 35 "Error!" 36 "Error!" 37 "Uncalibrated" 38 "Open Loop" 39 "Closed Loop" 40 "Not Learn" 41 "Learning" 42 "Off" 43 "On" 44 "Not Rev Limiting" 45 "Rev Limit" 46 "No Cut Off" 47 "CutOff!" 48 "Off" 49 "Warning!" 50 "Caution!" 51 "No Timing modifier" 52 "Timing is being modified" 53 "Timing Value is being replaced" 54 "Acq Sat" 55 "No GPS" 56 "No Data" 22 "Non Critical Green LED" 23 "Non Critical Yellow LED" 24 "Non Critical Red LED" 25 "Non Critical Blue LED" 26 "Non Critical Grey LED" 28 "Critical Yellow LED" 29 "Critical Red LED" 30 "Critical Blue LED" 31 "Critical Grey LED";
VAL_ 2654048256 Status 0 "OK" 1 "Disabled" 2 "Initializing" 3 "Heating" 4 "WB_Active" 5 "Too Cold" 6 "Too Hot" 7 "Unplugged" 8 "Slow!" 9 "Uncal Yellow" 10 "Uncal Red" 11 "Replace" 12 "Disabled" 13 "Shorted" 14 "Open" 15 "Over Range" 16 "Under Range" 17 "Undefined" 18 "Error!" 19 "Low Error" 20 "High Error" 21 "Non Critical No LED" 27 "Critical Green LED" 32 "Stall!" 33 "Synchronized" 34 "Syncing" 35 "Error!" 36 "Error!" 37 "Uncalibrated" 38 "Open Loop" 39 "Closed Loop" 40 "Not Learn" 41 "Learning" 42 "Off" 43 "On" 44 "Not Rev Limiting" 45 "Rev Limit" 46 "No Cut Off" 47 "CutOff!" 48 "Off" 49 "Warning!" 50 "Caution!" 51 "No Timing modifier" 52 "Timing is being modified" 53 "Timing Value is being replaced" 54 "Acq Sat" 55 "No GPS" 56 "No Data" 22 "Non Critical Green LED" 23 "Non Critical Yellow LED" 24 "Non Critical Red LED" 25 "Non Critical Blue LED" 26 "Non Critical Grey LED" 28 "Critical Yellow LED" 29 "Critical Red LED" 30 "Critical Blue LED" 31 "Critical Grey LED";
VAL_ 2654064640 Status 0 "OK" 1 "Disabled" 2 "Initializing" 3 "Heating" 4 "WB_Active" 5 "Too Cold" 6 "Too Hot" 7 "Unplugged" 8 "Slow!" 9 "Uncal Yellow" 10 "Uncal Red" 11 "Replace" 12 "Disabled" 13 "Shorted" 14 "Open" 15 "Over Range" 16 "Under Range" 17 "Undefined" 18 "Error!" 19 "Low Error" 20 "High Error" 21 "Non Critical No LED" 27 "Critical Green LED" 32 "Stall!" 33 "Synchronized" 34 "Syncing" 35 "Error!" 36 "Error!" 37 "Uncalibrated" 38 "Open Loop" 39 "Closed Loop" 40 "Not Learn" 41 "Learning" 42 "Off" 43 "On" 44 "Not Rev Limiting" 45 "Rev Limit" 46 "No Cut Off" 47 "CutOff!" 48 "Off" 49 "Warning!" 50 "Caution!" 51 "No Timing modifier" 52 "Timing is being modified" 53 "Timing Value is being replaced" 54 "Acq Sat" 55 "No GPS" 56 "No Data" 22 "Non Critical Green LED" 23 "Non Critical Yellow LED" 24 "Non Critical Red LED" 25 "Non Critical Blue LED" 26 "Non Critical Grey LED" 28 "Critical Yellow LED" 29 "Critical Red LED" 30 "Critical Blue LED" 31 "Critical Grey LED";
VAL_ 2654081024 Status 0 "OK" 1 "Disabled" 2 "Initializing" 3 "Heating" 4 "WB_Active" 5 "Too Cold" 6 "Too Hot" 7 "Unplugged" 8 "Slow!" 9 "Uncal Yellow" 10 "Uncal Red" 11 "Replace" 12 "Disabled" 13 "Shorted" 14 "Open" 15 "Over Range" 16 "Under Range" 17 "Undefined" 18 "Error!" 19 "Low Error" 20 "High Error" 21 "Non Critical No LED" 27 "Critical Green LED" 32 "Stall!" 33 "Synchronized" 34 "Syncing" 35 "Error!" 36 "Error!" 37 "Uncalibrated" 38 "Open Loop" 39 "Closed Loop" 40 "Not Learn" 41 "Learning" 42 "Off" 43 "On" 44 "Not Rev Limiting" 45 "Rev Limit" 46 "No Cut Off" 47 "CutOff!" 48 "Off" 49 "Warning!" 50 "Caution!" 51 "No Timing modifier" 52 "Timing is being modified" 53 "Timing Value is being replaced" 54 "Acq Sat" 55 "No GPS" 56 "No Data" 22 "Non Critical Green LED" 23 "Non Critical Yellow LED" 24 "Non Critical Red LED" 25 "Non Critical Blue LED" 26 "Non Critical Grey LED" 28 "Critical Yellow LED" 29 "Critical Red LED" 30 "Critical Blue LED" 31 "Critical Grey LED";
VAL_ 2654097408 Status 0 "OK" 1 "Disabled" 2 "Initializing" 3 "Heating" 4 "WB_Active" 5 "Too Cold" 6 "Too Hot" 7 "Unplugged" 8 "Slow!" 9 "Uncal Yellow" 10 "Uncal Red" 11 "Replace" 12 "Disabled" 13 "Shorted" 14 "Open" 15 "Over Range" 16 "Under Range" 17 "Undefined" 18 "Error!" 19 "Low Error" 20 "High Error" 21 "Non Critical No LED" 27 "Critical Green LED" 32 "Stall!" 33 "Synchronized" 34 "Syncing" 35 "Error!" 36 "Error!" 37 "Uncalibrated" 38 "Open Loop" 39 "Closed Loop" 40 "Not Learn" 41 "Learning" 42 "Off" 43 "On" 44 "Not Rev Limiting" 45 "Rev Limit" 46 "No Cut Off" 47 "CutOff!" 48 "Off" 49 "Warning!" 50 "Caution!" 51 "No Timing modifier" 52 "Timing is being modified" 53 "Timing Value is being replaced" 54 "Acq Sat" 55 "No GPS" 56 "No Data" 22 "Non Critical Green LED" 23 "Non Critical Yellow LED" 24 "Non Critical Red LED" 25 "Non Critical Blue LED" 26 "Non Critical Grey LED" 28 "Critical Yellow LED" 29 "Critical Red LED" 30 "Critical Blue LED" 31 "Critical Grey LED";
VAL_ 2654113792 Status 0 "OK" 1 "Disabled" 2 "Initializing" 3 "Heating" 4 "WB_Active" 5 "Too Cold" 6 "Too Hot" 7 "Unplugged" 8 "Slow!" 9 "Uncal Yellow" 10 "Uncal Red" 11 "Replace" 12 "Disabled" 13 "Shorted" 14 "Open" 15 "Over Range" 16 "Under Range" 17 "Undefined" 18 "Error!" 19 "Low Error" 20 "High Error" 21 "Non Critical No LED" 27 "Critical Green LED" 32 "Stall!" 33 "Synchronized" 34 "Syncing" 35 "Error!" 36 "Error!" 37 "Uncalibrated" 38 "Open Loop" 39 "Closed Loop" 40 "Not Learn" 41 "Learning" 42 "Off" 43 "On" 44 "Not Rev Limiting" 45 "Rev Limit" 46 "No Cut Off" 47 "CutOff!" 48 "Off" 49 "Warning!" 50 "Caution!" 51 "No Timing modifier" 52 "Timing is being modified" 53 "Timing Value is being replaced" 54 "Acq Sat" 55 "No GPS" 56 "No Data" 22 "Non Critical Green LED" 23 "Non Critical Yellow LED" 24 "Non Critical Red LED" 25 "Non Critical Blue LED" 26 "Non Critical Grey LED" 28 "Critical Yellow LED" 29 "Critical Red LED" 30 "Critical Blue LED" 31 "Critical Grey LED";
VAL_ 2654130176 Status 0 "OK" 1 "Disabled" 2 "Initializing" 3 "Heating" 4 "WB_Active" 5 "Too Cold" 6 "Too Hot" 7 "Unplugged" 8 "Slow!" 9 "Uncal Yellow" 10 "Uncal Red" 11 "Replace" 12 "Disabled" 13 "Shorted" 14 "Open" 15 "Over Range" 16 "Under Range" 17 "Undefined" 18 "Error!" 19 "Low Error" 20 "High Error" 21 "Non Critical No LED" 27 "Critical Green LED" 32 "Stall!" 33 "Synchronized" 34 "Syncing" 35 "Error!" 36 "Error!" 37 "Uncalibrated" 38 "Open Loop" 39 "Closed Loop" 40 "Not Learn" 41 "Learning" 42 "Off" 43 "On" 44 "Not Rev Limiting" 45 "Rev Limit" 46 "No Cut Off" 47 "CutOff!" 48 "Off" 49 "Warning!" 50 "Caution!" 51 "No Timing modifier" 52 "Timing is being modified" 53 "Timing Value is being replaced" 54 "Acq Sat" 55 "No GPS" 56 "No Data" 22 "Non Critical Green LED" 23 "Non Critical Yellow LED" 24 "Non Critical Red LED" 25 "Non Critical Blue LED" 26 "Non Critical Grey LED" 28 "Critical Yellow LED" 29 "Critical Red LED" 30 "Critical Blue LED" 31 "Critical Grey LED";
VAL_ 2654146560 Status 0 "OK" 1 "Disabled" 2 "Initializing" 3 "Heating" 4 "WB_Active" 5 "Too Cold" 6 "Too Hot" 7 "Unplugged" 8 "Slow!" 9 "Uncal Yellow" 10 "Uncal Red" 11 "Replace" 12 "Disabled" 13 "Shorted" 14 "Open" 15 "Over Range" 16 "Under Range" 17 "Undefined" 18 "Error!" 19 "Low Error" 20 "High Error" 21 "Non Critical No LED" 27 "Critical Green LED" 32 "Stall!" 33 "Synchronized" 34 "Syncing" 35 "Error!" 36 "Error!" 37 "Uncalibrated" 38 "Open Loop" 39 "Closed Loop" 40 "Not Learn" 41 "Learning" 42 "Off" 43 "On" 44 "Not Rev Limiting" 45 "Rev Limit" 46 "No Cut Off" 47 "CutOff!" 48 "Off" 49 "Warning!" 50 "Caution!" 51 "No Timing modifier" 52 "Timing is being modified" 53 "Timing Value is being replaced" 54 "Acq Sat" 55 "No GPS" 56 "No Data" 22 "Non Critical Green LED" 23 "Non Critical Yellow LED" 24 "Non Critical Red LED" 25 "Non Critical Blue LED" 26 "Non Critical Grey LED" 28 "Critical Yellow LED" 29 "Critical Red LED" 30 "Critical Blue LED" 31 "Critical Grey LED";
VAL_ 2654162944 Status 0 "OK" 1 "Disabled" 2 "Initializing" 3 "Heating" 4 "WB_Active" 5 "Too Cold" 6 "Too Hot" 7 "Unplugged" 8 "Slow!" 9 "Uncal Yellow" 10 "Uncal Red" 11 "Replace" 12 "Disabled" 13 "Shorted" 14 "Open" 15 "Over Range" 16 "Under Range" 17 "Undefined" 18 "Error!" 19 "Low Error" 20 "High Error" 21 "Non Critical No LED" 27 "Critical Green LED" 32 "Stall!" 33 "Synchronized" 34 "Syncing" 35 "Error!" 36 "Error!" 37 "Uncalibrated" 38 "Open Loop" 39 "Closed Loop" 40 "Not Learn" 41 "Learning" 42 "Off" 43 "On" 44 "Not Rev Limiting" 45 "Rev Limit" 46 "No Cut Off" 47 "CutOff!" 48 "Off" 49 "Warning!" 50 "Caution!" 51 "No Timing modifier" 52 "Timing is being modified" 53 "Timing Value is being replaced" 54 "Acq Sat" 55 "No GPS" 56 "No Data" 22 "Non Critical Green LED" 23 "Non Critical Yellow LED" 24 "Non Critical Red LED" 25 "Non Critical Blue LED" 26 "Non Critical Grey LED" 28 "Critical Yellow LED" 29 "Critical Red LED" 30 "Critical Blue LED" 31 "Critical Grey LED";
VAL_ 2654179328 Status 0 "OK" 1 "Disabled" 2 "Initializing" 3 "Heating" 4 "WB_Active" 5 "Too Cold" 6 "Too Hot" 7 "Unplugged" 8 "Slow!" 9 "Uncal Yellow" 10 "Uncal Red" 11 "Replace" 12 "Disabled" 13 "Shorted" 14 "Open" 15 "Over Range" 16 "Under Range" 17 "Undefined" 18 "Error!" 19 "Low Error" 20 "High Error" 21 "Non Critical No LED" 27 "Critical Green LED" 32 "Stall!" 33 "Synchronized" 34 "Syncing" 35 "Error!" 36 "Error!" 37 "Uncalibrated" 38 "Open Loop" 39 "Closed Loop" 40 "Not Learn" 41 "Learning" 42 "Off" 43 "On" 44 "Not Rev Limiting" 45 "Rev Limit" 46 "No Cut Off" 47 "CutOff!" 48 "Off" 49 "Warning!" 50 "Caution!" 51 "No Timing modifier" 52 "Timing is being modified" 53 "Timing Value is being replaced" 54 "Acq Sat" 55 "No GPS" 56 "No Data" 22 "Non Critical Green LED" 23 "Non Critical Yellow LED" 24 "Non Critical Red LED" 25 "Non Critical Blue LED" 26 "Non Critical Grey LED" 28 "Critical Yellow LED" 29 "Critical Red LED" 30 "Critical Blue LED" 31 "Critical Grey LED";
VAL_ 2654195712 Status 0 "OK" 1 "Disabled" 2 "Initializing" 3 "Heating" 4 "WB_Active" 5 "Too Cold" 6 "Too Hot" 7 "Unplugged" 8 "Slow!" 9 "Uncal Yellow" 10 "Uncal Red" 11 "Replace" 12 "Disabled" 13 "Shorted" 14 "Open" 15 "Over Range" 16 "Under Range" 17 "Undefined" 18 "Error!" 19 "Low Error" 20 "High Error" 21 "Non Critical No LED" 27 "Critical Green LED" 32 "Stall!" 33 "Synchronized" 34 "Syncing" 35 "Error!" 36 "Error!" 37 "Uncalibrated" 38 "Open Loop" 39 "Closed Loop" 40 "Not Learn" 41 "Learning" 42 "Off" 43 "On" 44 "Not Rev Limiting" 45 "Rev Limit" 46 "No Cut Off" 47 "CutOff!" 48 "Off" 49 "Warning!" 50 "Caution!" 51 "No Timing modifier" 52 "Timing is being modified" 53 "Timing Value is being replaced" 54 "Acq Sat" 55 "No GPS" 56 "No Data" 22 "Non Critical Green LED" 23 "Non Critical Yellow LED" 24 "Non Critical Red LED" 25 "Non Critical Blue LED" 26 "Non Critical Grey LED" 28 "Critical Yellow LED" 29 "Critical Red LED" 30 "Critical Blue LED" 31 "Critical Grey LED";
VAL_ 2654212096 Status 0 "OK" 1 "Disabled" 2 "Initializing" 3 "Heating" 4 "WB_Active" 5 "Too Cold" 6 "Too Hot" 7 "Unplugged" 8 "Slow!" 9 "Uncal Yellow" 10 "Uncal Red" 11 "Replace" 12 "Disabled" 13 "Shorted" 14 "Open" 15 "Over Range" 16 "Under Range" 17 "Undefined" 18 "Error!" 19 "Low Error" 20 "High Error" 21 "Non Critical No LED" 27 "Critical Green LED" 32 "Stall!" 33 "Synchronized" 34 "Syncing" 35 "Error!" 36 "Error!" 37 "Uncalibrated" 38 "Open Loop" 39 "Closed Loop" 40 "Not Learn" 41 "Learning" 42 "Off" 43 "On" 44 "Not Rev Limiting" 45 "Rev Limit" 46 "No Cut Off" 47 "CutOff!" 48 "Off" 49 "Warning!" 50 "Caution!" 51 "No Timing modifier" 52 "Timing is being modified" 53 "Timing Value is being replaced" 54 "Acq Sat" 55 "No GPS" 56 "No Data" 22 "Non Critical Green LED" 23 "Non Critical Yellow LED" 24 "Non Critical Red LED" 25 "Non Critical Blue LED" 26 "Non Critical Grey LED" 28 "Critical Yellow LED" 29 "Critical Red LED" 30 "Critical Blue LED" 31 "Critical Grey LED";
VAL_ 2654228480 Status 0 "OK" 1 "Disabled" 2 "Initializing" 3 "Heating" 4 "WB_Active" 5 "Too Cold" 6 "Too Hot" 7 "Unplugged" 8 "Slow!" 9 "Uncal Yellow" 10 "Uncal Red" 11 "Replace" 12 "Disabled" 13 "Shorted" 14 "Open" 15 "Over Range" 16 "Under Range" 17 "Undefined" 18 "Error!" 19 "Low Error" 20 "High Error" 21 "Non Critical No LED" 27 "Critical Green LED" 32 "Stall!" 33 "Synchronized" 34 "Syncing" 35 "Error!" 36 "Error!" 37 "Uncalibrated" 38 "Open Loop" 39 "Closed Loop" 40 "Not Learn" 41 "Learning" 42 "Off" 43 "On" 44 "Not Rev Limiting" 45 "Rev Limit" 46 "No Cut Off" 47 "CutOff!" 48 "Off" 49 "Warning!" 50 "Caution!" 51 "No Timing modifier" 52 "Timing is being modified" 53 "Timing Value is being replaced" 54 "Acq Sat" 55 "No GPS" 56 "No Data" 22 "Non Critical Green LED" 23 "Non Critical Yellow LED" 24 "Non Critical Red LED" 25 "Non Critical Blue LED" 26 "Non Critical Grey LED" 28 "Critical Yellow LED" 29 "Critical Red LED" 30 "Critical Blue LED" 31 "Critical Grey LED";
VAL_ 2654244864 Status 0 "OK" 1 "Disabled" 2 "Initializing" 3 "Heating" 4 "WB_Active" 5 "Too Cold" 6 "Too Hot" 7 "Unplugged" 8 "Slow!" 9 "Uncal Yellow" 10 "Uncal Red" 11 "Replace" 12 "Disabled" 13 "Shorted" 14 "Open" 15 "Over Range" 16 "Under Range" 17 "Undefined" 18 "Error!" 19 "Low Error" 20 "High Error" 21 "Non Critical No LED" 27 "Critical Green LED" 32 "Stall!" 33 "Synchronized" 34 "Syncing" 35 "Error!" 36 "Error!" 37 "Uncalibrated" 38 "Open Loop" 39 "Closed Loop" 40 "Not Learn" 41 "Learning" 42 "Off" 43 "On" 44 "Not Rev Limiting" 45 "Rev Limit" 46 "No Cut Off" 47 "CutOff!" 48 "Off" 49 "Warning!" 50 "Caution!" 51 "No Timing modifier" 52 "Timing is being modified" 53 "Timing Value is being replaced" 54 "Acq Sat" 55 "No GPS" 56 "No Data" 22 "Non Critical Green LED" 23 "Non Critical Yellow LED" 24 "Non Critical Red LED" 25 "Non Critical Blue LED" 26 "Non Critical Grey LED" 28 "Critical Yellow LED" 29 "Critical Red LED" 30 "Critical Blue LED" 31 "Critical Grey LED";
VAL_ 2654261248 Status 0 "OK" 1 "Disabled" 2 "Initializing" 3 "Heating" 4 "WB_Active" 5 "Too Cold" 6 "Too Hot" 7 "Unplugged" 8 "Slow!" 9 "Uncal Yellow" 10 "Uncal Red" 11 "Replace" 12 "Disabled" 13 "Shorted" 14 "Open" 15 "Over Range" 16 "Under Range" 17 "Undefined" 18 "Error!" 19 "Low Error" 20 "High Error" 21 "Non Critical No LED" 27 "Critical Green LED" 32 "Stall!" 33 "Synchronized" 34 "Syncing" 35 "Error!" 36 "Error!" 37 "Uncalibrated" 38 "Open Loop" 39 "Closed Loop" 40 "Not Learn" 41 "Learning" 42 "Off" 43 "On" 44 "Not Rev Limiting" 45 "Rev Limit" 46 "No Cut Off" 47 "CutOff!" 48 "Off" 49 "Warning!" 50 "Caution!" 51 "No Timing modifier" 52 "Timing is being modified" 53 "Timing Value is being replaced" 54 "Acq Sat" 55 "No GPS" 56 "No Data" 22 "Non Critical Green LED" 23 "Non Critical Yellow LED" 24 "Non Critical Red LED" 25 "Non Critical Blue LED" 26 "Non Critical Grey LED" 28 "Critical Yellow LED" 29 "Critical Red LED" 30 "Critical Blue LED" 31 "Critical Grey LED";
VAL_ 2654277632 Status 0 "OK" 1 "Disabled" 2 "Initializing" 3 "Heating" 4 "WB_Active" 5 "Too Cold" 6 "Too Hot" 7 "Unplugged" 8 "Slow!" 9 "Uncal Yellow" 10 "Uncal Red" 11 "Replace" 12 "Disabled" 13 "Shorted" 14 "Open" 15 "Over Range" 16 "Under Range" 17 "Undefined" 18 "Error!" 19 "Low Error" 20 "High Error" 21 "Non Critical No LED" 27 "Critical Green LED" 32 "Stall!" 33 "Synchronized" 34 "Syncing" 35 "Error!" 36 "Error!" 37 "Uncalibrated" 38 "Open Loop" 39 "Closed Loop" 40 "Not Learn" 41 "Learning" 42 "Off" 43 "On" 44 "Not Rev Limiting" 45 "Rev Limit" 46 "No Cut Off" 47 "CutOff!" 48 "Off" 49 "Warning!" 50 "Caution!" 51 "No Timing modifier" 52 "Timing is being modified" 53 "Timing Value is being replaced" 54 "Acq Sat" 55 "No GPS" 56 "No Data" 22 "Non Critical Green LED" 23 "Non Critical Yellow LED" 24 "Non Critical Red LED" 25 "Non Critical Blue LED" 26 "Non Critical Grey LED" 28 "Critical Yellow LED" 29 "Critical Red LED" 30 "Critical Blue LED" 31 "Critical Grey LED";
VAL_ 2654294016 Status 0 "OK" 1 "Disabled" 2 "Initializing" 3 "Heating" 4 "WB_Active" 5 "Too Cold" 6 "Too Hot" 7 "Unplugged" 8 "Slow!" 9 "Uncal Yellow" 10 "Uncal Red" 11 "Replace" 12 "Disabled" 13 "Shorted" 14 "Open" 15 "Over Range" 16 "Under Range" 17 "Undefined" 18 "Error!" 19 "Low Error" 20 "High Error" 21 "Non Critical No LED" 27 "Critical Green LED" 32 "Stall!" 33 "Synchronized" 34 "Syncing" 35 "Error!" 36 "Error!" 37 "Uncalibrated" 38 "Open Loop" 39 "Closed Loop" 40 "Not Learn" 41 "Learning" 42 "Off" 43 "On" 44 "Not Rev Limiting" 45 "Rev Limit" 46 "No Cut Off" 47 "CutOff!" 48 "Off" 49 "Warning!" 50 "Caution!" 51 "No Timing modifier" 52 "Timing is being modified" 53 "Timing Value is being replaced" 54 "Acq Sat" 55 "No GPS" 56 "No Data" 22 "Non Critical Green LED" 23 "Non Critical Yellow LED" 24 "Non Critical Red LED" 25 "Non Critical Blue LED" 26 "Non Critical Grey LED" 28 "Critical Yellow LED" 29 "Critical Red LED" 30 "Critical Blue LED" 31 "Critical Grey LED";
VAL_ 2654310400 Status 0 "OK" 1 "Disabled" 2 "Initializing" 3 "Heating" 4 "WB_Active" 5 "Too Cold" 6 "Too Hot" 7 "Unplugged" 8 "Slow!" 9 "Uncal Yellow" 10 "Uncal Red" 11 "Replace" 12 "Disabled" 13 "Shorted" 14 "Open" 15 "Over Range" 16 "Under Range" 17 "Undefined" 18 "Error!" 19 "Low Error" 20 "High Error" 21 "Non Critical No LED" 27 "Critical Green LED" 32 "Stall!" 33 "Synchronized" 34 "Syncing" 35 "Error!" 36 "Error!" 37 "Uncalibrated" 38 "Open Loop" 39 "Closed Loop" 40 "Not Learn" 41 "Learning" 42 "Off" 43 "On" 44 "Not Rev Limiting" 45 "Rev Limit" 46 "No Cut Off" 47 "CutOff!" 48 "Off" 49 "Warning!" 50 "Caution!" 51 "No Timing modifier" 52 "Timing is being modified" 53 "Timing Value is being replaced" 54 "Acq Sat" 55 "No GPS" 56 "No Data" 22 "Non Critical Green LED" 23 "Non Critical Yellow LED" 24 "Non Critical Red LED" 25 "Non Critical Blue LED" 26 "Non Critical Grey LED" 28 "Critical Yellow LED" 29 "Critical Red LED" 30 "Critical Blue LED" 31 "Critical Grey LED";
VAL_ 2654392320 Status 0 "OK" 1 "Disabled" 2 "Initializing" 3 "Heating" 4 "WB_Active" 5 "Too Cold" 6 "Too Hot" 7 "Unplugged" 8 "Slow!" 9 "Uncal Yellow" 10 "Uncal Red" 11 "Replace" 12 "Disabled" 13 "Shorted" 14 "Open" 15 "Over Range" 16 "Under Range" 17 "Undefined" 18 "Error!" 19 "Low Error" 20 "High Error" 21 "Non Critical No LED" 27 "Critical Green LED" 32 "Stall!" 33 "Synchronized" 34 "Syncing" 35 "Error!" 36 "Error!" 37 "Uncalibrated" 38 "Open Loop" 39 "Closed Loop" 40 "Not Learn" 41 "Learning" 42 "Off" 43 "On" 44 "Not Rev Limiting" 45 "Rev Limit" 46 "No Cut Off" 47 "CutOff!" 48 "Off" 49 "Warning!" 50 "Caution!" 51 "No Timing modifier" 52 "Timing is being modified" 53 "Timing Value is being replaced" 54 "Acq Sat" 55 "No GPS" 56 "No Data" 22 "Non Critical Green LED" 23 "Non Critical Yellow LED" 24 "Non Critical Red LED" 25 "Non Critical Blue LED" 26 "Non Critical Grey LED" 28 "Critical Yellow LED" 29 "Critical Red LED" 30 "Critical Blue LED" 31 "Critical Grey LED";
VAL_ 2654408704 Status 0 "OK" 1 "Disabled" 2 "Initializing" 3 "Heating" 4 "WB_Active" 5 "Too Cold" 6 "Too Hot" 7 "Unplugged" 8 "Slow!" 9 "Uncal Yellow" 10 "Uncal Red" 11 "Replace" 12 "Disabled" 13 "Shorted" 14 "Open" 15 "Over Range" 16 "Under Range" 17 "Undefined" 18 "Error!" 19 "Low Error" 20 "High Error" 21 "Non Critical No LED" 27 "Critical Green LED" 32 "Stall!" 33 "Synchronized" 34 "Syncing" 35 "Error!" 36 "Error!" 37 "Uncalibrated" 38 "Open Loop" 39 "Closed Loop" 40 "Not Learn" 41 "Learning" 42 "Off" 43 "On" 44 "Not Rev Limiting" 45 "Rev Limit" 46 "No Cut Off" 47 "CutOff!" 48 "Off" 49 "Warning!" 50 "Caution!" 51 "No Timing modifier" 52 "Timing is being modified" 53 "Timing Value is being replaced" 54 "Acq Sat" 55 "No GPS" 56 "No Data" 22 "Non Critical Green LED" 23 "Non Critical Yellow LED" 24 "Non Critical Red LED" 25 "Non Critical Blue LED" 26 "Non Critical Grey LED" 28 "Critical Yellow LED" 29 "Critical Red LED" 30 "Critical Blue LED" 31 "Critical Grey LED";
VAL_ 2654425088 Status 0 "OK" 1 "Disabled" 2 "Initializing" 3 "Heating" 4 "WB_Active" 5 "Too Cold" 6 "Too Hot" 7 "Unplugged" 8 "Slow!" 9 "Uncal Yellow" 10 "Uncal Red" 11 "Replace" 12 "Disabled" 13 "Shorted" 14 "Open" 15 "Over Range" 16 "Under Range" 17 "Undefined" 18 "Error!" 19 "Low Error" 20 "High Error" 21 "Non Critical No LED" 27 "Critical Green LED" 32 "Stall!" 33 "Synchronized" 34 "Syncing" 35 "Error!" 36 "Error!" 37 "Uncalibrated" 38 "Open Loop" 39 "Closed Loop" 40 "Not Learn" 41 "Learning" 42 "Off" 43 "On" 44 "Not Rev Limiting" 45 "Rev Limit" 46 "No Cut Off" 47 "CutOff!" 48 "Off" 49 "Warning!" 50 "Caution!" 51 "No Timing modifier" 52 "Timing is being modified" 53 "Timing Value is being replaced" 54 "Acq Sat" 55 "No GPS" 56 "No Data" 22 "Non Critical Green LED" 23 "Non Critical Yellow LED" 24 "Non Critical Red LED" 25 "Non Critical Blue LED" 26 "Non Critical Grey LED" 28 "Critical Yellow LED" 29 "Critical Red LED" 30 "Critical Blue LED" 31 "Critical Grey LED";
VAL_ 2654441472 Status 0 "OK" 1 "Disabled" 2 "Initializing" 3 "Heating" 4 "WB_Active" 5 "Too Cold" 6 "Too Hot" 7 "Unplugged" 8 "Slow!" 9 "Uncal Yellow" 10 "Uncal Red" 11 "Replace" 12 "Disabled" 13 "Shorted" 14 "Open" 15 "Over Range" 16 "Under Range" 17 "Undefined" 18 "Error!" 19 "Low Error" 20 "High Error" 21 "Non Critical No LED" 27 "Critical Green LED" 32 "Stall!" 33 "Synchronized" 34 "Syncing" 35 "Error!" 36 "Error!" 37 "Uncalibrated" 38 "Open Loop" 39 "Closed Loop" 40 "Not Learn" 41 "Learning" 42 "Off" 43 "On" 44 "Not Rev Limiting" 45 "Rev Limit" 46 "No Cut Off" 47 "CutOff!" 48 "Off" 49 "Warning!" 50 "Caution!" 51 "No Timing modifier" 52 "Timing is being modified" 53 "Timing Value is being replaced" 54 "Acq Sat" 55 "No GPS" 56 "No Data" 22 "Non Critical Green LED" 23 "Non Critical Yellow LED" 24 "Non Critical Red LED" 25 "Non Critical Blue LED" 26 "Non Critical Grey LED" 28 "Critical Yellow LED" 29 "Critical Red LED" 30 "Critical Blue LED" 31 "Critical Grey LED";
VAL_ 2654457856 Status 0 "OK" 1 "Disabled" 2 "Initializing" 3 "Heating" 4 "WB_Active" 5 "Too Cold" 6 "Too Hot" 7 "Unplugged" 8 "Slow!" 9 "Uncal Yellow" 10 "Uncal Red" 11 "Replace" 12 "Disabled" 13 "Shorted" 14 "Open" 15 "Over Range" 16 "Under Range" 17 "Undefined" 18 "Error!" 19 "Low Error" 20 "High Error" 21 "Non Critical No LED" 27 "Critical Green LED" 32 "Stall!" 33 "Synchronized" 34 "Syncing" 35 "Error!" 36 "Error!" 37 "Uncalibrated" 38 "Open Loop" 39 "Closed Loop" 40 "Not Learn" 41 "Learning" 42 "Off" 43 "On" 44 "Not Rev Limiting" 45 "Rev Limit" 46 "No Cut Off" 47 "CutOff!" 48 "Off" 49 "Warning!" 50 "Caution!" 51 "No Timing modifier" 52 "Timing is being modified" 53 "Timing Value is being replaced" 54 "Acq Sat" 55 "No GPS" 56 "No Data" 22 "Non Critical Green LED" 23 "Non Critical Yellow LED" 24 "Non Critical Red LED" 25 "Non Critical Blue LED" 26 "Non Critical Grey LED" 28 "Critical Yellow LED" 29 "Critical Red LED" 30 "Critical Blue LED" 31 "Critical Grey LED";
VAL_ 2654474240 Status 0 "OK" 1 "Disabled" 2 "Initializing" 3 "Heating" 4 "WB_Active" 5 "Too Cold" 6 "Too Hot" 7 "Unplugged" 8 "Slow!" 9 "Uncal Yellow" 10 "Uncal Red" 11 "Replace" 12 "Disabled" 13 "Shorted" 14 "Open" 15 "Over Range" 16 "Under Range" 17 "Undefined" 18 "Error!" 19 "Low Error" 20 "High Error" 21 "Non Critical No LED" 27 "Critical Green LED" 32 "Stall!" 33 "Synchronized" 34 "Syncing" 35 "Error!" 36 "Error!" 37 "Uncalibrated" 38 "Open Loop" 39 "Closed Loop" 40 "Not Learn" 41 "Learning" 42 "Off" 43 "On" 44 "Not Rev Limiting" 45 "Rev Limit" 46 "No Cut Off" 47 "CutOff!" 48 "Off" 49 "Warning!" 50 "Caution!" 51 "No Timing modifier" 52 "Timing is being modified" 53 "Timing Value is being replaced" 54 "Acq Sat" 55 "No GPS" 56 "No Data" 22 "Non Critical Green LED" 23 "Non Critical Yellow LED" 24 "Non Critical Red LED" 25 "Non Critical Blue LED" 26 "Non Critical Grey LED" 28 "Critical Yellow LED" 29 "Critical Red LED" 30 "Critical Blue LED" 31 "Critical Grey LED";
VAL_ 2654490624 Status 0 "OK" 1 "Disabled" 2 "Initializing" 3 "Heating" 4 "WB_Active" 5 "Too Cold" 6 "Too Hot" 7 "Unplugged" 8 "Slow!" 9 "Uncal Yellow" 10 "Uncal Red" 11 "Replace" 12 "Disabled" 13 "Shorted" 14 "Open" 15 "Over Range" 16 "Under Range" 17 "Undefined" 18 "Error!" 19 "Low Error" 20 "High Error" 21 "Non Critical No LED" 27 "Critical Green LED" 32 "Stall!" 33 "Synchronized" 34 "Syncing" 35 "Error!" 36 "Error!" 37 "Uncalibrated" 38 "Open Loop" 39 "Closed Loop" 40 "Not Learn" 41 "Learning" 42 "Off" 43 "On" 44 "Not Rev Limiting" 45 "Rev Limit" 46 "No Cut Off" 47 "CutOff!" 48 "Off" 49 "Warning!" 50 "Caution!" 51 "No Timing modifier" 52 "Timing is being modified" 53 "Timing Value is being replaced" 54 "Acq Sat" 55 "No GPS" 56 "No Data" 22 "Non Critical Green LED" 23 "Non Critical Yellow LED" 24 "Non Critical Red LED" 25 "Non Critical Blue LED" 26 "Non Critical Grey LED" 28 "Critical Yellow LED" 29 "Critical Red LED" 30 "Critical Blue LED" 31 "Critical Grey LED";
VAL_ 2654507008 Status 0 "OK" 1 "Disabled" 2 "Initializing" 3 "Heating" 4 "WB_Active" 5 "Too Cold" 6 "Too Hot" 7 "Unplugged" 8 "Slow!" 9 "Uncal Yellow" 10 "Uncal Red" 11 "Replace" 12 "Disabled" 13 "Shorted" 14 "Open" 15 "Over Range" 16 "Under Range" 17 "Undefined" 18 "Error!" 19 "Low Error" 20 "High Error" 21 "Non Critical No LED" 27 "Critical Green LED" 32 "Stall!" 33 "Synchronized" 34 "Syncing" 35 "Error!" 36 "Error!" 37 "Uncalibrated" 38 "Open Loop" 39 "Closed Loop" 40 "Not Learn" 41 "Learning" 42 "Off" 43 "On" 44 "Not Rev Limiting" 45 "Rev Limit" 46 "No Cut Off" 47 "CutOff!" 48 "Off" 49 "Warning!" 50 "Caution!" 51 "No Timing modifier" 52 "Timing is being modified" 53 "Timing Value is being replaced" 54 "Acq Sat" 55 "No GPS" 56 "No Data" 22 "Non Critical Green LED" 23 "Non Critical Yellow LED" 24 "Non Critical Red LED" 25 "Non Critical Blue LED" 26 "Non Critical Grey LED" 28 "Critical Yellow LED" 29 "Critical Red LED" 30 "Critical Blue LED" 31 "Critical Grey LED";
VAL_ 2654523392 Status 0 "OK" 1 "Disabled" 2 "Initializing" 3 "Heating" 4 "WB_Active" 5 "Too Cold" 6 "Too Hot" 7 "Unplugged" 8 "Slow!" 9 "Uncal Yellow" 10 "Uncal Red" 11 "Replace" 12 "Disabled" 13 "Shorted" 14 "Open" 15 "Over Range" 16 "Under Range" 17 "Undefined" 18 "Error!" 19 "Low Error" 20 "High Error" 21 "Non Critical No LED" 27 "Critical Green LED" 32 "Stall!" 33 "Synchronized" 34 "Syncing" 35 "Error!" 36 "Error!" 37 "Uncalibrated" 38 "Open Loop" 39 "Closed Loop" 40 "Not Learn" 41 "Learning" 42 "Off" 43 "On" 44 "Not Rev Limiting" 45 "Rev Limit" 46 "No Cut Off" 47 "CutOff!" 48 "Off" 49 "Warning!" 50 "Caution!" 51 "No Timing modifier" 52 "Timing is being modified" 53 "Timing Value is being replaced" 54 "Acq Sat" 55 "No GPS" 56 "No Data" 22 "Non Critical Green LED" 23 "Non Critical Yellow LED" 24 "Non Critical Red LED" 25 "Non Critical Blue LED" 26 "Non Critical Grey LED" 28 "Critical Yellow LED" 29 "Critical Red LED" 30 "Critical Blue LED" 31 "Critical Grey LED";
VAL_ 2654539776 Status 0 "OK" 1 "Disabled" 2 "Initializing" 3 "Heating" 4 "WB_Active" 5 "Too Cold" 6 "Too Hot" 7 "Unplugged" 8 "Slow!" 9 "Uncal Yellow" 10 "Uncal Red" 11 "Replace" 12 "Disabled" 13 "Shorted" 14 "Open" 15 "Over Range" 16 "Under Range" 17 "Undefined" 18 "Error!" 19 "Low Error" 20 "High Error" 21 "Non Critical No LED" 27 "Critical Green LED" 32 "Stall!" 33 "Synchronized" 34 "Syncing" 35 "Error!" 36 "Error!" 37 "Uncalibrated" 38 "Open Loop" 39 "Closed Loop" 40 "Not Learn" 41 "Learning" 42 "Off" 43 "On" 44 "Not Rev Limiting" 45 "Rev Limit" 46 "No Cut Off" 47 "CutOff!" 48 "Off" 49 "Warning!" 50 "Caution!" 51 "No Timing modifier" 52 "Timing is being modified" 53 "Timing Value is being replaced" 54 "Acq Sat" 55 "No GPS" 56 "No Data" 22 "Non Critical Green LED" 23 "Non Critical Yellow LED" 24 "Non Critical Red LED" 25 "Non Critical Blue LED" 26 "Non Critical Grey LED" 28 "Critical Yellow LED" 29 "Critical Red LED" 30 "Critical Blue LED" 31 "Critical Grey LED";
VAL_ 2654556160 Status 0 "OK" 1 "Disabled" 2 "Initializing" 3 "Heating" 4 "WB_Active" 5 "Too Cold" 6 "Too Hot" 7 "Unplugged" 8 "Slow!" 9 "Uncal Yellow" 10 "Uncal Red" 11 "Replace" 12 "Disabled" 13 "Shorted" 14 "Open" 15 "Over Range" 16 "Under Range" 17 "Undefined" 18 "Error!" 19 "Low Error" 20 "High Error" 21 "Non Critical No LED" 27 "Critical Green LED" 32 "Stall!" 33 "Synchronized" 34 "Syncing" 35 "Error!" 36 "Error!" 37 "Uncalibrated" 38 "Open Loop" 39 "Closed Loop" 40 "Not Learn" 41 "Learning" 42 "Off" 43 "On" 44 "Not Rev Limiting" 45 "Rev Limit" 46 "No Cut Off" 47 "CutOff!" 48 "Off" 49 "Warning!" 50 "Caution!" 51 "No Timing modifier" 52 "Timing is being modified" 53 "Timing Value is being replaced" 54 "Acq Sat" 55 "No GPS" 56 "No Data" 22 "Non Critical Green LED" 23 "Non Critical Yellow LED" 24 "Non Critical Red LED" 25 "Non Critical Blue LED" 26 "Non Critical Grey LED" 28 "Critical Yellow LED" 29 "Critical Red LED" 30 "Critical Blue LED" 31 "Critical Grey LED";
VAL_ 2654572544 Status 0 "OK" 1 "Disabled" 2 "Initializing" 3 "Heating" 4 "WB_Active" 5 "Too Cold" 6 "Too Hot" 7 "Unplugged" 8 "Slow!" 9 "Uncal Yellow" 10 "Uncal Red" 11 "Replace" 12 "Disabled" 13 "Shorted" 14 "Open" 15 "Over Range" 16 "Under Range" 17 "Undefined" 18 "Error!" 19 "Low Error" 20 "High Error" 21 "Non Critical No LED" 27 "Critical Green LED" 32 "Stall!" 33 "Synchronized" 34 "Syncing" 35 "Error!" 36 "Error!" 37 "Uncalibrated" 38 "Open Loop" 39 "Closed Loop" 40 "Not Learn" 41 "Learning" 42 "Off" 43 "On" 44 "Not Rev Limiting" 45 "Rev Limit" 46 "No Cut Off" 47 "CutOff!" 48 "Off" 49 "Warning!" 50 "Caution!" 51 "No Timing modifier" 52 "Timing is being modified" 53 "Timing Value is being replaced" 54 "Acq Sat" 55 "No GPS" 56 "No Data" 22 "Non Critical Green LED" 23 "Non Critical Yellow LED" 24 "Non Critical Red LED" 25 "Non Critical Blue LED" 26 "Non Critical Grey LED" 28 "Critical Yellow LED" 29 "Critical Red LED" 30 "Critical Blue LED" 31 "Critical Grey LED";
VAL_ 2654605312 Status 0 "OK" 1 "Disabled" 2 "Initializing" 3 "Heating" 4 "WB_Active" 5 "Too Cold" 6 "Too Hot" 7 "Unplugged" 8 "Slow!" 9 "Uncal Yellow" 10 "Uncal Red" 11 "Replace" 12 "Disabled" 13 "Shorted" 14 "Open" 15 "Over Range" 16 "Under Range" 17 "Undefined" 18 "Error!" 19 "Low Error" 20 "High Error" 21 "Non Critical No LED" 27 "Critical Green LED" 32 "Stall!" 33 "Synchronized" 34 "Syncing" 35 "Error!" 36 "Error!" 37 "Uncalibrated" 38 "Open Loop" 39 "Closed Loop" 40 "Not Learn" 41 "Learning" 42 "Off" 43 "On" 44 "Not Rev Limiting" 45 "Rev Limit" 46 "No Cut Off" 47 "CutOff!" 48 "Off" 49 "Warning!" 50 "Caution!" 51 "No Timing modifier" 52 "Timing is being modified" 53 "Timing Value is being replaced" 54 "Acq Sat" 55 "No GPS" 56 "No Data" 22 "Non Critical Green LED" 23 "Non Critical Yellow LED" 24 "Non Critical Red LED" 25 "Non Critical Blue LED" 26 "Non Critical Grey LED" 28 "Critical Yellow LED" 29 "Critical Red LED" 30 "Critical Blue LED" 31 "Critical Grey LED";
VAL_ 2654621696 Status 0 "OK" 1 "Disabled" 2 "Initializing" 3 "Heating" 4 "WB_Active" 5 "Too Cold" 6 "Too Hot" 7 "Unplugged" 8 "Slow!" 9 "Uncal Yellow" 10 "Uncal Red" 11 "Replace" 12 "Disabled" 13 "Shorted" 14 "Open" 15 "Over Range" 16 "Under Range" 17 "Undefined" 18 "Error!" 19 "Low Error" 20 "High Error" 21 "Non Critical No LED" 27 "Critical Green LED" 32 "Stall!" 33 "Synchronized" 34 "Syncing" 35 "Error!" 36 "Error!" 37 "Uncalibrated" 38 "Open Loop" 39 "Closed Loop" 40 "Not Learn" 41 "Learning" 42 "Off" 43 "On" 44 "Not Rev Limiting" 45 "Rev Limit" 46 "No Cut Off" 47 "CutOff!" 48 "Off" 49 "Warning!" 50 "Caution!" 51 "No Timing modifier" 52 "Timing is being modified" 53 "Timing Value is being replaced" 54 "Acq Sat" 55 "No GPS" 56 "No Data" 22 "Non Critical Green LED" 23 "Non Critical Yellow LED" 24 "Non Critical Red LED" 25 "Non Critical Blue LED" 26 "Non Critical Grey LED" 28 "Critical Yellow LED" 29 "Critical Red LED" 30 "Critical Blue LED" 31 "Critical Grey LED";
VAL_ 2654638080 Status 0 "OK" 1 "Disabled" 2 "Initializing" 3 "Heating" 4 "WB_Active" 5 "Too Cold" 6 "Too Hot" 7 "Unplugged" 8 "Slow!" 9 "Uncal Yellow" 10 "Uncal Red" 11 "Replace" 12 "Disabled" 13 "Shorted" 14 "Open" 15 "Over Range" 16 "Under Range" 17 "Undefined" 18 "Error!" 19 "Low Error" 20 "High Error" 21 "Non Critical No LED" 27 "Critical Green LED" 32 "Stall!" 33 "Synchronized" 34 "Syncing" 35 "Error!" 36 "Error!" 37 "Uncalibrated" 38 "Open Loop" 39 "Closed Loop" 40 "Not Learn" 41 "Learning" 42 "Off" 43 "On" 44 "Not Rev Limiting" 45 "Rev Limit" 46 "No Cut Off" 47 "CutOff!" 48 "Off" 49 "Warning!" 50 "Caution!" 51 "No Timing modifier" 52 "Timing is being modified" 53 "Timing Value is being replaced" 54 "Acq Sat" 55 "No GPS" 56 "No Data" 22 "Non Critical Green LED" 23 "Non Critical Yellow LED" 24 "Non Critical Red LED" 25 "Non Critical Blue LED" 26 "Non Critical Grey LED" 28 "Critical Yellow LED" 29 "Critical Red LED" 30 "Critical Blue LED" 31 "Critical Grey LED";
VAL_ 2654654464 Status 0 "OK" 1 "Disabled" 2 "Initializing" 3 "Heating" 4 "WB_Active" 5 "Too Cold" 6 "Too Hot" 7 "Unplugged" 8 "Slow!" 9 "Uncal Yellow" 10 "Uncal Red" 11 "Replace" 12 "Disabled" 13 "Shorted" 14 "Open" 15 "Over Range" 16 "Under Range" 17 "Undefined" 18 "Error!" 19 "Low Error" 20 "High Error" 21 "Non Critical No LED" 27 "Critical Green LED" 32 "Stall!" 33 "Synchronized" 34 "Syncing" 35 "Error!" 36 "Error!" 37 "Uncalibrated" 38 "Open Loop" 39 "Closed Loop" 40 "Not Learn" 41 "Learning" 42 "Off" 43 "On" 44 "Not Rev Limiting" 45 "Rev Limit" 46 "No Cut Off" 47 "CutOff!" 48 "Off" 49 "Warning!" 50 "Caution!" 51 "No Timing modifier" 52 "Timing is being modified" 53 "Timing Value is being replaced" 54 "Acq Sat" 55 "No GPS" 56 "No Data" 22 "Non Critical Green LED" 23 "Non Critical Yellow LED" 24 "Non Critical Red LED" 25 "Non Critical Blue LED" 26 "Non Critical Grey LED" 28 "Critical Yellow LED" 29 "Critical Red LED" 30 "Critical Blue LED" 31 "Critical Grey LED";
VAL_ 2654670848 Status 0 "OK" 1 "Disabled" 2 "Initializing" 3 "Heating" 4 "WB_Active" 5 "Too Cold" 6 "Too Hot" 7 "Unplugged" 8 "Slow!" 9 "Uncal Yellow" 10 "Uncal Red" 11 "Replace" 12 "Disabled" 13 "Shorted" 14 "Open" 15 "Over Range" 16 "Under Range" 17 "Undefined" 18 "Error!" 19 "Low Error" 20 "High Error" 21 "Non Critical No LED" 27 "Critical Green LED" 32 "Stall!" 33 "Synchronized" 34 "Syncing" 35 "Error!" 36 "Error!" 37 "Uncalibrated" 38 "Open Loop" 39 "Closed Loop" 40 "Not Learn" 41 "Learning" 42 "Off" 43 "On" 44 "Not Rev Limiting" 45 "Rev Limit" 46 "No Cut Off" 47 "CutOff!" 48 "Off" 49 "Warning!" 50 "Caution!" 51 "No Timing modifier" 52 "Timing is being modified" 53 "Timing Value is being replaced" 54 "Acq Sat" 55 "No GPS" 56 "No Data" 22 "Non Critical Green LED" 23 "Non Critical Yellow LED" 24 "Non Critical Red LED" 25 "Non Critical Blue LED" 26 "Non Critical Grey LED" 28 "Critical Yellow LED" 29 "Critical Red LED" 30 "Critical Blue LED" 31 "Critical Grey LED";
VAL_ 2654687232 Status 0 "OK" 1 "Disabled" 2 "Initializing" 3 "Heating" 4 "WB_Active" 5 "Too Cold" 6 "Too Hot" 7 "Unplugged" 8 "Slow!" 9 "Uncal Yellow" 10 "Uncal Red" 11 "Replace" 12 "Disabled" 13 "Shorted" 14 "Open" 15 "Over Range" 16 "Under Range" 17 "Undefined" 18 "Error!" 19 "Low Error" 20 "High Error" 21 "Non Critical No LED" 27 "Critical Green LED" 32 "Stall!" 33 "Synchronized" 34 "Syncing" 35 "Error!" 36 "Error!" 37 "Uncalibrated" 38 "Open Loop" 39 "Closed Loop" 40 "Not Learn" 41 "Learning" 42 "Off" 43 "On" 44 "Not Rev Limiting" 45 "Rev Limit" 46 "No Cut Off" 47 "CutOff!" 48 "Off" 49 "Warning!" 50 "Caution!" 51 "No Timing modifier" 52 "Timing is being modified" 53 "Timing Value is being replaced" 54 "Acq Sat" 55 "No GPS" 56 "No Data" 22 "Non Critical Green LED" 23 "Non Critical Yellow LED" 24 "Non Critical Red LED" 25 "Non Critical Blue LED" 26 "Non Critical Grey LED" 28 "Critical Yellow LED" 29 "Critical Red LED" 30 "Critical Blue LED" 31 "Critical Grey LED";
VAL_ 2654703616 Status 0 "OK" 1 "Disabled" 2 "Initializing" 3 "Heating" 4 "WB_Active" 5 "Too Cold" 6 "Too Hot" 7 "Unplugged" 8 "Slow!" 9 "Uncal Yellow" 10 "Uncal Red" 11 "Replace" 12 "Disabled" 13 "Shorted" 14 "Open" 15 "Over Range" 16 "Under Range" 17 "Undefined" 18 "Error!" 19 "Low Error" 20 "High Error" 21 "Non Critical No LED" 27 "Critical Green LED" 32 "Stall!" 33 "Synchronized" 34 "Syncing" 35 "Error!" 36 "Error!" 37 "Uncalibrated" 38 "Open Loop" 39 "Closed Loop" 40 "Not Learn" 41 "Learning" 42 "Off" 43 "On" 44 "Not Rev Limiting" 45 "Rev Limit" 46 "No Cut Off" 47 "CutOff!" 48 "Off" 49 "Warning!" 50 "Caution!" 51 "No Timing modifier" 52 "Timing is being modified" 53 "Timing Value is being replaced" 54 "Acq Sat" 55 "No GPS" 56 "No Data" 22 "Non Critical Green LED" 23 "Non Critical Yellow LED" 24 "Non Critical Red LED" 25 "Non Critical Blue LED" 26 "Non Critical Grey LED" 28 "Critical Yellow LED" 29 "Critical Red LED" 30 "Critical Blue LED" 31 "Critical Grey LED";
VAL_ 2654720000 Status 0 "OK" 1 "Disabled" 2 "Initializing" 3 "Heating" 4 "WB_Active" 5 "Too Cold" 6 "Too Hot" 7 "Unplugged" 8 "Slow!" 9 "Uncal Yellow" 10 "Uncal Red" 11 "Replace" 12 "Disabled" 13 "Shorted" 14 "Open" 15 "Over Range" 16 "Under Range" 17 "Undefined" 18 "Error!" 19 "Low Error" 20 "High Error" 21 "Non Critical No LED" 27 "Critical Green LED" 32 "Stall!" 33 "Synchronized" 34 "Syncing" 35 "Error!" 36 "Error!" 37 "Uncalibrated" 38 "Open Loop" 39 "Closed Loop" 40 "Not Learn" 41 "Learning" 42 "Off" 43 "On" 44 "Not Rev Limiting" 45 "Rev Limit" 46 "No Cut Off" 47 "CutOff!" 48 "Off" 49 "Warning!" 50 "Caution!" 51 "No Timing modifier" 52 "Timing is being modified" 53 "Timing Value is being replaced" 54 "Acq Sat" 55 "No GPS" 56 "No Data" 22 "Non Critical Green LED" 23 "Non Critical Yellow LED" 24 "Non Critical Red LED" 25 "Non Critical Blue LED" 26 "Non Critical Grey LED" 28 "Critical Yellow LED" 29 "Critical Red LED" 30 "Critical Blue LED" 31 "Critical Grey LED";
VAL_ 2654736384 Status 0 "OK" 1 "Disabled" 2 "Initializing" 3 "Heating" 4 "WB_Active" 5 "Too Cold" 6 "Too Hot" 7 "Unplugged" 8 "Slow!" 9 "Uncal Yellow" 10 "Uncal Red" 11 "Replace" 12 "Disabled" 13 "Shorted" 14 "Open" 15 "Over Range" 16 "Under Range" 17 "Undefined" 18 "Error!" 19 "Low Error" 20 "High Error" 21 "Non Critical No LED" 27 "Critical Green LED" 32 "Stall!" 33 "Synchronized" 34 "Syncing" 35 "Error!" 36 "Error!" 37 "Uncalibrated" 38 "Open Loop" 39 "Closed Loop" 40 "Not Learn" 41 "Learning" 42 "Off" 43 "On" 44 "Not Rev Limiting" 45 "Rev Limit" 46 "No Cut Off" 47 "CutOff!" 48 "Off" 49 "Warning!" 50 "Caution!" 51 "No Timing modifier" 52 "Timing is being modified" 53 "Timing Value is being replaced" 54 "Acq Sat" 55 "No GPS" 56 "No Data" 22 "Non Critical Green LED" 23 "Non Critical Yellow LED" 24 "Non Critical Red LED" 25 "Non Critical Blue LED" 26 "Non Critical Grey LED" 28 "Critical Yellow LED" 29 "Critical Red LED" 30 "Critical Blue LED" 31 "Critical Grey LED";
VAL_ 2654769152 Status 0 "OK" 1 "Disabled" 2 "Initializing" 3 "Heating" 4 "WB_Active" 5 "Too Cold" 6 "Too Hot" 7 "Unplugged" 8 "Slow!" 9 "Uncal Yellow" 10 "Uncal Red" 11 "Replace" 12 "Disabled" 13 "Shorted" 14 "Open" 15 "Over Range" 16 "Under Range" 17 "Undefined" 18 "Error!" 19 "Low Error" 20 "High Error" 21 "Non Critical No LED" 27 "Critical Green LED" 32 "Stall!" 33 "Synchronized" 34 "Syncing" 35 "Error!" 36 "Error!" 37 "Uncalibrated" 38 "Open Loop" 39 "Closed Loop" 40 "Not Learn" 41 "Learning" 42 "Off" 43 "On" 44 "Not Rev Limiting" 45 "Rev Limit" 46 "No Cut Off" 47 "CutOff!" 48 "Off" 49 "Warning!" 50 "Caution!" 51 "No Timing modifier" 52 "Timing is being modified" 53 "Timing Value is being replaced" 54 "Acq Sat" 55 "No GPS" 56 "No Data" 22 "Non Critical Green LED" 23 "Non Critical Yellow LED" 24 "Non Critical Red LED" 25 "Non Critical Blue LED" 26 "Non Critical Grey LED" 28 "Critical Yellow LED" 29 "Critical Red LED" 30 "Critical Blue LED" 31 "Critical Grey LED";
VAL_ 2654785536 Status 0 "OK" 1 "Disabled" 2 "Initializing" 3 "Heating" 4 "WB_Active" 5 "Too Cold" 6 "Too Hot" 7 "Unplugged" 8 "Slow!" 9 "Uncal Yellow" 10 "Uncal Red" 11 "Replace" 12 "Disabled" 13 "Shorted" 14 "Open" 15 "Over Range" 16 "Under Range" 17 "Undefined" 18 "Error!" 19 "Low Error" 20 "High Error" 21 "Non Critical No LED" 27 "Critical Green LED" 32 "Stall!" 33 "Synchronized" 34 "Syncing" 35 "Error!" 36 "Error!" 37 "Uncalibrated" 38 "Open Loop" 39 "Closed Loop" 40 "Not Learn" 41 "Learning" 42 "Off" 43 "On" 44 "Not Rev Limiting" 45 "Rev Limit" 46 "No Cut Off" 47 "CutOff!" 48 "Off" 49 "Warning!" 50 "Caution!" 51 "No Timing modifier" 52 "Timing is being modified" 53 "Timing Value is being replaced" 54 "Acq Sat" 55 "No GPS" 56 "No Data" 22 "Non Critical Green LED" 23 "Non Critical Yellow LED" 24 "Non Critical Red LED" 25 "Non Critical Blue LED" 26 "Non Critical Grey LED" 28 "Critical Yellow LED" 29 "Critical Red LED" 30 "Critical Blue LED" 31 "Critical Grey LED";
VAL_ 2654801920 Status 0 "OK" 1 "Disabled" 2 "Initializing" 3 "Heating" 4 "WB_Active" 5 "Too Cold" 6 "Too Hot" 7 "Unplugged" 8 "Slow!" 9 "Uncal Yellow" 10 "Uncal Red" 11 "Replace" 12 "Disabled" 13 "Shorted" 14 "Open" 15 "Over Range" 16 "Under Range" 17 "Undefined" 18 "Error!" 19 "Low Error" 20 "High Error" 21 "Non Critical No LED" 27 "Critical Green LED" 32 "Stall!" 33 "Synchronized" 34 "Syncing" 35 "Error!" 36 "Error!" 37 "Uncalibrated" 38 "Open Loop" 39 "Closed Loop" 40 "Not Learn" 41 "Learning" 42 "Off" 43 "On" 44 "Not Rev Limiting" 45 "Rev Limit" 46 "No Cut Off" 47 "CutOff!" 48 "Off" 49 "Warning!" 50 "Caution!" 51 "No Timing modifier" 52 "Timing is being modified" 53 "Timing Value is being replaced" 54 "Acq Sat" 55 "No GPS" 56 "No Data" 22 "Non Critical Green LED" 23 "Non Critical Yellow LED" 24 "Non Critical Red LED" 25 "Non Critical Blue LED" 26 "Non Critical Grey LED" 28 "Critical Yellow LED" 29 "Critical Red LED" 30 "Critical Blue LED" 31 "Critical Grey LED";
VAL_ 2654818304 Status 0 "OK" 1 "Disabled" 2 "Initializing" 3 "Heating" 4 "WB_Active" 5 "Too Cold" 6 "Too Hot" 7 "Unplugged" 8 "Slow!" 9 "Uncal Yellow" 10 "Uncal Red" 11 "Replace" 12 "Disabled" 13 "Shorted" 14 "Open" 15 "Over Range" 16 "Under Range" 17 "Undefined" 18 "Error!" 19 "Low Error" 20 "High Error" 21 "Non Critical No LED" 27 "Critical Green LED" 32 "Stall!" 33 "Synchronized" 34 "Syncing" 35 "Error!" 36 "Error!" 37 "Uncalibrated" 38 "Open Loop" 39 "Closed Loop" 40 "Not Learn" 41 "Learning" 42 "Off" 43 "On" 44 "Not Rev Limiting" 45 "Rev Limit" 46 "No Cut Off" 47 "CutOff!" 48 "Off" 49 "Warning!" 50 "Caution!" 51 "No Timing modifier" 52 "Timing is being modified" 53 "Timing Value is being replaced" 54 "Acq Sat" 55 "No GPS" 56 "No Data" 22 "Non Critical Green LED" 23 "Non Critical Yellow LED" 24 "Non Critical Red LED" 25 "Non Critical Blue LED" 26 "Non Critical Grey LED" 28 "Critical Yellow LED" 29 "Critical Red LED" 30 "Critical Blue LED" 31 "Critical Grey LED";
VAL_ 2654834688 Status 0 "OK" 1 "Disabled" 2 "Initializing" 3 "Heating" 4 "WB_Active" 5 "Too Cold" 6 "Too Hot" 7 "Unplugged" 8 "Slow!" 9 "Uncal Yellow" 10 "Uncal Red" 11 "Replace" 12 "Disabled" 13 "Shorted" 14 "Open" 15 "Over Range" 16 "Under Range" 17 "Undefined" 18 "Error!" 19 "Low Error" 20 "High Error" 21 "Non Critical No LED" 27 "Critical Green LED" 32 "Stall!" 33 "Synchronized" 34 "Syncing" 35 "Error!" 36 "Error!" 37 "Uncalibrated" 38 "Open Loop" 39 "Closed Loop" 40 "Not Learn" 41 "Learning" 42 "Off" 43 "On" 44 "Not Rev Limiting" 45 "Rev Limit" 46 "No Cut Off" 47 "CutOff!" 48 "Off" 49 "Warning!" 50 "Caution!" 51 "No Timing modifier" 52 "Timing is being modified" 53 "Timing Value is being replaced" 54 "Acq Sat" 55 "No GPS" 56 "No Data" 22 "Non Critical Green LED" 23 "Non Critical Yellow LED" 24 "Non Critical Red LED" 25 "Non Critical Blue LED" 26 "Non Critical Grey LED" 28 "Critical Yellow LED" 29 "Critical Red LED" 30 "Critical Blue LED" 31 "Critical Grey LED";
VAL_ 2654851072 Status 0 "OK" 1 "Disabled" 2 "Initializing" 3 "Heating" 4 "WB_Active" 5 "Too Cold" 6 "Too Hot" 7 "Unplugged" 8 "Slow!" 9 "Uncal Yellow" 10 "Uncal Red" 11 "Replace" 12 "Disabled" 13 "Shorted" 14 "Open" 15 "Over Range" 16 "Under Range" 17 "Undefined" 18 "Error!" 19 "Low Error" 20 "High Error" 21 "Non Critical No LED" 27 "Critical Green LED" 32 "Stall!" 33 "Synchronized" 34 "Syncing" 35 "Error!" 36 "Error!" 37 "Uncalibrated" 38 "Open Loop" 39 "Closed Loop" 40 "Not Learn" 41 "Learning" 42 "Off" 43 "On" 44 "Not Rev Limiting" 45 "Rev Limit" 46 "No Cut Off" 47 "CutOff!" 48 "Off" 49 "Warning!" 50 "Caution!" 51 "No Timing modifier" 52 "Timing is being modified" 53 "Timing Value is being replaced" 54 "Acq Sat" 55 "No GPS" 56 "No Data" 22 "Non Critical Green LED" 23 "Non Critical Yellow LED" 24 "Non Critical Red LED" 25 "Non Critical Blue LED" 26 "Non Critical Grey LED" 28 "Critical Yellow LED" 29 "Critical Red LED" 30 "Critical Blue LED" 31 "Critical Grey LED";
VAL_ 2654867456 Status 0 "OK" 1 "Disabled" 2 "Initializing" 3 "Heating" 4 "WB_Active" 5 "Too Cold" 6 "Too Hot" 7 "Unplugged" 8 "Slow!" 9 "Uncal Yellow" 10 "Uncal Red" 11 "Replace" 12 "Disabled" 13 "Shorted" 14 "Open" 15 "Over Range" 16 "Under Range" 17 "Undefined" 18 "Error!" 19 "Low Error" 20 "High Error" 21 "Non Critical No LED" 27 "Critical Green LED" 32 "Stall!" 33 "Synchronized" 34 "Syncing" 35 "Error!" 36 "Error!" 37 "Uncalibrated" 38 "Open Loop" 39 "Closed Loop" 40 "Not Learn" 41 "Learning" 42 "Off" 43 "On" 44 "Not Rev Limiting" 45 "Rev Limit" 46 "No Cut Off" 47 "CutOff!" 48 "Off" 49 "Warning!" 50 "Caution!" 51 "No Timing modifier" 52 "Timing is being modified" 53 "Timing Value is being replaced" 54 "Acq Sat" 55 "No GPS" 56 "No Data" 22 "Non Critical Green LED" 23 "Non Critical Yellow LED" 24 "Non Critical Red LED" 25 "Non Critical Blue LED" 26 "Non Critical Grey LED" 28 "Critical Yellow LED" 29 "Critical Red LED" 30 "Critical Blue LED" 31 "Critical Grey LED";
VAL_ 2654883840 Status 0 "OK" 1 "Disabled" 2 "Initializing" 3 "Heating" 4 "WB_Active" 5 "Too Cold" 6 "Too Hot" 7 "Unplugged" 8 "Slow!" 9 "Uncal Yellow" 10 "Uncal Red" 11 "Replace" 12 "Disabled" 13 "Shorted" 14 "Open" 15 "Over Range" 16 "Under Range" 17 "Undefined" 18 "Error!" 19 "Low Error" 20 "High Error" 21 "Non Critical No LED" 27 "Critical Green LED" 32 "Stall!" 33 "Synchronized" 34 "Syncing" 35 "Error!" 36 "Error!" 37 "Uncalibrated" 38 "Open Loop" 39 "Closed Loop" 40 "Not Learn" 41 "Learning" 42 "Off" 43 "On" 44 "Not Rev Limiting" 45 "Rev Limit" 46 "No Cut Off" 47 "CutOff!" 48 "Off" 49 "Warning!" 50 "Caution!" 51 "No Timing modifier" 52 "Timing is being modified" 53 "Timing Value is being replaced" 54 "Acq Sat" 55 "No GPS" 56 "No Data" 22 "Non Critical Green LED" 23 "Non Critical Yellow LED" 24 "Non Critical Red LED" 25 "Non Critical Blue LED" 26 "Non Critical Grey LED" 28 "Critical Yellow LED" 29 "Critical Red LED" 30 "Critical Blue LED" 31 "Critical Grey LED";
VAL_ 2654900224 Status 0 "OK" 1 "Disabled" 2 "Initializing" 3 "Heating" 4 "WB_Active" 5 "Too Cold" 6 "Too Hot" 7 "Unplugged" 8 "Slow!" 9 "Uncal Yellow" 10 "Uncal Red" 11 "Replace" 12 "Disabled" 13 "Shorted" 14 "Open" 15 "Over Range" 16 "Under Range" 17 "Undefined" 18 "Error!" 19 "Low Error" 20 "High Error" 21 "Non Critical No LED" 27 "Critical Green LED" 32 "Stall!" 33 "Synchronized" 34 "Syncing" 35 "Error!" 36 "Error!" 37 "Uncalibrated" 38 "Open Loop" 39 "Closed Loop" 40 "Not Learn" 41 "Learning" 42 "Off" 43 "On" 44 "Not Rev Limiting" 45 "Rev Limit" 46 "No Cut Off" 47 "CutOff!" 48 "Off" 49 "Warning!" 50 "Caution!" 51 "No Timing modifier" 52 "Timing is being modified" 53 "Timing Value is being replaced" 54 "Acq Sat" 55 "No GPS" 56 "No Data" 22 "Non Critical Green LED" 23 "Non Critical Yellow LED" 24 "Non Critical Red LED" 25 "Non Critical Blue LED" 26 "Non Critical Grey LED" 28 "Critical Yellow LED" 29 "Critical Red LED" 30 "Critical Blue LED" 31 "Critical Grey LED";
VAL_ 2654916608 Status 0 "OK" 1 "Disabled" 2 "Initializing" 3 "Heating" 4 "WB_Active" 5 "Too Cold" 6 "Too Hot" 7 "Unplugged" 8 "Slow!" 9 "Uncal Yellow" 10 "Uncal Red" 11 "Replace" 12 "Disabled" 13 "Shorted" 14 "Open" 15 "Over Range" 16 "Under Range" 17 "Undefined" 18 "Error!" 19 "Low Error" 20 "High Error" 21 "Non Critical No LED" 27 "Critical Green LED" 32 "Stall!" 33 "Synchronized" 34 "Syncing" 35 "Error!" 36 "Error!" 37 "Uncalibrated" 38 "Open Loop" 39 "Closed Loop" 40 "Not Learn" 41 "Learning" 42 "Off" 43 "On" 44 "Not Rev Limiting" 45 "Rev Limit" 46 "No Cut Off" 47 "CutOff!" 48 "Off" 49 "Warning!" 50 "Caution!" 51 "No Timing modifier" 52 "Timing is being modified" 53 "Timing Value is being replaced" 54 "Acq Sat" 55 "No GPS" 56 "No Data" 22 "Non Critical Green LED" 23 "Non Critical Yellow LED" 24 "Non Critical Red LED" 25 "Non Critical Blue LED" 26 "Non Critical Grey LED" 28 "Critical Yellow LED" 29 "Critical Red LED" 30 "Critical Blue LED" 31 "Critical Grey LED";
VAL_ 2654932992 Status 0 "OK" 1 "Disabled" 2 "Initializing" 3 "Heating" 4 "WB_Active" 5 "Too Cold" 6 "Too Hot" 7 "Unplugged" 8 "Slow!" 9 "Uncal Yellow" 10 "Uncal Red" 11 "Replace" 12 "Disabled" 13 "Shorted" 14 "Open" 15 "Over Range" 16 "Under Range" 17 "Undefined" 18 "Error!" 19 "Low Error" 20 "High Error" 21 "Non Critical No LED" 27 "Critical Green LED" 32 "Stall!" 33 "Synchronized" 34 "Syncing" 35 "Error!" 36 "Error!" 37 "Uncalibrated" 38 "Open Loop" 39 "Closed Loop" 40 "Not Learn" 41 "Learning" 42 "Off" 43 "On" 44 "Not Rev Limiting" 45 "Rev Limit" 46 "No Cut Off" 47 "CutOff!" 48 "Off" 49 "Warning!" 50 "Caution!" 51 "No Timing modifier" 52 "Timing is being modified" 53 "Timing Value is being replaced" 54 "Acq Sat" 55 "No GPS" 56 "No Data" 22 "Non Critical Green LED" 23 "Non Critical Yellow LED" 24 "Non Critical Red LED" 25 "Non Critical Blue LED" 26 "Non Critical Grey LED" 28 "Critical Yellow LED" 29 "Critical Red LED" 30 "Critical Blue LED" 31 "Critical Grey LED";
VAL_ 2654949376 Status 0 "OK" 1 "Disabled" 2 "Initializing" 3 "Heating" 4 "WB_Active" 5 "Too Cold" 6 "Too Hot" 7 "Unplugged" 8 "Slow!" 9 "Uncal Yellow" 10 "Uncal Red" 11 "Replace" 12 "Disabled" 13 "Shorted" 14 "Open" 15 "Over Range" 16 "Under Range" 17 "Undefined" 18 "Error!" 19 "Low Error" 20 "High Error" 21 "Non Critical No LED" 27 "Critical Green LED" 32 "Stall!" 33 "Synchronized" 34 "Syncing" 35 "Error!" 36 "Error!" 37 "Uncalibrated" 38 "Open Loop" 39 "Closed Loop" 40 "Not Learn" 41 "Learning" 42 "Off" 43 "On" 44 "Not Rev Limiting" 45 "Rev Limit" 46 "No Cut Off" 47 "CutOff!" 48 "Off" 49 "Warning!" 50 "Caution!" 51 "No Timing modifier" 52 "Timing is being modified" 53 "Timing Value is being replaced" 54 "Acq Sat" 55 "No GPS" 56 "No Data" 22 "Non Critical Green LED" 23 "Non Critical Yellow LED" 24 "Non Critical Red LED" 25 "Non Critical Blue LED" 26 "Non Critical Grey LED" 28 "Critical Yellow LED" 29 "Critical Red LED" 30 "Critical Blue LED" 31 "Critical Grey LED";
VAL_ 2654965760 Status 0 "OK" 1 "Disabled" 2 "Initializing" 3 "Heating" 4 "WB_Active" 5 "Too Cold" 6 "Too Hot" 7 "Unplugged" 8 "Slow!" 9 "Uncal Yellow" 10 "Uncal Red" 11 "Replace" 12 "Disabled" 13 "Shorted" 14 "Open" 15 "Over Range" 16 "Under Range" 17 "Undefined" 18 "Error!" 19 "Low Error" 20 "High Error" 21 "Non Critical No LED" 27 "Critical Green LED" 32 "Stall!" 33 "Synchronized" 34 "Syncing" 35 "Error!" 36 "Error!" 37 "Uncalibrated" 38 "Open Loop" 39 "Closed Loop" 40 "Not Learn" 41 "Learning" 42 "Off" 43 "On" 44 "Not Rev Limiting" 45 "Rev Limit" 46 "No Cut Off" 47 "CutOff!" 48 "Off" 49 "Warning!" 50 "Caution!" 51 "No Timing modifier" 52 "Timing is being modified" 53 "Timing Value is being replaced" 54 "Acq Sat" 55 "No GPS" 56 "No Data" 22 "Non Critical Green LED" 23 "Non Critical Yellow LED" 24 "Non Critical Red LED" 25 "Non Critical Blue LED" 26 "Non Critical Grey LED" 28 "Critical Yellow LED" 29 "Critical Red LED" 30 "Critical Blue LED" 31 "Critical Grey LED";
VAL_ 2654982144 Status 0 "OK" 1 "Disabled" 2 "Initializing" 3 "Heating" 4 "WB_Active" 5 "Too Cold" 6 "Too Hot" 7 "Unplugged" 8 "Slow!" 9 "Uncal Yellow" 10 "Uncal Red" 11 "Replace" 12 "Disabled" 13 "Shorted" 14 "Open" 15 "Over Range" 16 "Under Range" 17 "Undefined" 18 "Error!" 19 "Low Error" 20 "High Error" 21 "Non Critical No LED" 27 "Critical Green LED" 32 "Stall!" 33 "Synchronized" 34 "Syncing" 35 "Error!" 36 "Error!" 37 "Uncalibrated" 38 "Open Loop" 39 "Closed Loop" 40 "Not Learn" 41 "Learning" 42 "Off" 43 "On" 44 "Not Rev Limiting" 45 "Rev Limit" 46 "No Cut Off" 47 "CutOff!" 48 "Off" 49 "Warning!" 50 "Caution!" 51 "No Timing modifier" 52 "Timing is being modified" 53 "Timing Value is being replaced" 54 "Acq Sat" 55 "No GPS" 56 "No Data" 22 "Non Critical Green LED" 23 "Non Critical Yellow LED" 24 "Non Critical Red LED" 25 "Non Critical Blue LED" 26 "Non Critical Grey LED" 28 "Critical Yellow LED" 29 "Critical Red LED" 30 "Critical Blue LED" 31 "Critical Grey LED";
VAL_ 2654998528 Status 0 "OK" 1 "Disabled" 2 "Initializing" 3 "Heating" 4 "WB_Active" 5 "Too Cold" 6 "Too Hot" 7 "Unplugged" 8 "Slow!" 9 "Uncal Yellow" 10 "Uncal Red" 11 "Replace" 12 "Disabled" 13 "Shorted" 14 "Open" 15 "Over Range" 16 "Under Range" 17 "Undefined" 18 "Error!" 19 "Low Error" 20 "High Error" 21 "Non Critical No LED" 27 "Critical Green LED" 32 "Stall!" 33 "Synchronized" 34 "Syncing" 35 "Error!" 36 "Error!" 37 "Uncalibrated" 38 "Open Loop" 39 "Closed Loop" 40 "Not Learn" 41 "Learning" 42 "Off" 43 "On" 44 "Not Rev Limiting" 45 "Rev Limit" 46 "No Cut Off" 47 "CutOff!" 48 "Off" 49 "Warning!" 50 "Caution!" 51 "No Timing modifier" 52 "Timing is being modified" 53 "Timing Value is being replaced" 54 "Acq Sat" 55 "No GPS" 56 "No Data" 22 "Non Critical Green LED" 23 "Non Critical Yellow LED" 24 "Non Critical Red LED" 25 "Non Critical Blue LED" 26 "Non Critical Grey LED" 28 "Critical Yellow LED" 29 "Critical Red LED" 30 "Critical Blue LED" 31 "Critical Grey LED";
VAL_ 2655014912 Status 0 "OK" 1 "Disabled" 2 "Initializing" 3 "Heating" 4 "WB_Active" 5 "Too Cold" 6 "Too Hot" 7 "Unplugged" 8 "Slow!" 9 "Uncal Yellow" 10 "Uncal Red" 11 "Replace" 12 "Disabled" 13 "Shorted" 14 "Open" 15 "Over Range" 16 "Under Range" 17 "Undefined" 18 "Error!" 19 "Low Error" 20 "High Error" 21 "Non Critical No LED" 27 "Critical Green LED" 32 "Stall!" 33 "Synchronized" 34 "Syncing" 35 "Error!" 36 "Error!" 37 "Uncalibrated" 38 "Open Loop" 39 "Closed Loop" 40 "Not Learn" 41 "Learning" 42 "Off" 43 "On" 44 "Not Rev Limiting" 45 "Rev Limit" 46 "No Cut Off" 47 "CutOff!" 48 "Off" 49 "Warning!" 50 "Caution!" 51 "No Timing modifier" 52 "Timing is being modified" 53 "Timing Value is being replaced" 54 "Acq Sat" 55 "No GPS" 56 "No Data" 22 "Non Critical Green LED" 23 "Non Critical Yellow LED" 24 "Non Critical Red LED" 25 "Non Critical Blue LED" 26 "Non Critical Grey LED" 28 "Critical Yellow LED" 29 "Critical Red LED" 30 "Critical Blue LED" 31 "Critical Grey LED";
VAL_ 2655031296 Status 0 "OK" 1 "Disabled" 2 "Initializing" 3 "Heating" 4 "WB_Active" 5 "Too Cold" 6 "Too Hot" 7 "Unplugged" 8 "Slow!" 9 "Uncal Yellow" 10 "Uncal Red" 11 "Replace" 12 "Disabled" 13 "Shorted" 14 "Open" 15 "Over Range" 16 "Under Range" 17 "Undefined" 18 "Error!" 19 "Low Error" 20 "High Error" 21 "Non Critical No LED" 27 "Critical Green LED" 32 "Stall!" 33 "Synchronized" 34 "Syncing" 35 "Error!" 36 "Error!" 37 "Uncalibrated" 38 "Open Loop" 39 "Closed Loop" 40 "Not Learn" 41 "Learning" 42 "Off" 43 "On" 44 "Not Rev Limiting" 45 "Rev Limit" 46 "No Cut Off" 47 "CutOff!" 48 "Off" 49 "Warning!" 50 "Caution!" 51 "No Timing modifier" 52 "Timing is being modified" 53 "Timing Value is being replaced" 54 "Acq Sat" 55 "No GPS" 56 "No Data" 22 "Non Critical Green LED" 23 "Non Critical Yellow LED" 24 "Non Critical Red LED" 25 "Non Critical Blue LED" 26 "Non Critical Grey LED" 28 "Critical Yellow LED" 29 "Critical Red LED" 30 "Critical Blue LED" 31 "Critical Grey LED";
VAL_ 2655047680 Status 0 "OK" 1 "Disabled" 2 "Initializing" 3 "Heating" 4 "WB_Active" 5 "Too Cold" 6 "Too Hot" 7 "Unplugged" 8 "Slow!" 9 "Uncal Yellow" 10 "Uncal Red" 11 "Replace" 12 "Disabled" 13 "Shorted" 14 "Open" 15 "Over Range" 16 "Under Range" 17 "Undefined" 18 "Error!" 19 "Low Error" 20 "High Error" 21 "Non Critical No LED" 27 "Critical Green LED" 32 "Stall!" 33 "Synchronized" 34 "Syncing" 35 "Error!" 36 "Error!" 37 "Uncalibrated" 38 "Open Loop" 39 "Closed Loop" 40 "Not Learn" 41 "Learning" 42 "Off" 43 "On" 44 "Not Rev Limiting" 45 "Rev Limit" 46 "No Cut Off" 47 "CutOff!" 48 "Off" 49 "Warning!" 50 "Caution!" 51 "No Timing modifier" 52 "Timing is being modified" 53 "Timing Value is being replaced" 54 "Acq Sat" 55 "No GPS" 56 "No Data" 22 "Non Critical Green LED" 23 "Non Critical Yellow LED" 24 "Non Critical Red LED" 25 "Non Critical Blue LED" 26 "Non Critical Grey LED" 28 "Critical Yellow LED" 29 "Critical Red LED" 30 "Critical Blue LED" 31 "Critical Grey LED";
VAL_ 2655064064 Status 0 "OK" 1 "Disabled" 2 "Initializing" 3 "Heating" 4 "WB_Active" 5 "Too Cold" 6 "Too Hot" 7 "Unplugged" 8 "Slow!" 9 "Uncal Yellow" 10 "Uncal Red" 11 "Replace" 12 "Disabled" 13 "Shorted" 14 "Open" 15 "Over Range" 16 "Under Range" 17 "Undefined" 18 "Error!" 19 "Low Error" 20 "High Error" 21 "Non Critical No LED" 27 "Critical Green LED" 32 "Stall!" 33 "Synchronized" 34 "Syncing" 35 "Error!" 36 "Error!" 37 "Uncalibrated" 38 "Open Loop" 39 "Closed Loop" 40 "Not Learn" 41 "Learning" 42 "Off" 43 "On" 44 "Not Rev Limiting" 45 "Rev Limit" 46 "No Cut Off" 47 "CutOff!" 48 "Off" 49 "Warning!" 50 "Caution!" 51 "No Timing modifier" 52 "Timing is being modified" 53 "Timing Value is being replaced" 54 "Acq Sat" 55 "No GPS" 56 "No Data" 22 "Non Critical Green LED" 23 "Non Critical Yellow LED" 24 "Non Critical Red LED" 25 "Non Critical Blue LED" 26 "Non Critical Grey LED" 28 "Critical Yellow LED" 29 "Critical Red LED" 30 "Critical Blue LED" 31 "Critical Grey LED";
VAL_ 2655080448 Status 0 "OK" 1 "Disabled" 2 "Initializing" 3 "Heating" 4 "WB_Active" 5 "Too Cold" 6 "Too Hot" 7 "Unplugged" 8 "Slow!" 9 "Uncal Yellow" 10 "Uncal Red" 11 "Replace" 12 "Disabled" 13 "Shorted" 14 "Open" 15 "Over Range" 16 "Under Range" 17 "Undefined" 18 "Error!" 19 "Low Error" 20 "High Error" 21 "Non Critical No LED" 27 "Critical Green LED" 32 "Stall!" 33 "Synchronized" 34 "Syncing" 35 "Error!" 36 "Error!" 37 "Uncalibrated" 38 "Open Loop" 39 "Closed Loop" 40 "Not Learn" 41 "Learning" 42 "Off" 43 "On" 44 "Not Rev Limiting" 45 "Rev Limit" 46 "No Cut Off" 47 "CutOff!" 48 "Off" 49 "Warning!" 50 "Caution!" 51 "No Timing modifier" 52 "Timing is being modified" 53 "Timing Value is being replaced" 54 "Acq Sat" 55 "No GPS" 56 "No Data" 22 "Non Critical Green LED" 23 "Non Critical Yellow LED" 24 "Non Critical Red LED" 25 "Non Critical Blue LED" 26 "Non Critical Grey LED" 28 "Critical Yellow LED" 29 "Critical Red LED" 30 "Critical Blue LED" 31 "Critical Grey LED";
VAL_ 2655096832 Status 0 "OK" 1 "Disabled" 2 "Initializing" 3 "Heating" 4 "WB_Active" 5 "Too Cold" 6 "Too Hot" 7 "Unplugged" 8 "Slow!" 9 "Uncal Yellow" 10 "Uncal Red" 11 "Replace" 12 "Disabled" 13 "Shorted" 14 "Open" 15 "Over Range" 16 "Under Range" 17 "Undefined" 18 "Error!" 19 "Low Error" 20 "High Error" 21 "Non Critical No LED" 27 "Critical Green LED" 32 "Stall!" 33 "Synchronized" 34 "Syncing" 35 "Error!" 36 "Error!" 37 "Uncalibrated" 38 "Open Loop" 39 "Closed Loop" 40 "Not Learn" 41 "Learning" 42 "Off" 43 "On" 44 "Not Rev Limiting" 45 "Rev Limit" 46 "No Cut Off" 47 "CutOff!" 48 "Off" 49 "Warning!" 50 "Caution!" 51 "No Timing modifier" 52 "Timing is being modified" 53 "Timing Value is being replaced" 54 "Acq Sat" 55 "No GPS" 56 "No Data" 22 "Non Critical Green LED" 23 "Non Critical Yellow LED" 24 "Non Critical Red LED" 25 "Non Critical Blue LED" 26 "Non Critical Grey LED" 28 "Critical Yellow LED" 29 "Critical Red LED" 30 "Critical Blue LED" 31 "Critical Grey LED";
VAL_ 2655113216 Status 0 "OK" 1 "Disabled" 2 "Initializing" 3 "Heating" 4 "WB_Active" 5 "Too Cold" 6 "Too Hot" 7 "Unplugged" 8 "Slow!" 9 "Uncal Yellow" 10 "Uncal Red" 11 "Replace" 12 "Disabled" 13 "Shorted" 14 "Open" 15 "Over Range" 16 "Under Range" 17 "Undefined" 18 "Error!" 19 "Low Error" 20 "High Error" 21 "Non Critical No LED" 27 "Critical Green LED" 32 "Stall!" 33 "Synchronized" 34 "Syncing" 35 "Error!" 36 "Error!" 37 "Uncalibrated" 38 "Open Loop" 39 "Closed Loop" 40 "Not Learn" 41 "Learning" 42 "Off" 43 "On" 44 "Not Rev Limiting" 45 "Rev Limit" 46 "No Cut Off" 47 "CutOff!" 48 "Off" 49 "Warning!" 50 "Caution!" 51 "No Timing modifier" 52 "Timing is being modified" 53 "Timing Value is being replaced" 54 "Acq Sat" 55 "No GPS" 56 "No Data" 22 "Non Critical Green LED" 23 "Non Critical Yellow LED" 24 "Non Critical Red LED" 25 "Non Critical Blue LED" 26 "Non Critical Grey LED" 28 "Critical Yellow LED" 29 "Critical Red LED" 30 "Critical Blue LED" 31 "Critical Grey LED";
VAL_ 2655129600 Status 0 "OK" 1 "Disabled" 2 "Initializing" 3 "Heating" 4 "WB_Active" 5 "Too Cold" 6 "Too Hot" 7 "Unplugged" 8 "Slow!" 9 "Uncal Yellow" 10 "Uncal Red" 11 "Replace" 12 "Disabled" 13 "Shorted" 14 "Open" 15 "Over Range" 16 "Under Range" 17 "Undefined" 18 "Error!" 19 "Low Error" 20 "High Error" 21 "Non Critical No LED" 27 "Critical Green LED" 32 "Stall!" 33 "Synchronized" 34 "Syncing" 35 "Error!" 36 "Error!" 37 "Uncalibrated" 38 "Open Loop" 39 "Closed Loop" 40 "Not Learn" 41 "Learning" 42 "Off" 43 "On" 44 "Not Rev Limiting" 45 "Rev Limit" 46 "No Cut Off" 47 "CutOff!" 48 "Off" 49 "Warning!" 50 "Caution!" 51 "No Timing modifier" 52 "Timing is being modified" 53 "Timing Value is being replaced" 54 "Acq Sat" 55 "No GPS" 56 "No Data" 22 "Non Critical Green LED" 23 "Non Critical Yellow LED" 24 "Non Critical Red LED" 25 "Non Critical Blue LED" 26 "Non Critical Grey LED" 28 "Critical Yellow LED" 29 "Critical Red LED" 30 "Critical Blue LED" 31 "Critical Grey LED";
VAL_ 2655145984 Status 0 "OK" 1 "Disabled" 2 "Initializing" 3 "Heating" 4 "WB_Active" 5 "Too Cold" 6 "Too Hot" 7 "Unplugged" 8 "Slow!" 9 "Uncal Yellow" 10 "Uncal Red" 11 "Replace" 12 "Disabled" 13 "Shorted" 14 "Open" 15 "Over Range" 16 "Under Range" 17 "Undefined" 18 "Error!" 19 "Low Error" 20 "High Error" 21 "Non Critical No LED" 27 "Critical Green LED" 32 "Stall!" 33 "Synchronized" 34 "Syncing" 35 "Error!" 36 "Error!" 37 "Uncalibrated" 38 "Open Loop" 39 "Closed Loop" 40 "Not Learn" 41 "Learning" 42 "Off" 43 "On" 44 "Not Rev Limiting" 45 "Rev Limit" 46 "No Cut Off" 47 "CutOff!" 48 "Off" 49 "Warning!" 50 "Caution!" 51 "No Timing modifier" 52 "Timing is being modified" 53 "Timing Value is being replaced" 54 "Acq Sat" 55 "No GPS" 56 "No Data" 22 "Non Critical Green LED" 23 "Non Critical Yellow LED" 24 "Non Critical Red LED" 25 "Non Critical Blue LED" 26 "Non Critical Grey LED" 28 "Critical Yellow LED" 29 "Critical Red LED" 30 "Critical Blue LED" 31 "Critical Grey LED";
VAL_ 2655162368 Status 0 "OK" 1 "Disabled" 2 "Initializing" 3 "Heating" 4 "WB_Active" 5 "Too Cold" 6 "Too Hot" 7 "Unplugged" 8 "Slow!" 9 "Uncal Yellow" 10 "Uncal Red" 11 "Replace" 12 "Disabled" 13 "Shorted" 14 "Open" 15 "Over Range" 16 "Under Range" 17 "Undefined" 18 "Error!" 19 "Low Error" 20 "High Error" 21 "Non Critical No LED" 27 "Critical Green LED" 32 "Stall!" 33 "Synchronized" 34 "Syncing" 35 "Error!" 36 "Error!" 37 "Uncalibrated" 38 "Open Loop" 39 "Closed Loop" 40 "Not Learn" 41 "Learning" 42 "Off" 43 "On" 44 "Not Rev Limiting" 45 "Rev Limit" 46 "No Cut Off" 47 "CutOff!" 48 "Off" 49 "Warning!" 50 "Caution!" 51 "No Timing modifier" 52 "Timing is being modified" 53 "Timing Value is being replaced" 54 "Acq Sat" 55 "No GPS" 56 "No Data" 22 "Non Critical Green LED" 23 "Non Critical Yellow LED" 24 "Non Critical Red LED" 25 "Non Critical Blue LED" 26 "Non Critical Grey LED" 28 "Critical Yellow LED" 29 "Critical Red LED" 30 "Critical Blue LED" 31 "Critical Grey LED";
VAL_ 2655178752 Status 0 "OK" 1 "Disabled" 2 "Initializing" 3 "Heating" 4 "WB_Active" 5 "Too Cold" 6 "Too Hot" 7 "Unplugged" 8 "Slow!" 9 "Uncal Yellow" 10 "Uncal Red" 11 "Replace" 12 "Disabled" 13 "Shorted" 14 "Open" 15 "Over Range" 16 "Under Range" 17 "Undefined" 18 "Error!" 19 "Low Error" 20 "High Error" 21 "Non Critical No LED" 27 "Critical Green LED" 32 "Stall!" 33 "Synchronized" 34 "Syncing" 35 "Error!" 36 "Error!" 37 "Uncalibrated" 38 "Open Loop" 39 "Closed Loop" 40 "Not Learn" 41 "Learning" 42 "Off" 43 "On" 44 "Not Rev Limiting" 45 "Rev Limit" 46 "No Cut Off" 47 "CutOff!" 48 "Off" 49 "Warning!" 50 "Caution!" 51 "No Timing modifier" 52 "Timing is being modified" 53 "Timing Value is being replaced" 54 "Acq Sat" 55 "No GPS" 56 "No Data" 22 "Non Critical Green LED" 23 "Non Critical Yellow LED" 24 "Non Critical Red LED" 25 "Non Critical Blue LED" 26 "Non Critical Grey LED" 28 "Critical Yellow LED" 29 "Critical Red LED" 30 "Critical Blue LED" 31 "Critical Grey LED";
VAL_ 2655195136 Status 0 "OK" 1 "Disabled" 2 "Initializing" 3 "Heating" 4 "WB_Active" 5 "Too Cold" 6 "Too Hot" 7 "Unplugged" 8 "Slow!" 9 "Uncal Yellow" 10 "Uncal Red" 11 "Replace" 12 "Disabled" 13 "Shorted" 14 "Open" 15 "Over Range" 16 "Under Range" 17 "Undefined" 18 "Error!" 19 "Low Error" 20 "High Error" 21 "Non Critical No LED" 27 "Critical Green LED" 32 "Stall!" 33 "Synchronized" 34 "Syncing" 35 "Error!" 36 "Error!" 37 "Uncalibrated" 38 "Open Loop" 39 "Closed Loop" 40 "Not Learn" 41 "Learning" 42 "Off" 43 "On" 44 "Not Rev Limiting" 45 "Rev Limit" 46 "No Cut Off" 47 "CutOff!" 48 "Off" 49 "Warning!" 50 "Caution!" 51 "No Timing modifier" 52 "Timing is being modified" 53 "Timing Value is being replaced" 54 "Acq Sat" 55 "No GPS" 56 "No Data" 22 "Non Critical Green LED" 23 "Non Critical Yellow LED" 24 "Non Critical Red LED" 25 "Non Critical Blue LED" 26 "Non Critical Grey LED" 28 "Critical Yellow LED" 29 "Critical Red LED" 30 "Critical Blue LED" 31 "Critical Grey LED";
VAL_ 2655211520 Status 0 "OK" 1 "Disabled" 2 "Initializing" 3 "Heating" 4 "WB_Active" 5 "Too Cold" 6 "Too Hot" 7 "Unplugged" 8 "Slow!" 9 "Uncal Yellow" 10 "Uncal Red" 11 "Replace" 12 "Disabled" 13 "Shorted" 14 "Open" 15 "Over Range" 16 "Under Range" 17 "Undefined" 18 "Error!" 19 "Low Error" 20 "High Error" 21 "Non Critical No LED" 27 "Critical Green LED" 32 "Stall!" 33 "Synchronized" 34 "Syncing" 35 "Error!" 36 "Error!" 37 "Uncalibrated" 38 "Open Loop" 39 "Closed Loop" 40 "Not Learn" 41 "Learning" 42 "Off" 43 "On" 44 "Not Rev Limiting" 45 "Rev Limit" 46 "No Cut Off" 47 "CutOff!" 48 "Off" 49 "Warning!" 50 "Caution!" 51 "No Timing modifier" 52 "Timing is being modified" 53 "Timing Value is being replaced" 54 "Acq Sat" 55 "No GPS" 56 "No Data" 22 "Non Critical Green LED" 23 "Non Critical Yellow LED" 24 "Non Critical Red LED" 25 "Non Critical Blue LED" 26 "Non Critical Grey LED" 28 "Critical Yellow LED" 29 "Critical Red LED" 30 "Critical Blue LED" 31 "Critical Grey LED";
VAL_ 2655227904 Status 0 "OK" 1 "Disabled" 2 "Initializing" 3 "Heating" 4 "WB_Active" 5 "Too Cold" 6 "Too Hot" 7 "Unplugged" 8 "Slow!" 9 "Uncal Yellow" 10 "Uncal Red" 11 "Replace" 12 "Disabled" 13 "Shorted" 14 "Open" 15 "Over Range" 16 "Under Range" 17 "Undefined" 18 "Error!" 19 "Low Error" 20 "High Error" 21 "Non Critical No LED" 27 "Critical Green LED" 32 "Stall!" 33 "Synchronized" 34 "Syncing" 35 "Error!" 36 "Error!" 37 "Uncalibrated" 38 "Open Loop" 39 "Closed Loop" 40 "Not Learn" 41 "Learning" 42 "Off" 43 "On" 44 "Not Rev Limiting" 45 "Rev Limit" 46 "No Cut Off" 47 "CutOff!" 48 "Off" 49 "Warning!" 50 "Caution!" 51 "No Timing modifier" 52 "Timing is being modified" 53 "Timing Value is being replaced" 54 "Acq Sat" 55 "No GPS" 56 "No Data" 22 "Non Critical Green LED" 23 "Non Critical Yellow LED" 24 "Non Critical Red LED" 25 "Non Critical Blue LED" 26 "Non Critical Grey LED" 28 "Critical Yellow LED" 29 "Critical Red LED" 30 "Critical Blue LED" 31 "Critical Grey LED";
VAL_ 2655244288 Status 0 "OK" 1 "Disabled" 2 "Initializing" 3 "Heating" 4 "WB_Active" 5 "Too Cold" 6 "Too Hot" 7 "Unplugged" 8 "Slow!" 9 "Uncal Yellow" 10 "Uncal Red" 11 "Replace" 12 "Disabled" 13 "Shorted" 14 "Open" 15 "Over Range" 16 "Under Range" 17 "Undefined" 18 "Error!" 19 "Low Error" 20 "High Error" 21 "Non Critical No LED" 27 "Critical Green LED" 32 "Stall!" 33 "Synchronized" 34 "Syncing" 35 "Error!" 36 "Error!" 37 "Uncalibrated" 38 "Open Loop" 39 "Closed Loop" 40 "Not Learn" 41 "Learning" 42 "Off" 43 "On" 44 "Not Rev Limiting" 45 "Rev Limit" 46 "No Cut Off" 47 "CutOff!" 48 "Off" 49 "Warning!" 50 "Caution!" 51 "No Timing modifier" 52 "Timing is being modified" 53 "Timing Value is being replaced" 54 "Acq Sat" 55 "No GPS" 56 "No Data" 22 "Non Critical Green LED" 23 "Non Critical Yellow LED" 24 "Non Critical Red LED" 25 "Non Critical Blue LED" 26 "Non Critical Grey LED" 28 "Critical Yellow LED" 29 "Critical Red LED" 30 "Critical Blue LED" 31 "Critical Grey LED";
VAL_ 2655260672 Status 0 "OK" 1 "Disabled" 2 "Initializing" 3 "Heating" 4 "WB_Active" 5 "Too Cold" 6 "Too Hot" 7 "Unplugged" 8 "Slow!" 9 "Uncal Yellow" 10 "Uncal Red" 11 "Replace" 12 "Disabled" 13 "Shorted" 14 "Open" 15 "Over Range" 16 "Under Range" 17 "Undefined" 18 "Error!" 19 "Low Error" 20 "High Error" 21 "Non Critical No LED" 27 "Critical Green LED" 32 "Stall!" 33 "Synchronized" 34 "Syncing" 35 "Error!" 36 "Error!" 37 "Uncalibrated" 38 "Open Loop" 39 "Closed Loop" 40 "Not Learn" 41 "Learning" 42 "Off" 43 "On" 44 "Not Rev Limiting" 45 "Rev Limit" 46 "No Cut Off" 47 "CutOff!" 48 "Off" 49 "Warning!" 50 "Caution!" 51 "No Timing modifier" 52 "Timing is being modified" 53 "Timing Value is being replaced" 54 "Acq Sat" 55 "No GPS" 56 "No Data" 22 "Non Critical Green LED" 23 "Non Critical Yellow LED" 24 "Non Critical Red LED" 25 "Non Critical Blue LED" 26 "Non Critical Grey LED" 28 "Critical Yellow LED" 29 "Critical Red LED" 30 "Critical Blue LED" 31 "Critical Grey LED";
VAL_ 2655277056 Status 0 "OK" 1 "Disabled" 2 "Initializing" 3 "Heating" 4 "WB_Active" 5 "Too Cold" 6 "Too Hot" 7 "Unplugged" 8 "Slow!" 9 "Uncal Yellow" 10 "Uncal Red" 11 "Replace" 12 "Disabled" 13 "Shorted" 14 "Open" 15 "Over Range" 16 "Under Range" 17 "Undefined" 18 "Error!" 19 "Low Error" 20 "High Error" 21 "Non Critical No LED" 27 "Critical Green LED" 32 "Stall!" 33 "Synchronized" 34 "Syncing" 35 "Error!" 36 "Error!" 37 "Uncalibrated" 38 "Open Loop" 39 "Closed Loop" 40 "Not Learn" 41 "Learning" 42 "Off" 43 "On" 44 "Not Rev Limiting" 45 "Rev Limit" 46 "No Cut Off" 47 "CutOff!" 48 "Off" 49 "Warning!" 50 "Caution!" 51 "No Timing modifier" 52 "Timing is being modified" 53 "Timing Value is being replaced" 54 "Acq Sat" 55 "No GPS" 56 "No Data" 22 "Non Critical Green LED" 23 "Non Critical Yellow LED" 24 "Non Critical Red LED" 25 "Non Critical Blue LED" 26 "Non Critical Grey LED" 28 "Critical Yellow LED" 29 "Critical Red LED" 30 "Critical Blue LED" 31 "Critical Grey LED";
VAL_ 2655293440 Status 0 "OK" 1 "Disabled" 2 "Initializing" 3 "Heating" 4 "WB_Active" 5 "Too Cold" 6 "Too Hot" 7 "Unplugged" 8 "Slow!" 9 "Uncal Yellow" 10 "Uncal Red" 11 "Replace" 12 "Disabled" 13 "Shorted" 14 "Open" 15 "Over Range" 16 "Under Range" 17 "Undefined" 18 "Error!" 19 "Low Error" 20 "High Error" 21 "Non Critical No LED" 27 "Critical Green LED" 32 "Stall!" 33 "Synchronized" 34 "Syncing" 35 "Error!" 36 "Error!" 37 "Uncalibrated" 38 "Open Loop" 39 "Closed Loop" 40 "Not Learn" 41 "Learning" 42 "Off" 43 "On" 44 "Not Rev Limiting" 45 "Rev Limit" 46 "No Cut Off" 47 "CutOff!" 48 "Off" 49 "Warning!" 50 "Caution!" 51 "No Timing modifier" 52 "Timing is being modified" 53 "Timing Value is being replaced" 54 "Acq Sat" 55 "No GPS" 56 "No Data" 22 "Non Critical Green LED" 23 "Non Critical Yellow LED" 24 "Non Critical Red LED" 25 "Non Critical Blue LED" 26 "Non Critical Grey LED" 28 "Critical Yellow LED" 29 "Critical Red LED" 30 "Critical Blue LED" 31 "Critical Grey LED";
VAL_ 2655309824 Status 0 "OK" 1 "Disabled" 2 "Initializing" 3 "Heating" 4 "WB_Active" 5 "Too Cold" 6 "Too Hot" 7 "Unplugged" 8 "Slow!" 9 "Uncal Yellow" 10 "Uncal Red" 11 "Replace" 12 "Disabled" 13 "Shorted" 14 "Open" 15 "Over Range" 16 "Under Range" 17 "Undefined" 18 "Error!" 19 "Low Error" 20 "High Error" 21 "Non Critical No LED" 27 "Critical Green LED" 32 "Stall!" 33 "Synchronized" 34 "Syncing" 35 "Error!" 36 "Error!" 37 "Uncalibrated" 38 "Open Loop" 39 "Closed Loop" 40 "Not Learn" 41 "Learning" 42 "Off" 43 "On" 44 "Not Rev Limiting" 45 "Rev Limit" 46 "No Cut Off" 47 "CutOff!" 48 "Off" 49 "Warning!" 50 "Caution!" 51 "No Timing modifier" 52 "Timing is being modified" 53 "Timing Value is being replaced" 54 "Acq Sat" 55 "No GPS" 56 "No Data" 22 "Non Critical Green LED" 23 "Non Critical Yellow LED" 24 "Non Critical Red LED" 25 "Non Critical Blue LED" 26 "Non Critical Grey LED" 28 "Critical Yellow LED" 29 "Critical Red LED" 30 "Critical Blue LED" 31 "Critical Grey LED";
VAL_ 2655326208 Status 0 "OK" 1 "Disabled" 2 "Initializing" 3 "Heating" 4 "WB_Active" 5 "Too Cold" 6 "Too Hot" 7 "Unplugged" 8 "Slow!" 9 "Uncal Yellow" 10 "Uncal Red" 11 "Replace" 12 "Disabled" 13 "Shorted" 14 "Open" 15 "Over Range" 16 "Under Range" 17 "Undefined" 18 "Error!" 19 "Low Error" 20 "High Error" 21 "Non Critical No LED" 27 "Critical Green LED" 32 "Stall!" 33 "Synchronized" 34 "Syncing" 35 "Error!" 36 "Error!" 37 "Uncalibrated" 38 "Open Loop" 39 "Closed Loop" 40 "Not Learn" 41 "Learning" 42 "Off" 43 "On" 44 "Not Rev Limiting" 45 "Rev Limit" 46 "No Cut Off" 47 "CutOff!" 48 "Off" 49 "Warning!" 50 "Caution!" 51 "No Timing modifier" 52 "Timing is being modified" 53 "Timing Value is being replaced" 54 "Acq Sat" 55 "No GPS" 56 "No Data" 22 "Non Critical Green LED" 23 "Non Critical Yellow LED" 24 "Non Critical Red LED" 25 "Non Critical Blue LED" 26 "Non Critical Grey LED" 28 "Critical Yellow LED" 29 "Critical Red LED" 30 "Critical Blue LED" 31 "Critical Grey LED";
VAL_ 2655342592 Status 0 "OK" 1 "Disabled" 2 "Initializing" 3 "Heating" 4 "WB_Active" 5 "Too Cold" 6 "Too Hot" 7 "Unplugged" 8 "Slow!" 9 "Uncal Yellow" 10 "Uncal Red" 11 "Replace" 12 "Disabled" 13 "Shorted" 14 "Open" 15 "Over Range" 16 "Under Range" 17 "Undefined" 18 "Error!" 19 "Low Error" 20 "High Error" 21 "Non Critical No LED" 27 "Critical Green LED" 32 "Stall!" 33 "Synchronized" 34 "Syncing" 35 "Error!" 36 "Error!" 37 "Uncalibrated" 38 "Open Loop" 39 "Closed Loop" 40 "Not Learn" 41 "Learning" 42 "Off" 43 "On" 44 "Not Rev Limiting" 45 "Rev Limit" 46 "No Cut Off" 47 "CutOff!" 48 "Off" 49 "Warning!" 50 "Caution!" 51 "No Timing modifier" 52 "Timing is being modified" 53 "Timing Value is being replaced" 54 "Acq Sat" 55 "No GPS" 56 "No Data" 22 "Non Critical Green LED" 23 "Non Critical Yellow LED" 24 "Non Critical Red LED" 25 "Non Critical Blue LED" 26 "Non Critical Grey LED" 28 "Critical Yellow LED" 29 "Critical Red LED" 30 "Critical Blue LED" 31 "Critical Grey LED";
VAL_ 2655358976 Status 0 "OK" 1 "Disabled" 2 "Initializing" 3 "Heating" 4 "WB_Active" 5 "Too Cold" 6 "Too Hot" 7 "Unplugged" 8 "Slow!" 9 "Uncal Yellow" 10 "Uncal Red" 11 "Replace" 12 "Disabled" 13 "Shorted" 14 "Open" 15 "Over Range" 16 "Under Range" 17 "Undefined" 18 "Error!" 19 "Low Error" 20 "High Error" 21 "Non Critical No LED" 27 "Critical Green LED" 32 "Stall!" 33 "Synchronized" 34 "Syncing" 35 "Error!" 36 "Error!" 37 "Uncalibrated" 38 "Open Loop" 39 "Closed Loop" 40 "Not Learn" 41 "Learning" 42 "Off" 43 "On" 44 "Not Rev Limiting" 45 "Rev Limit" 46 "No Cut Off" 47 "CutOff!" 48 "Off" 49 "Warning!" 50 "Caution!" 51 "No Timing modifier" 52 "Timing is being modified" 53 "Timing Value is being replaced" 54 "Acq Sat" 55 "No GPS" 56 "No Data" 22 "Non Critical Green LED" 23 "Non Critical Yellow LED" 24 "Non Critical Red LED" 25 "Non Critical Blue LED" 26 "Non Critical Grey LED" 28 "Critical Yellow LED" 29 "Critical Red LED" 30 "Critical Blue LED" 31 "Critical Grey LED";
VAL_ 2655375360 Status 0 "OK" 1 "Disabled" 2 "Initializing" 3 "Heating" 4 "WB_Active" 5 "Too Cold" 6 "Too Hot" 7 "Unplugged" 8 "Slow!" 9 "Uncal Yellow" 10 "Uncal Red" 11 "Replace" 12 "Disabled" 13 "Shorted" 14 "Open" 15 "Over Range" 16 "Under Range" 17 "Undefined" 18 "Error!" 19 "Low Error" 20 "High Error" 21 "Non Critical No LED" 27 "Critical Green LED" 32 "Stall!" 33 "Synchronized" 34 "Syncing" 35 "Error!" 36 "Error!" 37 "Uncalibrated" 38 "Open Loop" 39 "Closed Loop" 40 "Not Learn" 41 "Learning" 42 "Off" 43 "On" 44 "Not Rev Limiting" 45 "Rev Limit" 46 "No Cut Off" 47 "CutOff!" 48 "Off" 49 "Warning!" 50 "Caution!" 51 "No Timing modifier" 52 "Timing is being modified" 53 "Timing Value is being replaced" 54 "Acq Sat" 55 "No GPS" 56 "No Data" 22 "Non Critical Green LED" 23 "Non Critical Yellow LED" 24 "Non Critical Red LED" 25 "Non Critical Blue LED" 26 "Non Critical Grey LED" 28 "Critical Yellow LED" 29 "Critical Red LED" 30 "Critical Blue LED" 31 "Critical Grey LED";
VAL_ 2655391744 Status 0 "OK" 1 "Disabled" 2 "Initializing" 3 "Heating" 4 "WB_Active" 5 "Too Cold" 6 "Too Hot" 7 "Unplugged" 8 "Slow!" 9 "Uncal Yellow" 10 "Uncal Red" 11 "Replace" 12 "Disabled" 13 "Shorted" 14 "Open" 15 "Over Range" 16 "Under Range" 17 "Undefined" 18 "Error!" 19 "Low Error" 20 "High Error" 21 "Non Critical No LED" 27 "Critical Green LED" 32 "Stall!" 33 "Synchronized" 34 "Syncing" 35 "Error!" 36 "Error!" 37 "Uncalibrated" 38 "Open Loop" 39 "Closed Loop" 40 "Not Learn" 41 "Learning" 42 "Off" 43 "On" 44 "Not Rev Limiting" 45 "Rev Limit" 46 "No Cut Off" 47 "CutOff!" 48 "Off" 49 "Warning!" 50 "Caution!" 51 "No Timing modifier" 52 "Timing is being modified" 53 "Timing Value is being replaced" 54 "Acq Sat" 55 "No GPS" 56 "No Data" 22 "Non Critical Green LED" 23 "Non Critical Yellow LED" 24 "Non Critical Red LED" 25 "Non Critical Blue LED" 26 "Non Critical Grey LED" 28 "Critical Yellow LED" 29 "Critical Red LED" 30 "Critical Blue LED" 31 "Critical Grey LED";
VAL_ 2655408128 Status 0 "OK" 1 "Disabled" 2 "Initializing" 3 "Heating" 4 "WB_Active" 5 "Too Cold" 6 "Too Hot" 7 "Unplugged" 8 "Slow!" 9 "Uncal Yellow" 10 "Uncal Red" 11 "Replace" 12 "Disabled" 13 "Shorted" 14 "Open" 15 "Over Range" 16 "Under Range" 17 "Undefined" 18 "Error!" 19 "Low Error" 20 "High Error" 21 "Non Critical No LED" 27 "Critical Green LED" 32 "Stall!" 33 "Synchronized" 34 "Syncing" 35 "Error!" 36 "Error!" 37 "Uncalibrated" 38 "Open Loop" 39 "Closed Loop" 40 "Not Learn" 41 "Learning" 42 "Off" 43 "On" 44 "Not Rev Limiting" 45 "Rev Limit" 46 "No Cut Off" 47 "CutOff!" 48 "Off" 49 "Warning!" 50 "Caution!" 51 "No Timing modifier" 52 "Timing is being modified" 53 "Timing Value is being replaced" 54 "Acq Sat" 55 "No GPS" 56 "No Data" 22 "Non Critical Green LED" 23 "Non Critical Yellow LED" 24 "Non Critical Red LED" 25 "Non Critical Blue LED" 26 "Non Critical Grey LED" 28 "Critical Yellow LED" 29 "Critical Red LED" 30 "Critical Blue LED" 31 "Critical Grey LED";
VAL_ 2655424512 Status 0 "OK" 1 "Disabled" 2 "Initializing" 3 "Heating" 4 "WB_Active" 5 "Too Cold" 6 "Too Hot" 7 "Unplugged" 8 "Slow!" 9 "Uncal Yellow" 10 "Uncal Red" 11 "Replace" 12 "Disabled" 13 "Shorted" 14 "Open" 15 "Over Range" 16 "Under Range" 17 "Undefined" 18 "Error!" 19 "Low Error" 20 "High Error" 21 "Non Critical No LED" 27 "Critical Green LED" 32 "Stall!" 33 "Synchronized" 34 "Syncing" 35 "Error!" 36 "Error!" 37 "Uncalibrated" 38 "Open Loop" 39 "Closed Loop" 40 "Not Learn" 41 "Learning" 42 "Off" 43 "On" 44 "Not Rev Limiting" 45 "Rev Limit" 46 "No Cut Off" 47 "CutOff!" 48 "Off" 49 "Warning!" 50 "Caution!" 51 "No Timing modifier" 52 "Timing is being modified" 53 "Timing Value is being replaced" 54 "Acq Sat" 55 "No GPS" 56 "No Data" 22 "Non Critical Green LED" 23 "Non Critical Yellow LED" 24 "Non Critical Red LED" 25 "Non Critical Blue LED" 26 "Non Critical Grey LED" 28 "Critical Yellow LED" 29 "Critical Red LED" 30 "Critical Blue LED" 31 "Critical Grey LED";
VAL_ 2655440896 Status 0 "OK" 1 "Disabled" 2 "Initializing" 3 "Heating" 4 "WB_Active" 5 "Too Cold" 6 "Too Hot" 7 "Unplugged" 8 "Slow!" 9 "Uncal Yellow" 10 "Uncal Red" 11 "Replace" 12 "Disabled" 13 "Shorted" 14 "Open" 15 "Over Range" 16 "Under Range" 17 "Undefined" 18 "Error!" 19 "Low Error" 20 "High Error" 21 "Non Critical No LED" 27 "Critical Green LED" 32 "Stall!" 33 "Synchronized" 34 "Syncing" 35 "Error!" 36 "Error!" 37 "Uncalibrated" 38 "Open Loop" 39 "Closed Loop" 40 "Not Learn" 41 "Learning" 42 "Off" 43 "On" 44 "Not Rev Limiting" 45 "Rev Limit" 46 "No Cut Off" 47 "CutOff!" 48 "Off" 49 "Warning!" 50 "Caution!" 51 "No Timing modifier" 52 "Timing is being modified" 53 "Timing Value is being replaced" 54 "Acq Sat" 55 "No GPS" 56 "No Data" 22 "Non Critical Green LED" 23 "Non Critical Yellow LED" 24 "Non Critical Red LED" 25 "Non Critical Blue LED" 26 "Non Critical Grey LED" 28 "Critical Yellow LED" 29 "Critical Red LED" 30 "Critical Blue LED" 31 "Critical Grey LED";
VAL_ 2655457280 Status 0 "OK" 1 "Disabled" 2 "Initializing" 3 "Heating" 4 "WB_Active" 5 "Too Cold" 6 "Too Hot" 7 "Unplugged" 8 "Slow!" 9 "Uncal Yellow" 10 "Uncal Red" 11 "Replace" 12 "Disabled" 13 "Shorted" 14 "Open" 15 "Over Range" 16 "Under Range" 17 "Undefined" 18 "Error!" 19 "Low Error" 20 "High Error" 21 "Non Critical No LED" 27 "Critical Green LED" 32 "Stall!" 33 "Synchronized" 34 "Syncing" 35 "Error!" 36 "Error!" 37 "Uncalibrated" 38 "Open Loop" 39 "Closed Loop" 40 "Not Learn" 41 "Learning" 42 "Off" 43 "On" 44 "Not Rev Limiting" 45 "Rev Limit" 46 "No Cut Off" 47 "CutOff!" 48 "Off" 49 "Warning!" 50 "Caution!" 51 "No Timing modifier" 52 "Timing is being modified" 53 "Timing Value is being replaced" 54 "Acq Sat" 55 "No GPS" 56 "No Data" 22 "Non Critical Green LED" 23 "Non Critical Yellow LED" 24 "Non Critical Red LED" 25 "Non Critical Blue LED" 26 "Non Critical Grey LED" 28 "Critical Yellow LED" 29 "Critical Red LED" 30 "Critical Blue LED" 31 "Critical Grey LED";
VAL_ 2655473664 Status 0 "OK" 1 "Disabled" 2 "Initializing" 3 "Heating" 4 "WB_Active" 5 "Too Cold" 6 "Too Hot" 7 "Unplugged" 8 "Slow!" 9 "Uncal Yellow" 10 "Uncal Red" 11 "Replace" 12 "Disabled" 13 "Shorted" 14 "Open" 15 "Over Range" 16 "Under Range" 17 "Undefined" 18 "Error!" 19 "Low Error" 20 "High Error" 21 "Non Critical No LED" 27 "Critical Green LED" 32 "Stall!" 33 "Synchronized" 34 "Syncing" 35 "Error!" 36 "Error!" 37 "Uncalibrated" 38 "Open Loop" 39 "Closed Loop" 40 "Not Learn" 41 "Learning" 42 "Off" 43 "On" 44 "Not Rev Limiting" 45 "Rev Limit" 46 "No Cut Off" 47 "CutOff!" 48 "Off" 49 "Warning!" 50 "Caution!" 51 "No Timing modifier" 52 "Timing is being modified" 53 "Timing Value is being replaced" 54 "Acq Sat" 55 "No GPS" 56 "No Data" 22 "Non Critical Green LED" 23 "Non Critical Yellow LED" 24 "Non Critical Red LED" 25 "Non Critical Blue LED" 26 "Non Critical Grey LED" 28 "Critical Yellow LED" 29 "Critical Red LED" 30 "Critical Blue LED" 31 "Critical Grey LED";
VAL_ 2655490048 Status 0 "OK" 1 "Disabled" 2 "Initializing" 3 "Heating" 4 "WB_Active" 5 "Too Cold" 6 "Too Hot" 7 "Unplugged" 8 "Slow!" 9 "Uncal Yellow" 10 "Uncal Red" 11 "Replace" 12 "Disabled" 13 "Shorted" 14 "Open" 15 "Over Range" 16 "Under Range" 17 "Undefined" 18 "Error!" 19 "Low Error" 20 "High Error" 21 "Non Critical No LED" 27 "Critical Green LED" 32 "Stall!" 33 "Synchronized" 34 "Syncing" 35 "Error!" 36 "Error!" 37 "Uncalibrated" 38 "Open Loop" 39 "Closed Loop" 40 "Not Learn" 41 "Learning" 42 "Off" 43 "On" 44 "Not Rev Limiting" 45 "Rev Limit" 46 "No Cut Off" 47 "CutOff!" 48 "Off" 49 "Warning!" 50 "Caution!" 51 "No Timing modifier" 52 "Timing is being modified" 53 "Timing Value is being replaced" 54 "Acq Sat" 55 "No GPS" 56 "No Data" 22 "Non Critical Green LED" 23 "Non Critical Yellow LED" 24 "Non Critical Red LED" 25 "Non Critical Blue LED" 26 "Non Critical Grey LED" 28 "Critical Yellow LED" 29 "Critical Red LED" 30 "Critical Blue LED" 31 "Critical Grey LED";
VAL_ 2655506432 Status 0 "OK" 1 "Disabled" 2 "Initializing" 3 "Heating" 4 "WB_Active" 5 "Too Cold" 6 "Too Hot" 7 "Unplugged" 8 "Slow!" 9 "Uncal Yellow" 10 "Uncal Red" 11 "Replace" 12 "Disabled" 13 "Shorted" 14 "Open" 15 "Over Range" 16 "Under Range" 17 "Undefined" 18 "Error!" 19 "Low Error" 20 "High Error" 21 "Non Critical No LED" 27 "Critical Green LED" 32 "Stall!" 33 "Synchronized" 34 "Syncing" 35 "Error!" 36 "Error!" 37 "Uncalibrated" 38 "Open Loop" 39 "Closed Loop" 40 "Not Learn" 41 "Learning" 42 "Off" 43 "On" 44 "Not Rev Limiting" 45 "Rev Limit" 46 "No Cut Off" 47 "CutOff!" 48 "Off" 49 "Warning!" 50 "Caution!" 51 "No Timing modifier" 52 "Timing is being modified" 53 "Timing Value is being replaced" 54 "Acq Sat" 55 "No GPS" 56 "No Data" 22 "Non Critical Green LED" 23 "Non Critical Yellow LED" 24 "Non Critical Red LED" 25 "Non Critical Blue LED" 26 "Non Critical Grey LED" 28 "Critical Yellow LED" 29 "Critical Red LED" 30 "Critical Blue LED" 31 "Critical Grey LED";
VAL_ 2655522816 Status 0 "OK" 1 "Disabled" 2 "Initializing" 3 "Heating" 4 "WB_Active" 5 "Too Cold" 6 "Too Hot" 7 "Unplugged" 8 "Slow!" 9 "Uncal Yellow" 10 "Uncal Red" 11 "Replace" 12 "Disabled" 13 "Shorted" 14 "Open" 15 "Over Range" 16 "Under Range" 17 "Undefined" 18 "Error!" 19 "Low Error" 20 "High Error" 21 "Non Critical No LED" 27 "Critical Green LED" 32 "Stall!" 33 "Synchronized" 34 "Syncing" 35 "Error!" 36 "Error!" 37 "Uncalibrated" 38 "Open Loop" 39 "Closed Loop" 40 "Not Learn" 41 "Learning" 42 "Off" 43 "On" 44 "Not Rev Limiting" 45 "Rev Limit" 46 "No Cut Off" 47 "CutOff!" 48 "Off" 49 "Warning!" 50 "Caution!" 51 "No Timing modifier" 52 "Timing is being modified" 53 "Timing Value is being replaced" 54 "Acq Sat" 55 "No GPS" 56 "No Data" 22 "Non Critical Green LED" 23 "Non Critical Yellow LED" 24 "Non Critical Red LED" 25 "Non Critical Blue LED" 26 "Non Critical Grey LED" 28 "Critical Yellow LED" 29 "Critical Red LED" 30 "Critical Blue LED" 31 "Critical Grey LED";
VAL_ 2655539200 Status 0 "OK" 1 "Disabled" 2 "Initializing" 3 "Heating" 4 "WB_Active" 5 "Too Cold" 6 "Too Hot" 7 "Unplugged" 8 "Slow!" 9 "Uncal Yellow" 10 "Uncal Red" 11 "Replace" 12 "Disabled" 13 "Shorted" 14 "Open" 15 "Over Range" 16 "Under Range" 17 "Undefined" 18 "Error!" 19 "Low Error" 20 "High Error" 21 "Non Critical No LED" 27 "Critical Green LED" 32 "Stall!" 33 "Synchronized" 34 "Syncing" 35 "Error!" 36 "Error!" 37 "Uncalibrated" 38 "Open Loop" 39 "Closed Loop" 40 "Not Learn" 41 "Learning" 42 "Off" 43 "On" 44 "Not Rev Limiting" 45 "Rev Limit" 46 "No Cut Off" 47 "CutOff!" 48 "Off" 49 "Warning!" 50 "Caution!" 51 "No Timing modifier" 52 "Timing is being modified" 53 "Timing Value is being replaced" 54 "Acq Sat" 55 "No GPS" 56 "No Data" 22 "Non Critical Green LED" 23 "Non Critical Yellow LED" 24 "Non Critical Red LED" 25 "Non Critical Blue LED" 26 "Non Critical Grey LED" 28 "Critical Yellow LED" 29 "Critical Red LED" 30 "Critical Blue LED" 31 "Critical Grey LED";
VAL_ 2655555584 Status 0 "OK" 1 "Disabled" 2 "Initializing" 3 "Heating" 4 "WB_Active" 5 "Too Cold" 6 "Too Hot" 7 "Unplugged" 8 "Slow!" 9 "Uncal Yellow" 10 "Uncal Red" 11 "Replace" 12 "Disabled" 13 "Shorted" 14 "Open" 15 "Over Range" 16 "Under Range" 17 "Undefined" 18 "Error!" 19 "Low Error" 20 "High Error" 21 "Non Critical No LED" 27 "Critical Green LED" 32 "Stall!" 33 "Synchronized" 34 "Syncing" 35 "Error!" 36 "Error!" 37 "Uncalibrated" 38 "Open Loop" 39 "Closed Loop" 40 "Not Learn" 41 "Learning" 42 "Off" 43 "On" 44 "Not Rev Limiting" 45 "Rev Limit" 46 "No Cut Off" 47 "CutOff!" 48 "Off" 49 "Warning!" 50 "Caution!" 51 "No Timing modifier" 52 "Timing is being modified" 53 "Timing Value is being replaced" 54 "Acq Sat" 55 "No GPS" 56 "No Data" 22 "Non Critical Green LED" 23 "Non Critical Yellow LED" 24 "Non Critical Red LED" 25 "Non Critical Blue LED" 26 "Non Critical Grey LED" 28 "Critical Yellow LED" 29 "Critical Red LED" 30 "Critical Blue LED" 31 "Critical Grey LED";
VAL_ 2655571968 Status 0 "OK" 1 "Disabled" 2 "Initializing" 3 "Heating" 4 "WB_Active" 5 "Too Cold" 6 "Too Hot" 7 "Unplugged" 8 "Slow!" 9 "Uncal Yellow" 10 "Uncal Red" 11 "Replace" 12 "Disabled" 13 "Shorted" 14 "Open" 15 "Over Range" 16 "Under Range" 17 "Undefined" 18 "Error!" 19 "Low Error" 20 "High Error" 21 "Non Critical No LED" 27 "Critical Green LED" 32 "Stall!" 33 "Synchronized" 34 "Syncing" 35 "Error!" 36 "Error!" 37 "Uncalibrated" 38 "Open Loop" 39 "Closed Loop" 40 "Not Learn" 41 "Learning" 42 "Off" 43 "On" 44 "Not Rev Limiting" 45 "Rev Limit" 46 "No Cut Off" 47 "CutOff!" 48 "Off" 49 "Warning!" 50 "Caution!" 51 "No Timing modifier" 52 "Timing is being modified" 53 "Timing Value is being replaced" 54 "Acq Sat" 55 "No GPS" 56 "No Data" 22 "Non Critical Green LED" 23 "Non Critical Yellow LED" 24 "Non Critical Red LED" 25 "Non Critical Blue LED" 26 "Non Critical Grey LED" 28 "Critical Yellow LED" 29 "Critical Red LED" 30 "Critical Blue LED" 31 "Critical Grey LED";
VAL_ 2655588352 Status 0 "OK" 1 "Disabled" 2 "Initializing" 3 "Heating" 4 "WB_Active" 5 "Too Cold" 6 "Too Hot" 7 "Unplugged" 8 "Slow!" 9 "Uncal Yellow" 10 "Uncal Red" 11 "Replace" 12 "Disabled" 13 "Shorted" 14 "Open" 15 "Over Range" 16 "Under Range" 17 "Undefined" 18 "Error!" 19 "Low Error" 20 "High Error" 21 "Non Critical No LED" 27 "Critical Green LED" 32 "Stall!" 33 "Synchronized" 34 "Syncing" 35 "Error!" 36 "Error!" 37 "Uncalibrated" 38 "Open Loop" 39 "Closed Loop" 40 "Not Learn" 41 "Learning" 42 "Off" 43 "On" 44 "Not Rev Limiting" 45 "Rev Limit" 46 "No Cut Off" 47 "CutOff!" 48 "Off" 49 "Warning!" 50 "Caution!" 51 "No Timing modifier" 52 "Timing is being modified" 53 "Timing Value is being replaced" 54 "Acq Sat" 55 "No GPS" 56 "No Data" 22 "Non Critical Green LED" 23 "Non Critical Yellow LED" 24 "Non Critical Red LED" 25 "Non Critical Blue LED" 26 "Non Critical Grey LED" 28 "Critical Yellow LED" 29 "Critical Red LED" 30 "Critical Blue LED" 31 "Critical Grey LED";
VAL_ 2655604736 Status 0 "OK" 1 "Disabled" 2 "Initializing" 3 "Heating" 4 "WB_Active" 5 "Too Cold" 6 "Too Hot" 7 "Unplugged" 8 "Slow!" 9 "Uncal Yellow" 10 "Uncal Red" 11 "Replace" 12 "Disabled" 13 "Shorted" 14 "Open" 15 "Over Range" 16 "Under Range" 17 "Undefined" 18 "Error!" 19 "Low Error" 20 "High Error" 21 "Non Critical No LED" 27 "Critical Green LED" 32 "Stall!" 33 "Synchronized" 34 "Syncing" 35 "Error!" 36 "Error!" 37 "Uncalibrated" 38 "Open Loop" 39 "Closed Loop" 40 "Not Learn" 41 "Learning" 42 "Off" 43 "On" 44 "Not Rev Limiting" 45 "Rev Limit" 46 "No Cut Off" 47 "CutOff!" 48 "Off" 49 "Warning!" 50 "Caution!" 51 "No Timing modifier" 52 "Timing is being modified" 53 "Timing Value is being replaced" 54 "Acq Sat" 55 "No GPS" 56 "No Data" 22 "Non Critical Green LED" 23 "Non Critical Yellow LED" 24 "Non Critical Red LED" 25 "Non Critical Blue LED" 26 "Non Critical Grey LED" 28 "Critical Yellow LED" 29 "Critical Red LED" 30 "Critical Blue LED" 31 "Critical Grey LED";
VAL_ 2655621120 Status 0 "OK" 1 "Disabled" 2 "Initializing" 3 "Heating" 4 "WB_Active" 5 "Too Cold" 6 "Too Hot" 7 "Unplugged" 8 "Slow!" 9 "Uncal Yellow" 10 "Uncal Red" 11 "Replace" 12 "Disabled" 13 "Shorted" 14 "Open" 15 "Over Range" 16 "Under Range" 17 "Undefined" 18 "Error!" 19 "Low Error" 20 "High Error" 21 "Non Critical No LED" 27 "Critical Green LED" 32 "Stall!" 33 "Synchronized" 34 "Syncing" 35 "Error!" 36 "Error!" 37 "Uncalibrated" 38 "Open Loop" 39 "Closed Loop" 40 "Not Learn" 41 "Learning" 42 "Off" 43 "On" 44 "Not Rev Limiting" 45 "Rev Limit" 46 "No Cut Off" 47 "CutOff!" 48 "Off" 49 "Warning!" 50 "Caution!" 51 "No Timing modifier" 52 "Timing is being modified" 53 "Timing Value is being replaced" 54 "Acq Sat" 55 "No GPS" 56 "No Data" 22 "Non Critical Green LED" 23 "Non Critical Yellow LED" 24 "Non Critical Red LED" 25 "Non Critical Blue LED" 26 "Non Critical Grey LED" 28 "Critical Yellow LED" 29 "Critical Red LED" 30 "Critical Blue LED" 31 "Critical Grey LED";
VAL_ 2655637504 Status 0 "OK" 1 "Disabled" 2 "Initializing" 3 "Heating" 4 "WB_Active" 5 "Too Cold" 6 "Too Hot" 7 "Unplugged" 8 "Slow!" 9 "Uncal Yellow" 10 "Uncal Red" 11 "Replace" 12 "Disabled" 13 "Shorted" 14 "Open" 15 "Over Range" 16 "Under Range" 17 "Undefined" 18 "Error!" 19 "Low Error" 20 "High Error" 21 "Non Critical No LED" 27 "Critical Green LED" 32 "Stall!" 33 "Synchronized" 34 "Syncing" 35 "Error!" 36 "Error!" 37 "Uncalibrated" 38 "Open Loop" 39 "Closed Loop" 40 "Not Learn" 41 "Learning" 42 "Off" 43 "On" 44 "Not Rev Limiting" 45 "Rev Limit" 46 "No Cut Off" 47 "CutOff!" 48 "Off" 49 "Warning!" 50 "Caution!" 51 "No Timing modifier" 52 "Timing is being modified" 53 "Timing Value is being replaced" 54 "Acq Sat" 55 "No GPS" 56 "No Data" 22 "Non Critical Green LED" 23 "Non Critical Yellow LED" 24 "Non Critical Red LED" 25 "Non Critical Blue LED" 26 "Non Critical Grey LED" 28 "Critical Yellow LED" 29 "Critical Red LED" 30 "Critical Blue LED" 31 "Critical Grey LED";
VAL_ 2655653888 Status 0 "OK" 1 "Disabled" 2 "Initializing" 3 "Heating" 4 "WB_Active" 5 "Too Cold" 6 "Too Hot" 7 "Unplugged" 8 "Slow!" 9 "Uncal Yellow" 10 "Uncal Red" 11 "Replace" 12 "Disabled" 13 "Shorted" 14 "Open" 15 "Over Range" 16 "Under Range" 17 "Undefined" 18 "Error!" 19 "Low Error" 20 "High Error" 21 "Non Critical No LED" 27 "Critical Green LED" 32 "Stall!" 33 "Synchronized" 34 "Syncing" 35 "Error!" 36 "Error!" 37 "Uncalibrated" 38 "Open Loop" 39 "Closed Loop" 40 "Not Learn" 41 "Learning" 42 "Off" 43 "On" 44 "Not Rev Limiting" 45 "Rev Limit" 46 "No Cut Off" 47 "CutOff!" 48 "Off" 49 "Warning!" 50 "Caution!" 51 "No Timing modifier" 52 "Timing is being modified" 53 "Timing Value is being replaced" 54 "Acq Sat" 55 "No GPS" 56 "No Data" 22 "Non Critical Green LED" 23 "Non Critical Yellow LED" 24 "Non Critical Red LED" 25 "Non Critical Blue LED" 26 "Non Critical Grey LED" 28 "Critical Yellow LED" 29 "Critical Red LED" 30 "Critical Blue LED" 31 "Critical Grey LED";
VAL_ 2655670272 Status 0 "OK" 1 "Disabled" 2 "Initializing" 3 "Heating" 4 "WB_Active" 5 "Too Cold" 6 "Too Hot" 7 "Unplugged" 8 "Slow!" 9 "Uncal Yellow" 10 "Uncal Red" 11 "Replace" 12 "Disabled" 13 "Shorted" 14 "Open" 15 "Over Range" 16 "Under Range" 17 "Undefined" 18 "Error!" 19 "Low Error" 20 "High Error" 21 "Non Critical No LED" 27 "Critical Green LED" 32 "Stall!" 33 "Synchronized" 34 "Syncing" 35 "Error!" 36 "Error!" 37 "Uncalibrated" 38 "Open Loop" 39 "Closed Loop" 40 "Not Learn" 41 "Learning" 42 "Off" 43 "On" 44 "Not Rev Limiting" 45 "Rev Limit" 46 "No Cut Off" 47 "CutOff!" 48 "Off" 49 "Warning!" 50 "Caution!" 51 "No Timing modifier" 52 "Timing is being modified" 53 "Timing Value is being replaced" 54 "Acq Sat" 55 "No GPS" 56 "No Data" 22 "Non Critical Green LED" 23 "Non Critical Yellow LED" 24 "Non Critical Red LED" 25 "Non Critical Blue LED" 26 "Non Critical Grey LED" 28 "Critical Yellow LED" 29 "Critical Red LED" 30 "Critical Blue LED" 31 "Critical Grey LED";
VAL_ 2655686656 Status 0 "OK" 1 "Disabled" 2 "Initializing" 3 "Heating" 4 "WB_Active" 5 "Too Cold" 6 "Too Hot" 7 "Unplugged" 8 "Slow!" 9 "Uncal Yellow" 10 "Uncal Red" 11 "Replace" 12 "Disabled" 13 "Shorted" 14 "Open" 15 "Over Range" 16 "Under Range" 17 "Undefined" 18 "Error!" 19 "Low Error" 20 "High Error" 21 "Non Critical No LED" 27 "Critical Green LED" 32 "Stall!" 33 "Synchronized" 34 "Syncing" 35 "Error!" 36 "Error!" 37 "Uncalibrated" 38 "Open Loop" 39 "Closed Loop" 40 "Not Learn" 41 "Learning" 42 "Off" 43 "On" 44 "Not Rev Limiting" 45 "Rev Limit" 46 "No Cut Off" 47 "CutOff!" 48 "Off" 49 "Warning!" 50 "Caution!" 51 "No Timing modifier" 52 "Timing is being modified" 53 "Timing Value is being replaced" 54 "Acq Sat" 55 "No GPS" 56 "No Data" 22 "Non Critical Green LED" 23 "Non Critical Yellow LED" 24 "Non Critical Red LED" 25 "Non Critical Blue LED" 26 "Non Critical Grey LED" 28 "Critical Yellow LED" 29 "Critical Red LED" 30 "Critical Blue LED" 31 "Critical Grey LED";
VAL_ 2655703040 Status 0 "OK" 1 "Disabled" 2 "Initializing" 3 "Heating" 4 "WB_Active" 5 "Too Cold" 6 "Too Hot" 7 "Unplugged" 8 "Slow!" 9 "Uncal Yellow" 10 "Uncal Red" 11 "Replace" 12 "Disabled" 13 "Shorted" 14 "Open" 15 "Over Range" 16 "Under Range" 17 "Undefined" 18 "Error!" 19 "Low Error" 20 "High Error" 21 "Non Critical No LED" 27 "Critical Green LED" 32 "Stall!" 33 "Synchronized" 34 "Syncing" 35 "Error!" 36 "Error!" 37 "Uncalibrated" 38 "Open Loop" 39 "Closed Loop" 40 "Not Learn" 41 "Learning" 42 "Off" 43 "On" 44 "Not Rev Limiting" 45 "Rev Limit" 46 "No Cut Off" 47 "CutOff!" 48 "Off" 49 "Warning!" 50 "Caution!" 51 "No Timing modifier" 52 "Timing is being modified" 53 "Timing Value is being replaced" 54 "Acq Sat" 55 "No GPS" 56 "No Data" 22 "Non Critical Green LED" 23 "Non Critical Yellow LED" 24 "Non Critical Red LED" 25 "Non Critical Blue LED" 26 "Non Critical Grey LED" 28 "Critical Yellow LED" 29 "Critical Red LED" 30 "Critical Blue LED" 31 "Critical Grey LED";
VAL_ 2655719424 Status 0 "OK" 1 "Disabled" 2 "Initializing" 3 "Heating" 4 "WB_Active" 5 "Too Cold" 6 "Too Hot" 7 "Unplugged" 8 "Slow!" 9 "Uncal Yellow" 10 "Uncal Red" 11 "Replace" 12 "Disabled" 13 "Shorted" 14 "Open" 15 "Over Range" 16 "Under Range" 17 "Undefined" 18 "Error!" 19 "Low Error" 20 "High Error" 21 "Non Critical No LED" 27 "Critical Green LED" 32 "Stall!" 33 "Synchronized" 34 "Syncing" 35 "Error!" 36 "Error!" 37 "Uncalibrated" 38 "Open Loop" 39 "Closed Loop" 40 "Not Learn" 41 "Learning" 42 "Off" 43 "On" 44 "Not Rev Limiting" 45 "Rev Limit" 46 "No Cut Off" 47 "CutOff!" 48 "Off" 49 "Warning!" 50 "Caution!" 51 "No Timing modifier" 52 "Timing is being modified" 53 "Timing Value is being replaced" 54 "Acq Sat" 55 "No GPS" 56 "No Data" 22 "Non Critical Green LED" 23 "Non Critical Yellow LED" 24 "Non Critical Red LED" 25 "Non Critical Blue LED" 26 "Non Critical Grey LED" 28 "Critical Yellow LED" 29 "Critical Red LED" 30 "Critical Blue LED" 31 "Critical Grey LED";
VAL_ 2655735808 Status 0 "OK" 1 "Disabled" 2 "Initializing" 3 "Heating" 4 "WB_Active" 5 "Too Cold" 6 "Too Hot" 7 "Unplugged" 8 "Slow!" 9 "Uncal Yellow" 10 "Uncal Red" 11 "Replace" 12 "Disabled" 13 "Shorted" 14 "Open" 15 "Over Range" 16 "Under Range" 17 "Undefined" 18 "Error!" 19 "Low Error" 20 "High Error" 21 "Non Critical No LED" 27 "Critical Green LED" 32 "Stall!" 33 "Synchronized" 34 "Syncing" 35 "Error!" 36 "Error!" 37 "Uncalibrated" 38 "Open Loop" 39 "Closed Loop" 40 "Not Learn" 41 "Learning" 42 "Off" 43 "On" 44 "Not Rev Limiting" 45 "Rev Limit" 46 "No Cut Off" 47 "CutOff!" 48 "Off" 49 "Warning!" 50 "Caution!" 51 "No Timing modifier" 52 "Timing is being modified" 53 "Timing Value is being replaced" 54 "Acq Sat" 55 "No GPS" 56 "No Data" 22 "Non Critical Green LED" 23 "Non Critical Yellow LED" 24 "Non Critical Red LED" 25 "Non Critical Blue LED" 26 "Non Critical Grey LED" 28 "Critical Yellow LED" 29 "Critical Red LED" 30 "Critical Blue LED" 31 "Critical Grey LED";
VAL_ 2655752192 Status 0 "OK" 1 "Disabled" 2 "Initializing" 3 "Heating" 4 "WB_Active" 5 "Too Cold" 6 "Too Hot" 7 "Unplugged" 8 "Slow!" 9 "Uncal Yellow" 10 "Uncal Red" 11 "Replace" 12 "Disabled" 13 "Shorted" 14 "Open" 15 "Over Range" 16 "Under Range" 17 "Undefined" 18 "Error!" 19 "Low Error" 20 "High Error" 21 "Non Critical No LED" 27 "Critical Green LED" 32 "Stall!" 33 "Synchronized" 34 "Syncing" 35 "Error!" 36 "Error!" 37 "Uncalibrated" 38 "Open Loop" 39 "Closed Loop" 40 "Not Learn" 41 "Learning" 42 "Off" 43 "On" 44 "Not Rev Limiting" 45 "Rev Limit" 46 "No Cut Off" 47 "CutOff!" 48 "Off" 49 "Warning!" 50 "Caution!" 51 "No Timing modifier" 52 "Timing is being modified" 53 "Timing Value is being replaced" 54 "Acq Sat" 55 "No GPS" 56 "No Data" 22 "Non Critical Green LED" 23 "Non Critical Yellow LED" 24 "Non Critical Red LED" 25 "Non Critical Blue LED" 26 "Non Critical Grey LED" 28 "Critical Yellow LED" 29 "Critical Red LED" 30 "Critical Blue LED" 31 "Critical Grey LED";
VAL_ 2655768576 Status 0 "OK" 1 "Disabled" 2 "Initializing" 3 "Heating" 4 "WB_Active" 5 "Too Cold" 6 "Too Hot" 7 "Unplugged" 8 "Slow!" 9 "Uncal Yellow" 10 "Uncal Red" 11 "Replace" 12 "Disabled" 13 "Shorted" 14 "Open" 15 "Over Range" 16 "Under Range" 17 "Undefined" 18 "Error!" 19 "Low Error" 20 "High Error" 21 "Non Critical No LED" 27 "Critical Green LED" 32 "Stall!" 33 "Synchronized" 34 "Syncing" 35 "Error!" 36 "Error!" 37 "Uncalibrated" 38 "Open Loop" 39 "Closed Loop" 40 "Not Learn" 41 "Learning" 42 "Off" 43 "On" 44 "Not Rev Limiting" 45 "Rev Limit" 46 "No Cut Off" 47 "CutOff!" 48 "Off" 49 "Warning!" 50 "Caution!" 51 "No Timing modifier" 52 "Timing is being modified" 53 "Timing Value is being replaced" 54 "Acq Sat" 55 "No GPS" 56 "No Data" 22 "Non Critical Green LED" 23 "Non Critical Yellow LED" 24 "Non Critical Red LED" 25 "Non Critical Blue LED" 26 "Non Critical Grey LED" 28 "Critical Yellow LED" 29 "Critical Red LED" 30 "Critical Blue LED" 31 "Critical Grey LED";
VAL_ 2655784960 Status 0 "OK" 1 "Disabled" 2 "Initializing" 3 "Heating" 4 "WB_Active" 5 "Too Cold" 6 "Too Hot" 7 "Unplugged" 8 "Slow!" 9 "Uncal Yellow" 10 "Uncal Red" 11 "Replace" 12 "Disabled" 13 "Shorted" 14 "Open" 15 "Over Range" 16 "Under Range" 17 "Undefined" 18 "Error!" 19 "Low Error" 20 "High Error" 21 "Non Critical No LED" 27 "Critical Green LED" 32 "Stall!" 33 "Synchronized" 34 "Syncing" 35 "Error!" 36 "Error!" 37 "Uncalibrated" 38 "Open Loop" 39 "Closed Loop" 40 "Not Learn" 41 "Learning" 42 "Off" 43 "On" 44 "Not Rev Limiting" 45 "Rev Limit" 46 "No Cut Off" 47 "CutOff!" 48 "Off" 49 "Warning!" 50 "Caution!" 51 "No Timing modifier" 52 "Timing is being modified" 53 "Timing Value is being replaced" 54 "Acq Sat" 55 "No GPS" 56 "No Data" 22 "Non Critical Green LED" 23 "Non Critical Yellow LED" 24 "Non Critical Red LED" 25 "Non Critical Blue LED" 26 "Non Critical Grey LED" 28 "Critical Yellow LED" 29 "Critical Red LED" 30 "Critical Blue LED" 31 "Critical Grey LED";
VAL_ 2655801344 Status 0 "OK" 1 "Disabled" 2 "Initializing" 3 "Heating" 4 "WB_Active" 5 "Too Cold" 6 "Too Hot" 7 "Unplugged" 8 "Slow!" 9 "Uncal Yellow" 10 "Uncal Red" 11 "Replace" 12 "Disabled" 13 "Shorted" 14 "Open" 15 "Over Range" 16 "Under Range" 17 "Undefined" 18 "Error!" 19 "Low Error" 20 "High Error" 21 "Non Critical No LED" 27 "Critical Green LED" 32 "Stall!" 33 "Synchronized" 34 "Syncing" 35 "Error!" 36 "Error!" 37 "Uncalibrated" 38 "Open Loop" 39 "Closed Loop" 40 "Not Learn" 41 "Learning" 42 "Off" 43 "On" 44 "Not Rev Limiting" 45 "Rev Limit" 46 "No Cut Off" 47 "CutOff!" 48 "Off" 49 "Warning!" 50 "Caution!" 51 "No Timing modifier" 52 "Timing is being modified" 53 "Timing Value is being replaced" 54 "Acq Sat" 55 "No GPS" 56 "No Data" 22 "Non Critical Green LED" 23 "Non Critical Yellow LED" 24 "Non Critical Red LED" 25 "Non Critical Blue LED" 26 "Non Critical Grey LED" 28 "Critical Yellow LED" 29 "Critical Red LED" 30 "Critical Blue LED" 31 "Critical Grey LED";
VAL_ 2655817728 Status 0 "OK" 1 "Disabled" 2 "Initializing" 3 "Heating" 4 "WB_Active" 5 "Too Cold" 6 "Too Hot" 7 "Unplugged" 8 "Slow!" 9 "Uncal Yellow" 10 "Uncal Red" 11 "Replace" 12 "Disabled" 13 "Shorted" 14 "Open" 15 "Over Range" 16 "Under Range" 17 "Undefined" 18 "Error!" 19 "Low Error" 20 "High Error" 21 "Non Critical No LED" 27 "Critical Green LED" 32 "Stall!" 33 "Synchronized" 34 "Syncing" 35 "Error!" 36 "Error!" 37 "Uncalibrated" 38 "Open Loop" 39 "Closed Loop" 40 "Not Learn" 41 "Learning" 42 "Off" 43 "On" 44 "Not Rev Limiting" 45 "Rev Limit" 46 "No Cut Off" 47 "CutOff!" 48 "Off" 49 "Warning!" 50 "Caution!" 51 "No Timing modifier" 52 "Timing is being modified" 53 "Timing Value is being replaced" 54 "Acq Sat" 55 "No GPS" 56 "No Data" 22 "Non Critical Green LED" 23 "Non Critical Yellow LED" 24 "Non Critical Red LED" 25 "Non Critical Blue LED" 26 "Non Critical Grey LED" 28 "Critical Yellow LED" 29 "Critical Red LED" 30 "Critical Blue LED" 31 "Critical Grey LED";
VAL_ 2655834112 Status 0 "OK" 1 "Disabled" 2 "Initializing" 3 "Heating" 4 "WB_Active" 5 "Too Cold" 6 "Too Hot" 7 "Unplugged" 8 "Slow!" 9 "Uncal Yellow" 10 "Uncal Red" 11 "Replace" 12 "Disabled" 13 "Shorted" 14 "Open" 15 "Over Range" 16 "Under Range" 17 "Undefined" 18 "Error!" 19 "Low Error" 20 "High Error" 21 "Non Critical No LED" 27 "Critical Green LED" 32 "Stall!" 33 "Synchronized" 34 "Syncing" 35 "Error!" 36 "Error!" 37 "Uncalibrated" 38 "Open Loop" 39 "Closed Loop" 40 "Not Learn" 41 "Learning" 42 "Off" 43 "On" 44 "Not Rev Limiting" 45 "Rev Limit" 46 "No Cut Off" 47 "CutOff!" 48 "Off" 49 "Warning!" 50 "Caution!" 51 "No Timing modifier" 52 "Timing is being modified" 53 "Timing Value is being replaced" 54 "Acq Sat" 55 "No GPS" 56 "No Data" 22 "Non Critical Green LED" 23 "Non Critical Yellow LED" 24 "Non Critical Red LED" 25 "Non Critical Blue LED" 26 "Non Critical Grey LED" 28 "Critical Yellow LED" 29 "Critical Red LED" 30 "Critical Blue LED" 31 "Critical Grey LED";
VAL_ 2655850496 Status 0 "OK" 1 "Disabled" 2 "Initializing" 3 "Heating" 4 "WB_Active" 5 "Too Cold" 6 "Too Hot" 7 "Unplugged" 8 "Slow!" 9 "Uncal Yellow" 10 "Uncal Red" 11 "Replace" 12 "Disabled" 13 "Shorted" 14 "Open" 15 "Over Range" 16 "Under Range" 17 "Undefined" 18 "Error!" 19 "Low Error" 20 "High Error" 21 "Non Critical No LED" 27 "Critical Green LED" 32 "Stall!" 33 "Synchronized" 34 "Syncing" 35 "Error!" 36 "Error!" 37 "Uncalibrated" 38 "Open Loop" 39 "Closed Loop" 40 "Not Learn" 41 "Learning" 42 "Off" 43 "On" 44 "Not Rev Limiting" 45 "Rev Limit" 46 "No Cut Off" 47 "CutOff!" 48 "Off" 49 "Warning!" 50 "Caution!" 51 "No Timing modifier" 52 "Timing is being modified" 53 "Timing Value is being replaced" 54 "Acq Sat" 55 "No GPS" 56 "No Data" 22 "Non Critical Green LED" 23 "Non Critical Yellow LED" 24 "Non Critical Red LED" 25 "Non Critical Blue LED" 26 "Non Critical Grey LED" 28 "Critical Yellow LED" 29 "Critical Red LED" 30 "Critical Blue LED" 31 "Critical Grey LED";
VAL_ 2655866880 Status 0 "OK" 1 "Disabled" 2 "Initializing" 3 "Heating" 4 "WB_Active" 5 "Too Cold" 6 "Too Hot" 7 "Unplugged" 8 "Slow!" 9 "Uncal Yellow" 10 "Uncal Red" 11 "Replace" 12 "Disabled" 13 "Shorted" 14 "Open" 15 "Over Range" 16 "Under Range" 17 "Undefined" 18 "Error!" 19 "Low Error" 20 "High Error" 21 "Non Critical No LED" 27 "Critical Green LED" 32 "Stall!" 33 "Synchronized" 34 "Syncing" 35 "Error!" 36 "Error!" 37 "Uncalibrated" 38 "Open Loop" 39 "Closed Loop" 40 "Not Learn" 41 "Learning" 42 "Off" 43 "On" 44 "Not Rev Limiting" 45 "Rev Limit" 46 "No Cut Off" 47 "CutOff!" 48 "Off" 49 "Warning!" 50 "Caution!" 51 "No Timing modifier" 52 "Timing is being modified" 53 "Timing Value is being replaced" 54 "Acq Sat" 55 "No GPS" 56 "No Data" 22 "Non Critical Green LED" 23 "Non Critical Yellow LED" 24 "Non Critical Red LED" 25 "Non Critical Blue LED" 26 "Non Critical Grey LED" 28 "Critical Yellow LED" 29 "Critical Red LED" 30 "Critical Blue LED" 31 "Critical Grey LED";
VAL_ 2655883264 Status 0 "OK" 1 "Disabled" 2 "Initializing" 3 "Heating" 4 "WB_Active" 5 "Too Cold" 6 "Too Hot" 7 "Unplugged" 8 "Slow!" 9 "Uncal Yellow" 10 "Uncal Red" 11 "Replace" 12 "Disabled" 13 "Shorted" 14 "Open" 15 "Over Range" 16 "Under Range" 17 "Undefined" 18 "Error!" 19 "Low Error" 20 "High Error" 21 "Non Critical No LED" 27 "Critical Green LED" 32 "Stall!" 33 "Synchronized" 34 "Syncing" 35 "Error!" 36 "Error!" 37 "Uncalibrated" 38 "Open Loop" 39 "Closed Loop" 40 "Not Learn" 41 "Learning" 42 "Off" 43 "On" 44 "Not Rev Limiting" 45 "Rev Limit" 46 "No Cut Off" 47 "CutOff!" 48 "Off" 49 "Warning!" 50 "Caution!" 51 "No Timing modifier" 52 "Timing is being modified" 53 "Timing Value is being replaced" 54 "Acq Sat" 55 "No GPS" 56 "No Data" 22 "Non Critical Green LED" 23 "Non Critical Yellow LED" 24 "Non Critical Red LED" 25 "Non Critical Blue LED" 26 "Non Critical Grey LED" 28 "Critical Yellow LED" 29 "Critical Red LED" 30 "Critical Blue LED" 31 "Critical Grey LED";
VAL_ 2655899648 Status 0 "OK" 1 "Disabled" 2 "Initializing" 3 "Heating" 4 "WB_Active" 5 "Too Cold" 6 "Too Hot" 7 "Unplugged" 8 "Slow!" 9 "Uncal Yellow" 10 "Uncal Red" 11 "Replace" 12 "Disabled" 13 "Shorted" 14 "Open" 15 "Over Range" 16 "Under Range" 17 "Undefined" 18 "Error!" 19 "Low Error" 20 "High Error" 21 "Non Critical No LED" 27 "Critical Green LED" 32 "Stall!" 33 "Synchronized" 34 "Syncing" 35 "Error!" 36 "Error!" 37 "Uncalibrated" 38 "Open Loop" 39 "Closed Loop" 40 "Not Learn" 41 "Learning" 42 "Off" 43 "On" 44 "Not Rev Limiting" 45 "Rev Limit" 46 "No Cut Off" 47 "CutOff!" 48 "Off" 49 "Warning!" 50 "Caution!" 51 "No Timing modifier" 52 "Timing is being modified" 53 "Timing Value is being replaced" 54 "Acq Sat" 55 "No GPS" 56 "No Data" 22 "Non Critical Green LED" 23 "Non Critical Yellow LED" 24 "Non Critical Red LED" 25 "Non Critical Blue LED" 26 "Non Critical Grey LED" 28 "Critical Yellow LED" 29 "Critical Red LED" 30 "Critical Blue LED" 31 "Critical Grey LED";
VAL_ 2655916032 Status 0 "OK" 1 "Disabled" 2 "Initializing" 3 "Heating" 4 "WB_Active" 5 "Too Cold" 6 "Too Hot" 7 "Unplugged" 8 "Slow!" 9 "Uncal Yellow" 10 "Uncal Red" 11 "Replace" 12 "Disabled" 13 "Shorted" 14 "Open" 15 "Over Range" 16 "Under Range" 17 "Undefined" 18 "Error!" 19 "Low Error" 20 "High Error" 21 "Non Critical No LED" 27 "Critical Green LED" 32 "Stall!" 33 "Synchronized" 34 "Syncing" 35 "Error!" 36 "Error!" 37 "Uncalibrated" 38 "Open Loop" 39 "Closed Loop" 40 "Not Learn" 41 "Learning" 42 "Off" 43 "On" 44 "Not Rev Limiting" 45 "Rev Limit" 46 "No Cut Off" 47 "CutOff!" 48 "Off" 49 "Warning!" 50 "Caution!" 51 "No Timing modifier" 52 "Timing is being modified" 53 "Timing Value is being replaced" 54 "Acq Sat" 55 "No GPS" 56 "No Data" 22 "Non Critical Green LED" 23 "Non Critical Yellow LED" 24 "Non Critical Red LED" 25 "Non Critical Blue LED" 26 "Non Critical Grey LED" 28 "Critical Yellow LED" 29 "Critical Red LED" 30 "Critical Blue LED" 31 "Critical Grey LED";
VAL_ 2655932416 Status 0 "OK" 1 "Disabled" 2 "Initializing" 3 "Heating" 4 "WB_Active" 5 "Too Cold" 6 "Too Hot" 7 "Unplugged" 8 "Slow!" 9 "Uncal Yellow" 10 "Uncal Red" 11 "Replace" 12 "Disabled" 13 "Shorted" 14 "Open" 15 "Over Range" 16 "Under Range" 17 "Undefined" 18 "Error!" 19 "Low Error" 20 "High Error" 21 "Non Critical No LED" 27 "Critical Green LED" 32 "Stall!" 33 "Synchronized" 34 "Syncing" 35 "Error!" 36 "Error!" 37 "Uncalibrated" 38 "Open Loop" 39 "Closed Loop" 40 "Not Learn" 41 "Learning" 42 "Off" 43 "On" 44 "Not Rev Limiting" 45 "Rev Limit" 46 "No Cut Off" 47 "CutOff!" 48 "Off" 49 "Warning!" 50 "Caution!" 51 "No Timing modifier" 52 "Timing is being modified" 53 "Timing Value is being replaced" 54 "Acq Sat" 55 "No GPS" 56 "No Data" 22 "Non Critical Green LED" 23 "Non Critical Yellow LED" 24 "Non Critical Red LED" 25 "Non Critical Blue LED" 26 "Non Critical Grey LED" 28 "Critical Yellow LED" 29 "Critical Red LED" 30 "Critical Blue LED" 31 "Critical Grey LED";
VAL_ 2655948800 Status 0 "OK" 1 "Disabled" 2 "Initializing" 3 "Heating" 4 "WB_Active" 5 "Too Cold" 6 "Too Hot" 7 "Unplugged" 8 "Slow!" 9 "Uncal Yellow" 10 "Uncal Red" 11 "Replace" 12 "Disabled" 13 "Shorted" 14 "Open" 15 "Over Range" 16 "Under Range" 17 "Undefined" 18 "Error!" 19 "Low Error" 20 "High Error" 21 "Non Critical No LED" 27 "Critical Green LED" 32 "Stall!" 33 "Synchronized" 34 "Syncing" 35 "Error!" 36 "Error!" 37 "Uncalibrated" 38 "Open Loop" 39 "Closed Loop" 40 "Not Learn" 41 "Learning" 42 "Off" 43 "On" 44 "Not Rev Limiting" 45 "Rev Limit" 46 "No Cut Off" 47 "CutOff!" 48 "Off" 49 "Warning!" 50 "Caution!" 51 "No Timing modifier" 52 "Timing is being modified" 53 "Timing Value is being replaced" 54 "Acq Sat" 55 "No GPS" 56 "No Data" 22 "Non Critical Green LED" 23 "Non Critical Yellow LED" 24 "Non Critical Red LED" 25 "Non Critical Blue LED" 26 "Non Critical Grey LED" 28 "Critical Yellow LED" 29 "Critical Red LED" 30 "Critical Blue LED" 31 "Critical Grey LED";
VAL_ 2655965184 Status 0 "OK" 1 "Disabled" 2 "Initializing" 3 "Heating" 4 "WB_Active" 5 "Too Cold" 6 "Too Hot" 7 "Unplugged" 8 "Slow!" 9 "Uncal Yellow" 10 "Uncal Red" 11 "Replace" 12 "Disabled" 13 "Shorted" 14 "Open" 15 "Over Range" 16 "Under Range" 17 "Undefined" 18 "Error!" 19 "Low Error" 20 "High Error" 21 "Non Critical No LED" 27 "Critical Green LED" 32 "Stall!" 33 "Synchronized" 34 "Syncing" 35 "Error!" 36 "Error!" 37 "Uncalibrated" 38 "Open Loop" 39 "Closed Loop" 40 "Not Learn" 41 "Learning" 42 "Off" 43 "On" 44 "Not Rev Limiting" 45 "Rev Limit" 46 "No Cut Off" 47 "CutOff!" 48 "Off" 49 "Warning!" 50 "Caution!" 51 "No Timing modifier" 52 "Timing is being modified" 53 "Timing Value is being replaced" 54 "Acq Sat" 55 "No GPS" 56 "No Data" 22 "Non Critical Green LED" 23 "Non Critical Yellow LED" 24 "Non Critical Red LED" 25 "Non Critical Blue LED" 26 "Non Critical Grey LED" 28 "Critical Yellow LED" 29 "Critical Red LED" 30 "Critical Blue LED" 31 "Critical Grey LED";
VAL_ 2655981568 Status 0 "OK" 1 "Disabled" 2 "Initializing" 3 "Heating" 4 "WB_Active" 5 "Too Cold" 6 "Too Hot" 7 "Unplugged" 8 "Slow!" 9 "Uncal Yellow" 10 "Uncal Red" 11 "Replace" 12 "Disabled" 13 "Shorted" 14 "Open" 15 "Over Range" 16 "Under Range" 17 "Undefined" 18 "Error!" 19 "Low Error" 20 "High Error" 21 "Non Critical No LED" 27 "Critical Green LED" 32 "Stall!" 33 "Synchronized" 34 "Syncing" 35 "Error!" 36 "Error!" 37 "Uncalibrated" 38 "Open Loop" 39 "Closed Loop" 40 "Not Learn" 41 "Learning" 42 "Off" 43 "On" 44 "Not Rev Limiting" 45 "Rev Limit" 46 "No Cut Off" 47 "CutOff!" 48 "Off" 49 "Warning!" 50 "Caution!" 51 "No Timing modifier" 52 "Timing is being modified" 53 "Timing Value is being replaced" 54 "Acq Sat" 55 "No GPS" 56 "No Data" 22 "Non Critical Green LED" 23 "Non Critical Yellow LED" 24 "Non Critical Red LED" 25 "Non Critical Blue LED" 26 "Non Critical Grey LED" 28 "Critical Yellow LED" 29 "Critical Red LED" 30 "Critical Blue LED" 31 "Critical Grey LED";
VAL_ 2655997952 Status 0 "OK" 1 "Disabled" 2 "Initializing" 3 "Heating" 4 "WB_Active" 5 "Too Cold" 6 "Too Hot" 7 "Unplugged" 8 "Slow!" 9 "Uncal Yellow" 10 "Uncal Red" 11 "Replace" 12 "Disabled" 13 "Shorted" 14 "Open" 15 "Over Range" 16 "Under Range" 17 "Undefined" 18 "Error!" 19 "Low Error" 20 "High Error" 21 "Non Critical No LED" 27 "Critical Green LED" 32 "Stall!" 33 "Synchronized" 34 "Syncing" 35 "Error!" 36 "Error!" 37 "Uncalibrated" 38 "Open Loop" 39 "Closed Loop" 40 "Not Learn" 41 "Learning" 42 "Off" 43 "On" 44 "Not Rev Limiting" 45 "Rev Limit" 46 "No Cut Off" 47 "CutOff!" 48 "Off" 49 "Warning!" 50 "Caution!" 51 "No Timing modifier" 52 "Timing is being modified" 53 "Timing Value is being replaced" 54 "Acq Sat" 55 "No GPS" 56 "No Data" 22 "Non Critical Green LED" 23 "Non Critical Yellow LED" 24 "Non Critical Red LED" 25 "Non Critical Blue LED" 26 "Non Critical Grey LED" 28 "Critical Yellow LED" 29 "Critical Red LED" 30 "Critical Blue LED" 31 "Critical Grey LED";
VAL_ 2656014336 Status 0 "OK" 1 "Disabled" 2 "Initializing" 3 "Heating" 4 "WB_Active" 5 "Too Cold" 6 "Too Hot" 7 "Unplugged" 8 "Slow!" 9 "Uncal Yellow" 10 "Uncal Red" 11 "Replace" 12 "Disabled" 13 "Shorted" 14 "Open" 15 "Over Range" 16 "Under Range" 17 "Undefined" 18 "Error!" 19 "Low Error" 20 "High Error" 21 "Non Critical No LED" 27 "Critical Green LED" 32 "Stall!" 33 "Synchronized" 34 "Syncing" 35 "Error!" 36 "Error!" 37 "Uncalibrated" 38 "Open Loop" 39 "Closed Loop" 40 "Not Learn" 41 "Learning" 42 "Off" 43 "On" 44 "Not Rev Limiting" 45 "Rev Limit" 46 "No Cut Off" 47 "CutOff!" 48 "Off" 49 "Warning!" 50 "Caution!" 51 "No Timing modifier" 52 "Timing is being modified" 53 "Timing Value is being replaced" 54 "Acq Sat" 55 "No GPS" 56 "No Data" 22 "Non Critical Green LED" 23 "Non Critical Yellow LED" 24 "Non Critical Red LED" 25 "Non Critical Blue LED" 26 "Non Critical Grey LED" 28 "Critical Yellow LED" 29 "Critical Red LED" 30 "Critical Blue LED" 31 "Critical Grey LED";
VAL_ 2656030720 Status 0 "OK" 1 "Disabled" 2 "Initializing" 3 "Heating" 4 "WB_Active" 5 "Too Cold" 6 "Too Hot" 7 "Unplugged" 8 "Slow!" 9 "Uncal Yellow" 10 "Uncal Red" 11 "Replace" 12 "Disabled" 13 "Shorted" 14 "Open" 15 "Over Range" 16 "Under Range" 17 "Undefined" 18 "Error!" 19 "Low Error" 20 "High Error" 21 "Non Critical No LED" 27 "Critical Green LED" 32 "Stall!" 33 "Synchronized" 34 "Syncing" 35 "Error!" 36 "Error!" 37 "Uncalibrated" 38 "Open Loop" 39 "Closed Loop" 40 "Not Learn" 41 "Learning" 42 "Off" 43 "On" 44 "Not Rev Limiting" 45 "Rev Limit" 46 "No Cut Off" 47 "CutOff!" 48 "Off" 49 "Warning!" 50 "Caution!" 51 "No Timing modifier" 52 "Timing is being modified" 53 "Timing Value is being replaced" 54 "Acq Sat" 55 "No GPS" 56 "No Data" 22 "Non Critical Green LED" 23 "Non Critical Yellow LED" 24 "Non Critical Red LED" 25 "Non Critical Blue LED" 26 "Non Critical Grey LED" 28 "Critical Yellow LED" 29 "Critical Red LED" 30 "Critical Blue LED" 31 "Critical Grey LED";
VAL_ 2656047104 Status 0 "OK" 1 "Disabled" 2 "Initializing" 3 "Heating" 4 "WB_Active" 5 "Too Cold" 6 "Too Hot" 7 "Unplugged" 8 "Slow!" 9 "Uncal Yellow" 10 "Uncal Red" 11 "Replace" 12 "Disabled" 13 "Shorted" 14 "Open" 15 "Over Range" 16 "Under Range" 17 "Undefined" 18 "Error!" 19 "Low Error" 20 "High Error" 21 "Non Critical No LED" 27 "Critical Green LED" 32 "Stall!" 33 "Synchronized" 34 "Syncing" 35 "Error!" 36 "Error!" 37 "Uncalibrated" 38 "Open Loop" 39 "Closed Loop" 40 "Not Learn" 41 "Learning" 42 "Off" 43 "On" 44 "Not Rev Limiting" 45 "Rev Limit" 46 "No Cut Off" 47 "CutOff!" 48 "Off" 49 "Warning!" 50 "Caution!" 51 "No Timing modifier" 52 "Timing is being modified" 53 "Timing Value is being replaced" 54 "Acq Sat" 55 "No GPS" 56 "No Data" 22 "Non Critical Green LED" 23 "Non Critical Yellow LED" 24 "Non Critical Red LED" 25 "Non Critical Blue LED" 26 "Non Critical Grey LED" 28 "Critical Yellow LED" 29 "Critical Red LED" 30 "Critical Blue LED" 31 "Critical Grey LED";
VAL_ 2656063488 Status 0 "OK" 1 "Disabled" 2 "Initializing" 3 "Heating" 4 "WB_Active" 5 "Too Cold" 6 "Too Hot" 7 "Unplugged" 8 "Slow!" 9 "Uncal Yellow" 10 "Uncal Red" 11 "Replace" 12 "Disabled" 13 "Shorted" 14 "Open" 15 "Over Range" 16 "Under Range" 17 "Undefined" 18 "Error!" 19 "Low Error" 20 "High Error" 21 "Non Critical No LED" 27 "Critical Green LED" 32 "Stall!" 33 "Synchronized" 34 "Syncing" 35 "Error!" 36 "Error!" 37 "Uncalibrated" 38 "Open Loop" 39 "Closed Loop" 40 "Not Learn" 41 "Learning" 42 "Off" 43 "On" 44 "Not Rev Limiting" 45 "Rev Limit" 46 "No Cut Off" 47 "CutOff!" 48 "Off" 49 "Warning!" 50 "Caution!" 51 "No Timing modifier" 52 "Timing is being modified" 53 "Timing Value is being replaced" 54 "Acq Sat" 55 "No GPS" 56 "No Data" 22 "Non Critical Green LED" 23 "Non Critical Yellow LED" 24 "Non Critical Red LED" 25 "Non Critical Blue LED" 26 "Non Critical Grey LED" 28 "Critical Yellow LED" 29 "Critical Red LED" 30 "Critical Blue LED" 31 "Critical Grey LED";
VAL_ 2656079872 Status 0 "OK" 1 "Disabled" 2 "Initializing" 3 "Heating" 4 "WB_Active" 5 "Too Cold" 6 "Too Hot" 7 "Unplugged" 8 "Slow!" 9 "Uncal Yellow" 10 "Uncal Red" 11 "Replace" 12 "Disabled" 13 "Shorted" 14 "Open" 15 "Over Range" 16 "Under Range" 17 "Undefined" 18 "Error!" 19 "Low Error" 20 "High Error" 21 "Non Critical No LED" 27 "Critical Green LED" 32 "Stall!" 33 "Synchronized" 34 "Syncing" 35 "Error!" 36 "Error!" 37 "Uncalibrated" 38 "Open Loop" 39 "Closed Loop" 40 "Not Learn" 41 "Learning" 42 "Off" 43 "On" 44 "Not Rev Limiting" 45 "Rev Limit" 46 "No Cut Off" 47 "CutOff!" 48 "Off" 49 "Warning!" 50 "Caution!" 51 "No Timing modifier" 52 "Timing is being modified" 53 "Timing Value is being replaced" 54 "Acq Sat" 55 "No GPS" 56 "No Data" 22 "Non Critical Green LED" 23 "Non Critical Yellow LED" 24 "Non Critical Red LED" 25 "Non Critical Blue LED" 26 "Non Critical Grey LED" 28 "Critical Yellow LED" 29 "Critical Red LED" 30 "Critical Blue LED" 31 "Critical Grey LED";
VAL_ 2656096256 Status 0 "OK" 1 "Disabled" 2 "Initializing" 3 "Heating" 4 "WB_Active" 5 "Too Cold" 6 "Too Hot" 7 "Unplugged" 8 "Slow!" 9 "Uncal Yellow" 10 "Uncal Red" 11 "Replace" 12 "Disabled" 13 "Shorted" 14 "Open" 15 "Over Range" 16 "Under Range" 17 "Undefined" 18 "Error!" 19 "Low Error" 20 "High Error" 21 "Non Critical No LED" 27 "Critical Green LED" 32 "Stall!" 33 "Synchronized" 34 "Syncing" 35 "Error!" 36 "Error!" 37 "Uncalibrated" 38 "Open Loop" 39 "Closed Loop" 40 "Not Learn" 41 "Learning" 42 "Off" 43 "On" 44 "Not Rev Limiting" 45 "Rev Limit" 46 "No Cut Off" 47 "CutOff!" 48 "Off" 49 "Warning!" 50 "Caution!" 51 "No Timing modifier" 52 "Timing is being modified" 53 "Timing Value is being replaced" 54 "Acq Sat" 55 "No GPS" 56 "No Data" 22 "Non Critical Green LED" 23 "Non Critical Yellow LED" 24 "Non Critical Red LED" 25 "Non Critical Blue LED" 26 "Non Critical Grey LED" 28 "Critical Yellow LED" 29 "Critical Red LED" 30 "Critical Blue LED" 31 "Critical Grey LED";
VAL_ 2656112640 Status 0 "OK" 1 "Disabled" 2 "Initializing" 3 "Heating" 4 "WB_Active" 5 "Too Cold" 6 "Too Hot" 7 "Unplugged" 8 "Slow!" 9 "Uncal Yellow" 10 "Uncal Red" 11 "Replace" 12 "Disabled" 13 "Shorted" 14 "Open" 15 "Over Range" 16 "Under Range" 17 "Undefined" 18 "Error!" 19 "Low Error" 20 "High Error" 21 "Non Critical No LED" 27 "Critical Green LED" 32 "Stall!" 33 "Synchronized" 34 "Syncing" 35 "Error!" 36 "Error!" 37 "Uncalibrated" 38 "Open Loop" 39 "Closed Loop" 40 "Not Learn" 41 "Learning" 42 "Off" 43 "On" 44 "Not Rev Limiting" 45 "Rev Limit" 46 "No Cut Off" 47 "CutOff!" 48 "Off" 49 "Warning!" 50 "Caution!" 51 "No Timing modifier" 52 "Timing is being modified" 53 "Timing Value is being replaced" 54 "Acq Sat" 55 "No GPS" 56 "No Data" 22 "Non Critical Green LED" 23 "Non Critical Yellow LED" 24 "Non Critical Red LED" 25 "Non Critical Blue LED" 26 "Non Critical Grey LED" 28 "Critical Yellow LED" 29 "Critical Red LED" 30 "Critical Blue LED" 31 "Critical Grey LED";
VAL_ 2656129024 Status 0 "OK" 1 "Disabled" 2 "Initializing" 3 "Heating" 4 "WB_Active" 5 "Too Cold" 6 "Too Hot" 7 "Unplugged" 8 "Slow!" 9 "Uncal Yellow" 10 "Uncal Red" 11 "Replace" 12 "Disabled" 13 "Shorted" 14 "Open" 15 "Over Range" 16 "Under Range" 17 "Undefined" 18 "Error!" 19 "Low Error" 20 "High Error" 21 "Non Critical No LED" 27 "Critical Green LED" 32 "Stall!" 33 "Synchronized" 34 "Syncing" 35 "Error!" 36 "Error!" 37 "Uncalibrated" 38 "Open Loop" 39 "Closed Loop" 40 "Not Learn" 41 "Learning" 42 "Off" 43 "On" 44 "Not Rev Limiting" 45 "Rev Limit" 46 "No Cut Off" 47 "CutOff!" 48 "Off" 49 "Warning!" 50 "Caution!" 51 "No Timing modifier" 52 "Timing is being modified" 53 "Timing Value is being replaced" 54 "Acq Sat" 55 "No GPS" 56 "No Data" 22 "Non Critical Green LED" 23 "Non Critical Yellow LED" 24 "Non Critical Red LED" 25 "Non Critical Blue LED" 26 "Non Critical Grey LED" 28 "Critical Yellow LED" 29 "Critical Red LED" 30 "Critical Blue LED" 31 "Critical Grey LED";
VAL_ 2656145408 Status 0 "OK" 1 "Disabled" 2 "Initializing" 3 "Heating" 4 "WB_Active" 5 "Too Cold" 6 "Too Hot" 7 "Unplugged" 8 "Slow!" 9 "Uncal Yellow" 10 "Uncal Red" 11 "Replace" 12 "Disabled" 13 "Shorted" 14 "Open" 15 "Over Range" 16 "Under Range" 17 "Undefined" 18 "Error!" 19 "Low Error" 20 "High Error" 21 "Non Critical No LED" 27 "Critical Green LED" 32 "Stall!" 33 "Synchronized" 34 "Syncing" 35 "Error!" 36 "Error!" 37 "Uncalibrated" 38 "Open Loop" 39 "Closed Loop" 40 "Not Learn" 41 "Learning" 42 "Off" 43 "On" 44 "Not Rev Limiting" 45 "Rev Limit" 46 "No Cut Off" 47 "CutOff!" 48 "Off" 49 "Warning!" 50 "Caution!" 51 "No Timing modifier" 52 "Timing is being modified" 53 "Timing Value is being replaced" 54 "Acq Sat" 55 "No GPS" 56 "No Data" 22 "Non Critical Green LED" 23 "Non Critical Yellow LED" 24 "Non Critical Red LED" 25 "Non Critical Blue LED" 26 "Non Critical Grey LED" 28 "Critical Yellow LED" 29 "Critical Red LED" 30 "Critical Blue LED" 31 "Critical Grey LED";
VAL_ 2656161792 Status 0 "OK" 1 "Disabled" 2 "Initializing" 3 "Heating" 4 "WB_Active" 5 "Too Cold" 6 "Too Hot" 7 "Unplugged" 8 "Slow!" 9 "Uncal Yellow" 10 "Uncal Red" 11 "Replace" 12 "Disabled" 13 "Shorted" 14 "Open" 15 "Over Range" 16 "Under Range" 17 "Undefined" 18 "Error!" 19 "Low Error" 20 "High Error" 21 "Non Critical No LED" 27 "Critical Green LED" 32 "Stall!" 33 "Synchronized" 34 "Syncing" 35 "Error!" 36 "Error!" 37 "Uncalibrated" 38 "Open Loop" 39 "Closed Loop" 40 "Not Learn" 41 "Learning" 42 "Off" 43 "On" 44 "Not Rev Limiting" 45 "Rev Limit" 46 "No Cut Off" 47 "CutOff!" 48 "Off" 49 "Warning!" 50 "Caution!" 51 "No Timing modifier" 52 "Timing is being modified" 53 "Timing Value is being replaced" 54 "Acq Sat" 55 "No GPS" 56 "No Data" 22 "Non Critical Green LED" 23 "Non Critical Yellow LED" 24 "Non Critical Red LED" 25 "Non Critical Blue LED" 26 "Non Critical Grey LED" 28 "Critical Yellow LED" 29 "Critical Red LED" 30 "Critical Blue LED" 31 "Critical Grey LED";
VAL_ 2656178176 Status 0 "OK" 1 "Disabled" 2 "Initializing" 3 "Heating" 4 "WB_Active" 5 "Too Cold" 6 "Too Hot" 7 "Unplugged" 8 "Slow!" 9 "Uncal Yellow" 10 "Uncal Red" 11 "Replace" 12 "Disabled" 13 "Shorted" 14 "Open" 15 "Over Range" 16 "Under Range" 17 "Undefined" 18 "Error!" 19 "Low Error" 20 "High Error" 21 "Non Critical No LED" 27 "Critical Green LED" 32 "Stall!" 33 "Synchronized" 34 "Syncing" 35 "Error!" 36 "Error!" 37 "Uncalibrated" 38 "Open Loop" 39 "Closed Loop" 40 "Not Learn" 41 "Learning" 42 "Off" 43 "On" 44 "Not Rev Limiting" 45 "Rev Limit" 46 "No Cut Off" 47 "CutOff!" 48 "Off" 49 "Warning!" 50 "Caution!" 51 "No Timing modifier" 52 "Timing is being modified" 53 "Timing Value is being replaced" 54 "Acq Sat" 55 "No GPS" 56 "No Data" 22 "Non Critical Green LED" 23 "Non Critical Yellow LED" 24 "Non Critical Red LED" 25 "Non Critical Blue LED" 26 "Non Critical Grey LED" 28 "Critical Yellow LED" 29 "Critical Red LED" 30 "Critical Blue LED" 31 "Critical Grey LED";
VAL_ 2656194560 Status 0 "OK" 1 "Disabled" 2 "Initializing" 3 "Heating" 4 "WB_Active" 5 "Too Cold" 6 "Too Hot" 7 "Unplugged" 8 "Slow!" 9 "Uncal Yellow" 10 "Uncal Red" 11 "Replace" 12 "Disabled" 13 "Shorted" 14 "Open" 15 "Over Range" 16 "Under Range" 17 "Undefined" 18 "Error!" 19 "Low Error" 20 "High Error" 21 "Non Critical No LED" 27 "Critical Green LED" 32 "Stall!" 33 "Synchronized" 34 "Syncing" 35 "Error!" 36 "Error!" 37 "Uncalibrated" 38 "Open Loop" 39 "Closed Loop" 40 "Not Learn" 41 "Learning" 42 "Off" 43 "On" 44 "Not Rev Limiting" 45 "Rev Limit" 46 "No Cut Off" 47 "CutOff!" 48 "Off" 49 "Warning!" 50 "Caution!" 51 "No Timing modifier" 52 "Timing is being modified" 53 "Timing Value is being replaced" 54 "Acq Sat" 55 "No GPS" 56 "No Data" 22 "Non Critical Green LED" 23 "Non Critical Yellow LED" 24 "Non Critical Red LED" 25 "Non Critical Blue LED" 26 "Non Critical Grey LED" 28 "Critical Yellow LED" 29 "Critical Red LED" 30 "Critical Blue LED" 31 "Critical Grey LED";
VAL_ 2656210944 Status 0 "OK" 1 "Disabled" 2 "Initializing" 3 "Heating" 4 "WB_Active" 5 "Too Cold" 6 "Too Hot" 7 "Unplugged" 8 "Slow!" 9 "Uncal Yellow" 10 "Uncal Red" 11 "Replace" 12 "Disabled" 13 "Shorted" 14 "Open" 15 "Over Range" 16 "Under Range" 17 "Undefined" 18 "Error!" 19 "Low Error" 20 "High Error" 21 "Non Critical No LED" 27 "Critical Green LED" 32 "Stall!" 33 "Synchronized" 34 "Syncing" 35 "Error!" 36 "Error!" 37 "Uncalibrated" 38 "Open Loop" 39 "Closed Loop" 40 "Not Learn" 41 "Learning" 42 "Off" 43 "On" 44 "Not Rev Limiting" 45 "Rev Limit" 46 "No Cut Off" 47 "CutOff!" 48 "Off" 49 "Warning!" 50 "Caution!" 51 "No Timing modifier" 52 "Timing is being modified" 53 "Timing Value is being replaced" 54 "Acq Sat" 55 "No GPS" 56 "No Data" 22 "Non Critical Green LED" 23 "Non Critical Yellow LED" 24 "Non Critical Red LED" 25 "Non Critical Blue LED" 26 "Non Critical Grey LED" 28 "Critical Yellow LED" 29 "Critical Red LED" 30 "Critical Blue LED" 31 "Critical Grey LED";
VAL_ 2656227328 Status 0 "OK" 1 "Disabled" 2 "Initializing" 3 "Heating" 4 "WB_Active" 5 "Too Cold" 6 "Too Hot" 7 "Unplugged" 8 "Slow!" 9 "Uncal Yellow" 10 "Uncal Red" 11 "Replace" 12 "Disabled" 13 "Shorted" 14 "Open" 15 "Over Range" 16 "Under Range" 17 "Undefined" 18 "Error!" 19 "Low Error" 20 "High Error" 21 "Non Critical No LED" 27 "Critical Green LED" 32 "Stall!" 33 "Synchronized" 34 "Syncing" 35 "Error!" 36 "Error!" 37 "Uncalibrated" 38 "Open Loop" 39 "Closed Loop" 40 "Not Learn" 41 "Learning" 42 "Off" 43 "On" 44 "Not Rev Limiting" 45 "Rev Limit" 46 "No Cut Off" 47 "CutOff!" 48 "Off" 49 "Warning!" 50 "Caution!" 51 "No Timing modifier" 52 "Timing is being modified" 53 "Timing Value is being replaced" 54 "Acq Sat" 55 "No GPS" 56 "No Data" 22 "Non Critical Green LED" 23 "Non Critical Yellow LED" 24 "Non Critical Red LED" 25 "Non Critical Blue LED" 26 "Non Critical Grey LED" 28 "Critical Yellow LED" 29 "Critical Red LED" 30 "Critical Blue LED" 31 "Critical Grey LED";
VAL_ 2656243712 Status 0 "OK" 1 "Disabled" 2 "Initializing" 3 "Heating" 4 "WB_Active" 5 "Too Cold" 6 "Too Hot" 7 "Unplugged" 8 "Slow!" 9 "Uncal Yellow" 10 "Uncal Red" 11 "Replace" 12 "Disabled" 13 "Shorted" 14 "Open" 15 "Over Range" 16 "Under Range" 17 "Undefined" 18 "Error!" 19 "Low Error" 20 "High Error" 21 "Non Critical No LED" 27 "Critical Green LED" 32 "Stall!" 33 "Synchronized" 34 "Syncing" 35 "Error!" 36 "Error!" 37 "Uncalibrated" 38 "Open Loop" 39 "Closed Loop" 40 "Not Learn" 41 "Learning" 42 "Off" 43 "On" 44 "Not Rev Limiting" 45 "Rev Limit" 46 "No Cut Off" 47 "CutOff!" 48 "Off" 49 "Warning!" 50 "Caution!" 51 "No Timing modifier" 52 "Timing is being modified" 53 "Timing Value is being replaced" 54 "Acq Sat" 55 "No GPS" 56 "No Data" 22 "Non Critical Green LED" 23 "Non Critical Yellow LED" 24 "Non Critical Red LED" 25 "Non Critical Blue LED" 26 "Non Critical Grey LED" 28 "Critical Yellow LED" 29 "Critical Red LED" 30 "Critical Blue LED" 31 "Critical Grey LED";
VAL_ 2656260096 Status 0 "OK" 1 "Disabled" 2 "Initializing" 3 "Heating" 4 "WB_Active" 5 "Too Cold" 6 "Too Hot" 7 "Unplugged" 8 "Slow!" 9 "Uncal Yellow" 10 "Uncal Red" 11 "Replace" 12 "Disabled" 13 "Shorted" 14 "Open" 15 "Over Range" 16 "Under Range" 17 "Undefined" 18 "Error!" 19 "Low Error" 20 "High Error" 21 "Non Critical No LED" 27 "Critical Green LED" 32 "Stall!" 33 "Synchronized" 34 "Syncing" 35 "Error!" 36 "Error!" 37 "Uncalibrated" 38 "Open Loop" 39 "Closed Loop" 40 "Not Learn" 41 "Learning" 42 "Off" 43 "On" 44 "Not Rev Limiting" 45 "Rev Limit" 46 "No Cut Off" 47 "CutOff!" 48 "Off" 49 "Warning!" 50 "Caution!" 51 "No Timing modifier" 52 "Timing is being modified" 53 "Timing Value is being replaced" 54 "Acq Sat" 55 "No GPS" 56 "No Data" 22 "Non Critical Green LED" 23 "Non Critical Yellow LED" 24 "Non Critical Red LED" 25 "Non Critical Blue LED" 26 "Non Critical Grey LED" 28 "Critical Yellow LED" 29 "Critical Red LED" 30 "Critical Blue LED" 31 "Critical Grey LED";
VAL_ 2656276480 Status 0 "OK" 1 "Disabled" 2 "Initializing" 3 "Heating" 4 "WB_Active" 5 "Too Cold" 6 "Too Hot" 7 "Unplugged" 8 "Slow!" 9 "Uncal Yellow" 10 "Uncal Red" 11 "Replace" 12 "Disabled" 13 "Shorted" 14 "Open" 15 "Over Range" 16 "Under Range" 17 "Undefined" 18 "Error!" 19 "Low Error" 20 "High Error" 21 "Non Critical No LED" 27 "Critical Green LED" 32 "Stall!" 33 "Synchronized" 34 "Syncing" 35 "Error!" 36 "Error!" 37 "Uncalibrated" 38 "Open Loop" 39 "Closed Loop" 40 "Not Learn" 41 "Learning" 42 "Off" 43 "On" 44 "Not Rev Limiting" 45 "Rev Limit" 46 "No Cut Off" 47 "CutOff!" 48 "Off" 49 "Warning!" 50 "Caution!" 51 "No Timing modifier" 52 "Timing is being modified" 53 "Timing Value is being replaced" 54 "Acq Sat" 55 "No GPS" 56 "No Data" 22 "Non Critical Green LED" 23 "Non Critical Yellow LED" 24 "Non Critical Red LED" 25 "Non Critical Blue LED" 26 "Non Critical Grey LED" 28 "Critical Yellow LED" 29 "Critical Red LED" 30 "Critical Blue LED" 31 "Critical Grey LED";
VAL_ 2656292864 Status 0 "OK" 1 "Disabled" 2 "Initializing" 3 "Heating" 4 "WB_Active" 5 "Too Cold" 6 "Too Hot" 7 "Unplugged" 8 "Slow!" 9 "Uncal Yellow" 10 "Uncal Red" 11 "Replace" 12 "Disabled" 13 "Shorted" 14 "Open" 15 "Over Range" 16 "Under Range" 17 "Undefined" 18 "Error!" 19 "Low Error" 20 "High Error" 21 "Non Critical No LED" 27 "Critical Green LED" 32 "Stall!" 33 "Synchronized" 34 "Syncing" 35 "Error!" 36 "Error!" 37 "Uncalibrated" 38 "Open Loop" 39 "Closed Loop" 40 "Not Learn" 41 "Learning" 42 "Off" 43 "On" 44 "Not Rev Limiting" 45 "Rev Limit" 46 "No Cut Off" 47 "CutOff!" 48 "Off" 49 "Warning!" 50 "Caution!" 51 "No Timing modifier" 52 "Timing is being modified" 53 "Timing Value is being replaced" 54 "Acq Sat" 55 "No GPS" 56 "No Data" 22 "Non Critical Green LED" 23 "Non Critical Yellow LED" 24 "Non Critical Red LED" 25 "Non Critical Blue LED" 26 "Non Critical Grey LED" 28 "Critical Yellow LED" 29 "Critical Red LED" 30 "Critical Blue LED" 31 "Critical Grey LED";
VAL_ 2656309248 Status 0 "OK" 1 "Disabled" 2 "Initializing" 3 "Heating" 4 "WB_Active" 5 "Too Cold" 6 "Too Hot" 7 "Unplugged" 8 "Slow!" 9 "Uncal Yellow" 10 "Uncal Red" 11 "Replace" 12 "Disabled" 13 "Shorted" 14 "Open" 15 "Over Range" 16 "Under Range" 17 "Undefined" 18 "Error!" 19 "Low Error" 20 "High Error" 21 "Non Critical No LED" 27 "Critical Green LED" 32 "Stall!" 33 "Synchronized" 34 "Syncing" 35 "Error!" 36 "Error!" 37 "Uncalibrated" 38 "Open Loop" 39 "Closed Loop" 40 "Not Learn" 41 "Learning" 42 "Off" 43 "On" 44 "Not Rev Limiting" 45 "Rev Limit" 46 "No Cut Off" 47 "CutOff!" 48 "Off" 49 "Warning!" 50 "Caution!" 51 "No Timing modifier" 52 "Timing is being modified" 53 "Timing Value is being replaced" 54 "Acq Sat" 55 "No GPS" 56 "No Data" 22 "Non Critical Green LED" 23 "Non Critical Yellow LED" 24 "Non Critical Red LED" 25 "Non Critical Blue LED" 26 "Non Critical Grey LED" 28 "Critical Yellow LED" 29 "Critical Red LED" 30 "Critical Blue LED" 31 "Critical Grey LED";
VAL_ 2656325632 Status 0 "OK" 1 "Disabled" 2 "Initializing" 3 "Heating" 4 "WB_Active" 5 "Too Cold" 6 "Too Hot" 7 "Unplugged" 8 "Slow!" 9 "Uncal Yellow" 10 "Uncal Red" 11 "Replace" 12 "Disabled" 13 "Shorted" 14 "Open" 15 "Over Range" 16 "Under Range" 17 "Undefined" 18 "Error!" 19 "Low Error" 20 "High Error" 21 "Non Critical No LED" 27 "Critical Green LED" 32 "Stall!" 33 "Synchronized" 34 "Syncing" 35 "Error!" 36 "Error!" 37 "Uncalibrated" 38 "Open Loop" 39 "Closed Loop" 40 "Not Learn" 41 "Learning" 42 "Off" 43 "On" 44 "Not Rev Limiting" 45 "Rev Limit" 46 "No Cut Off" 47 "CutOff!" 48 "Off" 49 "Warning!" 50 "Caution!" 51 "No Timing modifier" 52 "Timing is being modified" 53 "Timing Value is being replaced" 54 "Acq Sat" 55 "No GPS" 56 "No Data" 22 "Non Critical Green LED" 23 "Non Critical Yellow LED" 24 "Non Critical Red LED" 25 "Non Critical Blue LED" 26 "Non Critical Grey LED" 28 "Critical Yellow LED" 29 "Critical Red LED" 30 "Critical Blue LED" 31 "Critical Grey LED";
VAL_ 2656342016 Status 0 "OK" 1 "Disabled" 2 "Initializing" 3 "Heating" 4 "WB_Active" 5 "Too Cold" 6 "Too Hot" 7 "Unplugged" 8 "Slow!" 9 "Uncal Yellow" 10 "Uncal Red" 11 "Replace" 12 "Disabled" 13 "Shorted" 14 "Open" 15 "Over Range" 16 "Under Range" 17 "Undefined" 18 "Error!" 19 "Low Error" 20 "High Error" 21 "Non Critical No LED" 27 "Critical Green LED" 32 "Stall!" 33 "Synchronized" 34 "Syncing" 35 "Error!" 36 "Error!" 37 "Uncalibrated" 38 "Open Loop" 39 "Closed Loop" 40 "Not Learn" 41 "Learning" 42 "Off" 43 "On" 44 "Not Rev Limiting" 45 "Rev Limit" 46 "No Cut Off" 47 "CutOff!" 48 "Off" 49 "Warning!" 50 "Caution!" 51 "No Timing modifier" 52 "Timing is being modified" 53 "Timing Value is being replaced" 54 "Acq Sat" 55 "No GPS" 56 "No Data" 22 "Non Critical Green LED" 23 "Non Critical Yellow LED" 24 "Non Critical Red LED" 25 "Non Critical Blue LED" 26 "Non Critical Grey LED" 28 "Critical Yellow LED" 29 "Critical Red LED" 30 "Critical Blue LED" 31 "Critical Grey LED";
VAL_ 2656358400 Status 0 "OK" 1 "Disabled" 2 "Initializing" 3 "Heating" 4 "WB_Active" 5 "Too Cold" 6 "Too Hot" 7 "Unplugged" 8 "Slow!" 9 "Uncal Yellow" 10 "Uncal Red" 11 "Replace" 12 "Disabled" 13 "Shorted" 14 "Open" 15 "Over Range" 16 "Under Range" 17 "Undefined" 18 "Error!" 19 "Low Error" 20 "High Error" 21 "Non Critical No LED" 27 "Critical Green LED" 32 "Stall!" 33 "Synchronized" 34 "Syncing" 35 "Error!" 36 "Error!" 37 "Uncalibrated" 38 "Open Loop" 39 "Closed Loop" 40 "Not Learn" 41 "Learning" 42 "Off" 43 "On" 44 "Not Rev Limiting" 45 "Rev Limit" 46 "No Cut Off" 47 "CutOff!" 48 "Off" 49 "Warning!" 50 "Caution!" 51 "No Timing modifier" 52 "Timing is being modified" 53 "Timing Value is being replaced" 54 "Acq Sat" 55 "No GPS" 56 "No Data" 22 "Non Critical Green LED" 23 "Non Critical Yellow LED" 24 "Non Critical Red LED" 25 "Non Critical Blue LED" 26 "Non Critical Grey LED" 28 "Critical Yellow LED" 29 "Critical Red LED" 30 "Critical Blue LED" 31 "Critical Grey LED";
VAL_ 2656374784 Status 0 "OK" 1 "Disabled" 2 "Initializing" 3 "Heating" 4 "WB_Active" 5 "Too Cold" 6 "Too Hot" 7 "Unplugged" 8 "Slow!" 9 "Uncal Yellow" 10 "Uncal Red" 11 "Replace" 12 "Disabled" 13 "Shorted" 14 "Open" 15 "Over Range" 16 "Under Range" 17 "Undefined" 18 "Error!" 19 "Low Error" 20 "High Error" 21 "Non Critical No LED" 27 "Critical Green LED" 32 "Stall!" 33 "Synchronized" 34 "Syncing" 35 "Error!" 36 "Error!" 37 "Uncalibrated" 38 "Open Loop" 39 "Closed Loop" 40 "Not Learn" 41 "Learning" 42 "Off" 43 "On" 44 "Not Rev Limiting" 45 "Rev Limit" 46 "No Cut Off" 47 "CutOff!" 48 "Off" 49 "Warning!" 50 "Caution!" 51 "No Timing modifier" 52 "Timing is being modified" 53 "Timing Value is being replaced" 54 "Acq Sat" 55 "No GPS" 56 "No Data" 22 "Non Critical Green LED" 23 "Non Critical Yellow LED" 24 "Non Critical Red LED" 25 "Non Critical Blue LED" 26 "Non Critical Grey LED" 28 "Critical Yellow LED" 29 "Critical Red LED" 30 "Critical Blue LED" 31 "Critical Grey LED";
VAL_ 2656391168 Status 0 "OK" 1 "Disabled" 2 "Initializing" 3 "Heating" 4 "WB_Active" 5 "Too Cold" 6 "Too Hot" 7 "Unplugged" 8 "Slow!" 9 "Uncal Yellow" 10 "Uncal Red" 11 "Replace" 12 "Disabled" 13 "Shorted" 14 "Open" 15 "Over Range" 16 "Under Range" 17 "Undefined" 18 "Error!" 19 "Low Error" 20 "High Error" 21 "Non Critical No LED" 27 "Critical Green LED" 32 "Stall!" 33 "Synchronized" 34 "Syncing" 35 "Error!" 36 "Error!" 37 "Uncalibrated" 38 "Open Loop" 39 "Closed Loop" 40 "Not Learn" 41 "Learning" 42 "Off" 43 "On" 44 "Not Rev Limiting" 45 "Rev Limit" 46 "No Cut Off" 47 "CutOff!" 48 "Off" 49 "Warning!" 50 "Caution!" 51 "No Timing modifier" 52 "Timing is being modified" 53 "Timing Value is being replaced" 54 "Acq Sat" 55 "No GPS" 56 "No Data" 22 "Non Critical Green LED" 23 "Non Critical Yellow LED" 24 "Non Critical Red LED" 25 "Non Critical Blue LED" 26 "Non Critical Grey LED" 28 "Critical Yellow LED" 29 "Critical Red LED" 30 "Critical Blue LED" 31 "Critical Grey LED";
VAL_ 2656407552 Status 0 "OK" 1 "Disabled" 2 "Initializing" 3 "Heating" 4 "WB_Active" 5 "Too Cold" 6 "Too Hot" 7 "Unplugged" 8 "Slow!" 9 "Uncal Yellow" 10 "Uncal Red" 11 "Replace" 12 "Disabled" 13 "Shorted" 14 "Open" 15 "Over Range" 16 "Under Range" 17 "Undefined" 18 "Error!" 19 "Low Error" 20 "High Error" 21 "Non Critical No LED" 27 "Critical Green LED" 32 "Stall!" 33 "Synchronized" 34 "Syncing" 35 "Error!" 36 "Error!" 37 "Uncalibrated" 38 "Open Loop" 39 "Closed Loop" 40 "Not Learn" 41 "Learning" 42 "Off" 43 "On" 44 "Not Rev Limiting" 45 "Rev Limit" 46 "No Cut Off" 47 "CutOff!" 48 "Off" 49 "Warning!" 50 "Caution!" 51 "No Timing modifier" 52 "Timing is being modified" 53 "Timing Value is being replaced" 54 "Acq Sat" 55 "No GPS" 56 "No Data" 22 "Non Critical Green LED" 23 "Non Critical Yellow LED" 24 "Non Critical Red LED" 25 "Non Critical Blue LED" 26 "Non Critical Grey LED" 28 "Critical Yellow LED" 29 "Critical Red LED" 30 "Critical Blue LED" 31 "Critical Grey LED";
VAL_ 2656423936 Status 0 "OK" 1 "Disabled" 2 "Initializing" 3 "Heating" 4 "WB_Active" 5 "Too Cold" 6 "Too Hot" 7 "Unplugged" 8 "Slow!" 9 "Uncal Yellow" 10 "Uncal Red" 11 "Replace" 12 "Disabled" 13 "Shorted" 14 "Open" 15 "Over Range" 16 "Under Range" 17 "Undefined" 18 "Error!" 19 "Low Error" 20 "High Error" 21 "Non Critical No LED" 27 "Critical Green LED" 32 "Stall!" 33 "Synchronized" 34 "Syncing" 35 "Error!" 36 "Error!" 37 "Uncalibrated" 38 "Open Loop" 39 "Closed Loop" 40 "Not Learn" 41 "Learning" 42 "Off" 43 "On" 44 "Not Rev Limiting" 45 "Rev Limit" 46 "No Cut Off" 47 "CutOff!" 48 "Off" 49 "Warning!" 50 "Caution!" 51 "No Timing modifier" 52 "Timing is being modified" 53 "Timing Value is being replaced" 54 "Acq Sat" 55 "No GPS" 56 "No Data" 22 "Non Critical Green LED" 23 "Non Critical Yellow LED" 24 "Non Critical Red LED" 25 "Non Critical Blue LED" 26 "Non Critical Grey LED" 28 "Critical Yellow LED" 29 "Critical Red LED" 30 "Critical Blue LED" 31 "Critical Grey LED";
VAL_ 2656440320 Status 0 "OK" 1 "Disabled" 2 "Initializing" 3 "Heating" 4 "WB_Active" 5 "Too Cold" 6 "Too Hot" 7 "Unplugged" 8 "Slow!" 9 "Uncal Yellow" 10 "Uncal Red" 11 "Replace" 12 "Disabled" 13 "Shorted" 14 "Open" 15 "Over Range" 16 "Under Range" 17 "Undefined" 18 "Error!" 19 "Low Error" 20 "High Error" 21 "Non Critical No LED" 27 "Critical Green LED" 32 "Stall!" 33 "Synchronized" 34 "Syncing" 35 "Error!" 36 "Error!" 37 "Uncalibrated" 38 "Open Loop" 39 "Closed Loop" 40 "Not Learn" 41 "Learning" 42 "Off" 43 "On" 44 "Not Rev Limiting" 45 "Rev Limit" 46 "No Cut Off" 47 "CutOff!" 48 "Off" 49 "Warning!" 50 "Caution!" 51 "No Timing modifier" 52 "Timing is being modified" 53 "Timing Value is being replaced" 54 "Acq Sat" 55 "No GPS" 56 "No Data" 22 "Non Critical Green LED" 23 "Non Critical Yellow LED" 24 "Non Critical Red LED" 25 "Non Critical Blue LED" 26 "Non Critical Grey LED" 28 "Critical Yellow LED" 29 "Critical Red LED" 30 "Critical Blue LED" 31 "Critical Grey LED";
VAL_ 2656456704 Status 0 "OK" 1 "Disabled" 2 "Initializing" 3 "Heating" 4 "WB_Active" 5 "Too Cold" 6 "Too Hot" 7 "Unplugged" 8 "Slow!" 9 "Uncal Yellow" 10 "Uncal Red" 11 "Replace" 12 "Disabled" 13 "Shorted" 14 "Open" 15 "Over Range" 16 "Under Range" 17 "Undefined" 18 "Error!" 19 "Low Error" 20 "High Error" 21 "Non Critical No LED" 27 "Critical Green LED" 32 "Stall!" 33 "Synchronized" 34 "Syncing" 35 "Error!" 36 "Error!" 37 "Uncalibrated" 38 "Open Loop" 39 "Closed Loop" 40 "Not Learn" 41 "Learning" 42 "Off" 43 "On" 44 "Not Rev Limiting" 45 "Rev Limit" 46 "No Cut Off" 47 "CutOff!" 48 "Off" 49 "Warning!" 50 "Caution!" 51 "No Timing modifier" 52 "Timing is being modified" 53 "Timing Value is being replaced" 54 "Acq Sat" 55 "No GPS" 56 "No Data" 22 "Non Critical Green LED" 23 "Non Critical Yellow LED" 24 "Non Critical Red LED" 25 "Non Critical Blue LED" 26 "Non Critical Grey LED" 28 "Critical Yellow LED" 29 "Critical Red LED" 30 "Critical Blue LED" 31 "Critical Grey LED";
VAL_ 2656473088 Status 0 "OK" 1 "Disabled" 2 "Initializing" 3 "Heating" 4 "WB_Active" 5 "Too Cold" 6 "Too Hot" 7 "Unplugged" 8 "Slow!" 9 "Uncal Yellow" 10 "Uncal Red" 11 "Replace" 12 "Disabled" 13 "Shorted" 14 "Open" 15 "Over Range" 16 "Under Range" 17 "Undefined" 18 "Error!" 19 "Low Error" 20 "High Error" 21 "Non Critical No LED" 27 "Critical Green LED" 32 "Stall!" 33 "Synchronized" 34 "Syncing" 35 "Error!" 36 "Error!" 37 "Uncalibrated" 38 "Open Loop" 39 "Closed Loop" 40 "Not Learn" 41 "Learning" 42 "Off" 43 "On" 44 "Not Rev Limiting" 45 "Rev Limit" 46 "No Cut Off" 47 "CutOff!" 48 "Off" 49 "Warning!" 50 "Caution!" 51 "No Timing modifier" 52 "Timing is being modified" 53 "Timing Value is being replaced" 54 "Acq Sat" 55 "No GPS" 56 "No Data" 22 "Non Critical Green LED" 23 "Non Critical Yellow LED" 24 "Non Critical Red LED" 25 "Non Critical Blue LED" 26 "Non Critical Grey LED" 28 "Critical Yellow LED" 29 "Critical Red LED" 30 "Critical Blue LED" 31 "Critical Grey LED";
VAL_ 2656489472 Status 0 "OK" 1 "Disabled" 2 "Initializing" 3 "Heating" 4 "WB_Active" 5 "Too Cold" 6 "Too Hot" 7 "Unplugged" 8 "Slow!" 9 "Uncal Yellow" 10 "Uncal Red" 11 "Replace" 12 "Disabled" 13 "Shorted" 14 "Open" 15 "Over Range" 16 "Under Range" 17 "Undefined" 18 "Error!" 19 "Low Error" 20 "High Error" 21 "Non Critical No LED" 27 "Critical Green LED" 32 "Stall!" 33 "Synchronized" 34 "Syncing" 35 "Error!" 36 "Error!" 37 "Uncalibrated" 38 "Open Loop" 39 "Closed Loop" 40 "Not Learn" 41 "Learning" 42 "Off" 43 "On" 44 "Not Rev Limiting" 45 "Rev Limit" 46 "No Cut Off" 47 "CutOff!" 48 "Off" 49 "Warning!" 50 "Caution!" 51 "No Timing modifier" 52 "Timing is being modified" 53 "Timing Value is being replaced" 54 "Acq Sat" 55 "No GPS" 56 "No Data" 22 "Non Critical Green LED" 23 "Non Critical Yellow LED" 24 "Non Critical Red LED" 25 "Non Critical Blue LED" 26 "Non Critical Grey LED" 28 "Critical Yellow LED" 29 "Critical Red LED" 30 "Critical Blue LED" 31 "Critical Grey LED";
SIG_VALTYPE_ 2653655040 GPO_7 : 1;
SIG_VALTYPE_ 2653671424 GPO_8 : 1;
SIG_VALTYPE_ 2653687808 N2O_Enabled : 1;
SIG_VALTYPE_ 2653704192 N2O_Input_1 : 1;
SIG_VALTYPE_ 2653720576 N2O_Input_2 : 1;
SIG_VALTYPE_ 2653736960 N2O_Input_3 : 1;
SIG_VALTYPE_ 2653753344 N2O_Input_4 : 1;
SIG_VALTYPE_ 2653769728 N2O_Input_5 : 1;
SIG_VALTYPE_ 2653786112 N2O_Input_6 : 1;
SIG_VALTYPE_ 2653802496 N2O_Input_7 : 1;
SIG_VALTYPE_ 2653818880 N2O_Input_8 : 1;
SIG_VALTYPE_ 2653835264 N2O_Purge : 1;
SIG_VALTYPE_ 2653851648 N2O_Lean_Cutoff : 1;
SIG_VALTYPE_ 2653868032 N2O_Rich_Cutoff : 1;
SIG_VALTYPE_ 2653884416 N2O_RPM_Cutoff : 1;
SIG_VALTYPE_ 2653900800 N2O_MAP_Cutoff : 1;
SIG_VALTYPE_ 2653917184 N2O_Purge_Output : 1;
SIG_VALTYPE_ 2653933568 N2O_Dry_Fuel_1 : 1;
SIG_VALTYPE_ 2653949952 N2O_Dry_Fuel_2 : 1;
SIG_VALTYPE_ 2653966336 N2O_Dry_Fuel_3 : 1;
SIG_VALTYPE_ 2653982720 N2O_Dry_Fuel_4 : 1;
SIG_VALTYPE_ 2653999104 N2O_Dry_Fuel_5 : 1;
SIG_VALTYPE_ 2654015488 N2O_Dry_Fuel_6 : 1;
SIG_VALTYPE_ 2654031872 N2O_Dry_Fuel_7 : 1;
SIG_VALTYPE_ 2654048256 N2O_Dry_Fuel_8 : 1;
SIG_VALTYPE_ 2654064640 N2O_Tmg_Mod_1 : 1;
SIG_VALTYPE_ 2654081024 N2O_Tmg_Mod_2 : 1;
SIG_VALTYPE_ 2654097408 N2O_Tmg_Mod_3 : 1;
SIG_VALTYPE_ 2654113792 N2O_Tmg_Mod_4 : 1;
SIG_VALTYPE_ 2654130176 N2O_Tmg_Mod_5 : 1;
SIG_VALTYPE_ 2654146560 N2O_Tmg_Mod_6 : 1;
SIG_VALTYPE_ 2654162944 N2O_Tmg_Mod_7 : 1;
SIG_VALTYPE_ 2654179328 N2O_Tmg_Mod_8 : 1;
SIG_VALTYPE_ 2654195712 N2O_Timer_1 : 1;
SIG_VALTYPE_ 2654212096 N2O_Timer_2 : 1;
SIG_VALTYPE_ 2654228480 N2O_Timer_3 : 1;
SIG_VALTYPE_ 2654244864 N2O_Timer_4 : 1;
SIG_VALTYPE_ 2654261248 N2O_Timer_5 : 1;
SIG_VALTYPE_ 2654277632 N2O_Timer_6 : 1;
SIG_VALTYPE_ 2654294016 N2O_Timer_7 : 1;
SIG_VALTYPE_ 2654310400 N2O_Timer_8 : 1;
SIG_VALTYPE_ 2654392320 Gear : 1;
SIG_VALTYPE_ 2654408704 Speed : 1;
SIG_VALTYPE_ 2654425088 Line_Pressure : 1;
SIG_VALTYPE_ 2654441472 Input_Shaft_Speed : 1;
SIG_VALTYPE_ 2654457856 Accum_Pressure : 1;
SIG_VALTYPE_ 2654474240 TCC_Duty_Cycle : 1;
SIG_VALTYPE_ 2654490624 Line_Temp : 1;
SIG_VALTYPE_ 2654507008 Torque_Time : 1;
SIG_VALTYPE_ 2654523392 Trans_Man_US_Input : 1;
SIG_VALTYPE_ 2654539776 Trans_Man_DS_Input : 1;
SIG_VALTYPE_ 2654556160 Trans_AutoMan_In : 1;
SIG_VALTYPE_ 2654572544 Trans_Switch_Position : 1;
SIG_VALTYPE_ 2654605312 TB_TPS_1 : 1;
SIG_VALTYPE_ 2654621696 TB_TPS_2 : 1;
SIG_VALTYPE_ 2654638080 Pedal_TPS_1 : 1;
SIG_VALTYPE_ 2654654464 Pedal_TPS_2 : 1;
SIG_VALTYPE_ 2654670848 TB2_TPS_1 : 1;
SIG_VALTYPE_ 2654687232 TB2_TPS_2 : 1;
SIG_VALTYPE_ 2654703616 TB_Position : 1;
SIG_VALTYPE_ 2654720000 TB2_Position : 1;
SIG_VALTYPE_ 2654736384 Brake_Pedal : 1;
SIG_VALTYPE_ 2654769152 Diag_1 : 1;
SIG_VALTYPE_ 2654785536 Diag_2 : 1;
SIG_VALTYPE_ 2654801920 Diag_3 : 1;
SIG_VALTYPE_ 2654818304 Diag_4 : 1;
SIG_VALTYPE_ 2654834688 Diag_5 : 1;
SIG_VALTYPE_ 2654851072 Diag_6 : 1;
SIG_VALTYPE_ 2654867456 Diag_7 : 1;
SIG_VALTYPE_ 2654883840 Diag_8 : 1;
SIG_VALTYPE_ 2654900224 Diag_9 : 1;
SIG_VALTYPE_ 2654916608 Diag_10 : 1;
SIG_VALTYPE_ 2654932992 Diag_11 : 1;
SIG_VALTYPE_ 2654949376 Diag_12 : 1;
SIG_VALTYPE_ 2654965760 Diag_13 : 1;
SIG_VALTYPE_ 2654982144 Diag_14 : 1;
SIG_VALTYPE_ 2654998528 Diag_15 : 1;
SIG_VALTYPE_ 2655014912 Diag_16 : 1;
SIG_VALTYPE_ 2655031296 Diag_17 : 1;
SIG_VALTYPE_ 2655047680 Diag_18 : 1;
SIG_VALTYPE_ 2655064064 Diag_19 : 1;
SIG_VALTYPE_ 2655080448 Diag_20 : 1;
SIG_VALTYPE_ 2655096832 AT_Launch_Input : 1;
SIG_VALTYPE_ 2655113216 AT_Shift_Input : 1;
SIG_VALTYPE_ 2655129600 AT_Manual_Reset : 1;
SIG_VALTYPE_ 2655145984 AT_Gear : 1;
SIG_VALTYPE_ 2655162368 AT_1D_1 : 1;
SIG_VALTYPE_ 2655178752 AT_1D_2 : 1;
SIG_VALTYPE_ 2655195136 AT_1D_3 : 1;
SIG_VALTYPE_ 2655211520 AT_1D_4 : 1;
SIG_VALTYPE_ 2655227904 AT_1D_5 : 1;
SIG_VALTYPE_ 2655244288 AT_1D_6 : 1;
SIG_VALTYPE_ 2655260672 AT_1D_7 : 1;
SIG_VALTYPE_ 2655277056 AT_1D_8 : 1;
SIG_VALTYPE_ 2655293440 AT_2D_1 : 1;
SIG_VALTYPE_ 2655309824 AT_2D_2 : 1;
SIG_VALTYPE_ 2655326208 AT_2D_3 : 1;
SIG_VALTYPE_ 2655342592 AT_2D_4 : 1;
SIG_VALTYPE_ 2655358976 AT_2D_5 : 1;
SIG_VALTYPE_ 2655375360 AT_2D_6 : 1;
SIG_VALTYPE_ 2655391744 AT_2D_7 : 1;
SIG_VALTYPE_ 2655408128 AT_2D_8 : 1;
SIG_VALTYPE_ 2655424512 AT_1D_Gear_1 : 1;
SIG_VALTYPE_ 2655440896 AT_1D_Gear_2 : 1;
SIG_VALTYPE_ 2655457280 AT_1D_Gear_3 : 1;
SIG_VALTYPE_ 2655473664 AT_1D_Gear_4 : 1;
SIG_VALTYPE_ 2655490048 AT_1D_Gear_5 : 1;
SIG_VALTYPE_ 2655506432 AT_1D_Gear_6 : 1;
SIG_VALTYPE_ 2655522816 AT_1D_Gear_7 : 1;
SIG_VALTYPE_ 2655539200 AT_1D_Gear_8 : 1;
SIG_VALTYPE_ 2655555584 AT_2D_Gear_1 : 1;
SIG_VALTYPE_ 2655571968 AT_2D_Gear_2 : 1;
SIG_VALTYPE_ 2655588352 AT_2D_Gear_3 : 1;
SIG_VALTYPE_ 2655604736 AT_2D_Gear_4 : 1;
SIG_VALTYPE_ 2655621120 AT_2D_Gear_5 : 1;
SIG_VALTYPE_ 2655637504 AT_2D_Gear_6 : 1;
SIG_VALTYPE_ 2655653888 AT_2D_Gear_7 : 1;
SIG_VALTYPE_ 2655670272 AT_2D_Gear_8 : 1;
SIG_VALTYPE_ 2655686656 Input_1 : 1;
SIG_VALTYPE_ 2655703040 Input_2 : 1;
SIG_VALTYPE_ 2655719424 Input_3 : 1;
SIG_VALTYPE_ 2655735808 Input_4 : 1;
SIG_VALTYPE_ 2655752192 Input_5 : 1;
SIG_VALTYPE_ 2655768576 Input_6 : 1;
SIG_VALTYPE_ 2655784960 Input_7 : 1;
SIG_VALTYPE_ 2655801344 Input_8 : 1;
SIG_VALTYPE_ 2655817728 Input_9 : 1;
SIG_VALTYPE_ 2655834112 Input_10 : 1;
SIG_VALTYPE_ 2655850496 Input_11 : 1;
SIG_VALTYPE_ 2655866880 Input_12 : 1;
SIG_VALTYPE_ 2655883264 Input_13 : 1;
SIG_VALTYPE_ 2655899648 Input_14 : 1;
SIG_VALTYPE_ 2655916032 Input_15 : 1;
SIG_VALTYPE_ 2655932416 Input_16 : 1;
SIG_VALTYPE_ 2655948800 Input_17 : 1;
SIG_VALTYPE_ 2655965184 Input_18 : 1;
SIG_VALTYPE_ 2655981568 Input_19 : 1;
SIG_VALTYPE_ 2655997952 Input_20 : 1;
SIG_VALTYPE_ 2656014336 Input_21 : 1;
SIG_VALTYPE_ 2656030720 Input_22 : 1;
SIG_VALTYPE_ 2656047104 Input_23 : 1;
SIG_VALTYPE_ 2656063488 Input_24 : 1;
SIG_VALTYPE_ 2656079872 Input_25 : 1;
SIG_VALTYPE_ 2656096256 Input_26 : 1;
SIG_VALTYPE_ 2656112640 Input_27 : 1;
SIG_VALTYPE_ 2656129024 Input_28 : 1;
SIG_VALTYPE_ 2656145408 Input_29 : 1;
SIG_VALTYPE_ 2656161792 Input_30 : 1;
SIG_VALTYPE_ 2656178176 Input_31 : 1;
SIG_VALTYPE_ 2656194560 Input_32 : 1;
SIG_VALTYPE_ 2656210944 Input_33 : 1;
SIG_VALTYPE_ 2656227328 Input_34 : 1;
SIG_VALTYPE_ 2656243712 Input_35 : 1;
SIG_VALTYPE_ 2656260096 Input_36 : 1;
SIG_VALTYPE_ 2656276480 Input_37 : 1;
SIG_VALTYPE_ 2656292864 Input_38 : 1;
SIG_VALTYPE_ 2656309248 Input_39 : 1;
SIG_VALTYPE_ 2656325632 Input_40 : 1;
SIG_VALTYPE_ 2656342016 Input_41 : 1;
SIG_VALTYPE_ 2656358400 Input_42 : 1;
SIG_VALTYPE_ 2656374784 Input_43 : 1;
SIG_VALTYPE_ 2656391168 Input_44 : 1;
SIG_VALTYPE_ 2656407552 Input_45 : 1;
SIG_VALTYPE_ 2656423936 Input_46 : 1;
SIG_VALTYPE_ 2656440320 Input_47 : 1;
SIG_VALTYPE_ 2656456704 Input_48 : 1;
SIG_VALTYPE_ 2656473088 Input_49 : 1;
SIG_VALTYPE_ 2656489472 Input_50 : 1;
