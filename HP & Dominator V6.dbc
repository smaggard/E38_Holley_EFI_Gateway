VERSION ""

NS_ :

BS_:

BU_: Vector__XXX

BO_ 2650804224 RTC: 8 Vector__XXX
SG_ RTC : 7|64@0+ (1,0) [0|18446744073709551615] "ms" Vector__XXX

BO_ 2650820608 RPM: 8 Vector__XXX
SG_ RPM : 7|32@0- (1,0) [0.00|20000.00] "RPM" Vector__XXX
SG_ Status : 63|8@0+ (1,0) [0|255] "" Vector__XXX

BO_ 2650836992 Inj_PW: 8 Vector__XXX
SG_ Inj_PW : 7|32@0- (1,0) [0.00|70.00] "ms" Vector__XXX
SG_ Status : 63|8@0+ (1,0) [0|255] "" Vector__XXX

BO_ 2650853376 Duty_Cycle: 8 Vector__XXX
SG_ Duty_Cycle : 7|32@0- (1,0) [0.00|100.00] "%" Vector__XXX
SG_ Status : 63|8@0+ (1,0) [0|255] "" Vector__XXX

BO_ 2650869760 CL_Comp: 8 Vector__XXX
SG_ CL_Comp : 7|32@0- (1,0) [0.00|999.00] "%" Vector__XXX
SG_ Status : 63|8@0+ (1,0) [0|255] "" Vector__XXX

BO_ 2650886144 Target_AFR: 8 Vector__XXX
SG_ Target_AFR : 7|32@0- (1,0) [2.00|20.00] "A/F" Vector__XXX
SG_ Status : 63|8@0+ (1,0) [0|255] "" Vector__XXX

BO_ 2650902528 AFR_Left: 8 Vector__XXX
SG_ AFR_Left : 7|32@0- (1,0) [2.00|20.00] "A/F" Vector__XXX
SG_ Status : 63|8@0+ (1,0) [0|255] "" Vector__XXX

BO_ 2650918912 AFR_Right: 8 Vector__XXX
SG_ AFR_Right : 7|32@0- (1,0) [2.00|20.00] "A/F" Vector__XXX
SG_ Status : 63|8@0+ (1,0) [0|255] "" Vector__XXX

BO_ 2650935296 AFR_Average: 8 Vector__XXX
SG_ AFR_Average : 7|32@0- (1,0) [2.00|20.00] "A/F" Vector__XXX
SG_ Status : 63|8@0+ (1,0) [0|255] "" Vector__XXX

BO_ 2650951680 Air_Temp_Enr: 8 Vector__XXX
SG_ Air_Temp_Enr : 7|32@0- (1,0) [0.00|600.00] "%" Vector__XXX
SG_ Status : 63|8@0+ (1,0) [0|255] "" Vector__XXX

BO_ 2650968064 Coolant_Enr: 8 Vector__XXX
SG_ Coolant_Enr : 7|32@0- (1,0) [70.00|200.00] "%" Vector__XXX
SG_ Status : 63|8@0+ (1,0) [0|255] "" Vector__XXX

BO_ 2650984448 Coolant_AFR_Offset: 8 Vector__XXX
SG_ Coolant_AFR_Offset : 7|32@0- (1,0) [-5.00|5.00] "A/F" Vector__XXX
SG_ Status : 63|8@0+ (1,0) [0|255] "" Vector__XXX

BO_ 2651000832 Afterstart_Enr: 8 Vector__XXX
SG_ Afterstart_Enr : 7|32@0- (1,0) [75.00|300.00] "%" Vector__XXX
SG_ Status : 63|8@0+ (1,0) [0|255] "" Vector__XXX

BO_ 2651017216 Current_Learn: 8 Vector__XXX
SG_ Current_Learn : 7|32@0- (1,0) [-100.00|100.00] "%" Vector__XXX
SG_ Status : 63|8@0+ (1,0) [0|255] "" Vector__XXX

BO_ 2651033600 CL_Status: 8 Vector__XXX
SG_ CL_Status : 7|32@0- (1,0) [0.00|1.00] "" Vector__XXX
SG_ Status : 63|8@0+ (1,0) [0|255] "" Vector__XXX

BO_ 2651049984 Learn_Status: 8 Vector__XXX
SG_ Learn_Status : 7|32@0- (1,0) [0.00|1.00] "" Vector__XXX
SG_ Status : 63|8@0+ (1,0) [0|255] "" Vector__XXX

BO_ 2651066368 Fuel_Economy: 8 Vector__XXX
SG_ Fuel_Economy : 7|32@0- (1,0) [0.00|99999.00] "mpg" Vector__XXX
SG_ Status : 63|8@0+ (1,0) [0|255] "" Vector__XXX

BO_ 2651082752 Fuel_Flow: 8 Vector__XXX
SG_ Fuel_Flow : 7|32@0- (1,0) [0.00|2000.00] "lb/h" Vector__XXX
SG_ Status : 63|8@0+ (1,0) [0|255] "" Vector__XXX

BO_ 2651099136 MAP_RoC: 8 Vector__XXX
SG_ MAP_RoC : 7|32@0- (1,0) [0.00|999.00] "kpa/sec x10" Vector__XXX
SG_ Status : 63|8@0+ (1,0) [0|255] "" Vector__XXX

BO_ 2651115520 TPS_RoC: 8 Vector__XXX
SG_ TPS_RoC : 7|32@0- (1,0) [0.00|1000.00] "%/sec" Vector__XXX
SG_ Status : 63|8@0+ (1,0) [0|255] "" Vector__XXX

BO_ 2651131904 Tuning_Change: 8 Vector__XXX
SG_ Tuning_Change : 7|32@0- (1,0) [0.00|1.00] "" Vector__XXX
SG_ Status : 63|8@0+ (1,0) [0|255] "" Vector__XXX

BO_ 2651148288 Estimated_VE: 8 Vector__XXX
SG_ Estimated_VE : 7|32@0- (1,0) [0.00|300.00] "lb/h" Vector__XXX
SG_ Status : 63|8@0+ (1,0) [0|255] "" Vector__XXX

BO_ 2651164672 Ignition_Timing: 8 Vector__XXX
SG_ Ignition_Timing : 7|32@0- (1,0) [-10.00|60.00] "°" Vector__XXX
SG_ Status : 63|8@0+ (1,0) [0|255] "" Vector__XXX

BO_ 2651181056 Knock_Retard: 8 Vector__XXX
SG_ Knock_Retard : 7|32@0- (1,0) [-10.00|60.00] "°" Vector__XXX
SG_ Status : 63|8@0+ (1,0) [0|255] "" Vector__XXX

BO_ 2651197440 Knock_Level: 8 Vector__XXX
SG_ Knock_Level : 7|32@0- (1,0) [0.00|100.00] "%" Vector__XXX
SG_ Status : 63|8@0+ (1,0) [0|255] "" Vector__XXX

BO_ 2651230208 IAC_Position: 8 Vector__XXX
SG_ IAC_Position : 7|32@0- (1,0) [0.00|100.00] "%" Vector__XXX
SG_ Status : 63|8@0+ (1,0) [0|255] "" Vector__XXX

BO_ 2651246592 Target_Idle_Speed: 8 Vector__XXX
SG_ Target_Idle_Speed : 7|32@0- (1,0) [0.00|20000.00] "RPM" Vector__XXX
SG_ Status : 63|8@0+ (1,0) [0|255] "" Vector__XXX

BO_ 2651262976 MAP: 8 Vector__XXX
SG_ MAP : 7|32@0- (1,0) [0.00|999.00] "kpa" Vector__XXX
SG_ Status : 63|8@0+ (1,0) [0|255] "" Vector__XXX

BO_ 2651279360 TPS: 8 Vector__XXX
SG_ TPS : 7|32@0- (1,0) [0.00|100.00] "%" Vector__XXX
SG_ Status : 63|8@0+ (1,0) [0|255] "" Vector__XXX

BO_ 2651295744 MAT: 8 Vector__XXX
SG_ MAT : 7|32@0- (1,0) [-40.00|260.00] "°F" Vector__XXX
SG_ Status : 63|8@0+ (1,0) [0|255] "" Vector__XXX

BO_ 2651312128 CTS: 8 Vector__XXX
SG_ CTS : 7|32@0- (1,0) [-40.00|260.00] "°F" Vector__XXX
SG_ Status : 63|8@0+ (1,0) [0|255] "" Vector__XXX

BO_ 2651328512 Baro: 8 Vector__XXX
SG_ Baro : 7|32@0- (1,0) [0.00|110.00] "kpa" Vector__XXX
SG_ Status : 63|8@0+ (1,0) [0|255] "" Vector__XXX

BO_ 2651344896 Battery: 8 Vector__XXX
SG_ Battery : 7|32@0- (1,0) [0.00|20.00] "V" Vector__XXX
SG_ Status : 63|8@0+ (1,0) [0|255] "" Vector__XXX

BO_ 2651361280 Oil_Pressure: 8 Vector__XXX
SG_ Oil_Pressure : 7|32@0- (1,0) [0.00|100.00] "PSIa" Vector__XXX
SG_ Status : 63|8@0+ (1,0) [0|255] "" Vector__XXX

BO_ 2651377664 Fuel_Pressure: 8 Vector__XXX
SG_ Fuel_Pressure : 7|32@0- (1,0) [0.00|100.00] "PSIa" Vector__XXX
SG_ Status : 63|8@0+ (1,0) [0|255] "" Vector__XXX

BO_ 2651394048 Pedal_Position: 8 Vector__XXX
SG_ Pedal_Position : 7|32@0- (1,0) [0.00|100.00] "%" Vector__XXX
SG_ Status : 63|8@0+ (1,0) [0|255] "" Vector__XXX

BO_ 2651410432 Main_Rev_Limit: 8 Vector__XXX
SG_ Main_Rev_Limit : 7|32@0- (1,0) [0.00|1.00] "" Vector__XXX
SG_ Status : 63|8@0+ (1,0) [0|255] "" Vector__XXX

BO_ 2651426816 Rev_Limit_1: 8 Vector__XXX
SG_ Rev_Limit_1 : 7|32@0- (1,0) [0.00|1.00] "" Vector__XXX
SG_ Status : 63|8@0+ (1,0) [0|255] "" Vector__XXX

BO_ 2651443200 Rev_Limit_2: 8 Vector__XXX
SG_ Rev_Limit_2 : 7|32@0- (1,0) [0.00|1.00] "" Vector__XXX
SG_ Status : 63|8@0+ (1,0) [0|255] "" Vector__XXX

BO_ 2651459584 AC_Kick: 8 Vector__XXX
SG_ AC_Kick : 7|32@0- (1,0) [0.00|1.00] "" Vector__XXX
SG_ Status : 63|8@0+ (1,0) [0|255] "" Vector__XXX

BO_ 2651475968 Timing_Retard_1: 8 Vector__XXX
SG_ Timing_Retard_1 : 7|32@0- (1,0) [-10.00|60.00] "°" Vector__XXX
SG_ Status : 63|8@0+ (1,0) [0|255] "" Vector__XXX

BO_ 2651492352 Timing_Retard_2: 8 Vector__XXX
SG_ Timing_Retard_2 : 7|32@0- (1,0) [-10.00|60.00] "°" Vector__XXX
SG_ Status : 63|8@0+ (1,0) [0|255] "" Vector__XXX

BO_ 2651508736 Timing_Retard_3: 8 Vector__XXX
SG_ Timing_Retard_3 : 7|32@0- (1,0) [-10.00|60.00] "°" Vector__XXX
SG_ Status : 63|8@0+ (1,0) [0|255] "" Vector__XXX

BO_ 2651525120 Fan_1: 8 Vector__XXX
SG_ Fan_1 : 7|32@0- (1,0) [0.00|1.00] "" Vector__XXX
SG_ Status : 63|8@0+ (1,0) [0|255] "" Vector__XXX

BO_ 2651541504 Fan_2: 8 Vector__XXX
SG_ Fan_2 : 7|32@0- (1,0) [0.00|1.00] "" Vector__XXX
SG_ Status : 63|8@0+ (1,0) [0|255] "" Vector__XXX

BO_ 2651557888 Fuel_Pump_2: 8 Vector__XXX
SG_ Fuel_Pump_2 : 7|32@0- (1,0) [0.00|1.00] "" Vector__XXX
SG_ Status : 63|8@0+ (1,0) [0|255] "" Vector__XXX

BO_ 2651574272 AC_Shutdown: 8 Vector__XXX
SG_ AC_Shutdown : 7|32@0- (1,0) [0.00|1.00] "" Vector__XXX
SG_ Status : 63|8@0+ (1,0) [0|255] "" Vector__XXX

BO_ 2651590656 TCC_Lockup: 8 Vector__XXX
SG_ TCC_Lockup : 7|32@0- (1,0) [0.00|1.00] "" Vector__XXX
SG_ Status : 63|8@0+ (1,0) [0|255] "" Vector__XXX

BO_ 2651607040 Sensor_Warning: 8 Vector__XXX
SG_ Sensor_Warning : 7|32@0- (1,0) [0.00|1.00] "" Vector__XXX
SG_ Status : 63|8@0+ (1,0) [0|255] "" Vector__XXX

BO_ 2651623424 Sensor_Caution: 8 Vector__XXX
SG_ Sensor_Caution : 7|32@0- (1,0) [0.00|1.00] "" Vector__XXX
SG_ Status : 63|8@0+ (1,0) [0|255] "" Vector__XXX

BO_ 2651639808 Base_Fuel_lbhr: 8 Vector__XXX
SG_ Base_Fuel_lbhr : 7|32@0- (1,0) [0.00|2000.00] "lb/h" Vector__XXX
SG_ Status : 63|8@0+ (1,0) [0|255] "" Vector__XXX

BO_ 2651656192 Base_Fuel_VE: 8 Vector__XXX
SG_ Base_Fuel_VE : 7|32@0- (1,0) [0.00|300.00] "lb/h" Vector__XXX
SG_ Status : 63|8@0+ (1,0) [0|255] "" Vector__XXX

BO_ 2651672576 Base_Timing: 8 Vector__XXX
SG_ Base_Timing : 7|32@0- (1,0) [-10.00|60.00] "°" Vector__XXX
SG_ Status : 63|8@0+ (1,0) [0|255] "" Vector__XXX

BO_ 2651688960 Base_Target_AFR: 8 Vector__XXX
SG_ Base_Target_AFR : 7|32@0- (1,0) [2.00|20.00] "lb/h" Vector__XXX
SG_ Status : 63|8@0+ (1,0) [0|255] "" Vector__XXX

BO_ 2651705344 Base_Ign_Dwell: 8 Vector__XXX
SG_ Base_Ign_Dwell : 7|32@0- (1,0) [0.00|10.00] "ms" Vector__XXX
SG_ Status : 63|8@0+ (1,0) [0|255] "" Vector__XXX

BO_ 2651721728 Vol_Comp_Ign_Dwell: 8 Vector__XXX
SG_ Vol_Comp_Ign_Dwell : 7|32@0- (1,0) [0.00|10.00] "ms" Vector__XXX
SG_ Status : 63|8@0+ (1,0) [0|255] "" Vector__XXX

BO_ 2651738112 Inj_End_Angle: 8 Vector__XXX
SG_ Inj_End_Angle : 7|32@0- (1,0) [-720.00|720.00] "°" Vector__XXX
SG_ Status : 63|8@0+ (1,0) [0|255] "" Vector__XXX

BO_ 2651754496 ECU_Log_Trigger: 8 Vector__XXX
SG_ ECU_Log_Trigger : 7|32@0- (1,0) [0.00|-1.00] "s" Vector__XXX
SG_ Status : 63|8@0+ (1,0) [0|255] "" Vector__XXX

BO_ 2651770880 Timing_vs_Air: 8 Vector__XXX
SG_ Timing_vs_Air : 7|32@0- (1,0) [-20.00|20.00] "°" Vector__XXX
SG_ Status : 63|8@0+ (1,0) [0|255] "" Vector__XXX

BO_ 2651787264 Timing_vs_Cool: 8 Vector__XXX
SG_ Timing_vs_Cool : 7|32@0- (1,0) [-20.00|20.00] "°" Vector__XXX
SG_ Status : 63|8@0+ (1,0) [0|255] "" Vector__XXX

BO_ 2651803648 Status_1: 8 Vector__XXX
SG_ Status_1 : 7|32@0- (1,0) [0.00|99999.00] "None" Vector__XXX
SG_ Status : 63|8@0+ (1,0) [0|255] "" Vector__XXX

BO_ 2651820032 Status_2: 8 Vector__XXX
SG_ Status_2 : 7|32@0- (1,0) [0.00|99999.00] "None" Vector__XXX
SG_ Status : 63|8@0+ (1,0) [0|255] "" Vector__XXX

BO_ 2651836416 Status_3: 8 Vector__XXX
SG_ Status_3 : 7|32@0- (1,0) [0.00|99999.00] "None" Vector__XXX
SG_ Status : 63|8@0+ (1,0) [0|255] "" Vector__XXX

BO_ 2651852800 Status_4: 8 Vector__XXX
SG_ Status_4 : 7|32@0- (1,0) [0.00|99999.00] "None" Vector__XXX
SG_ Status : 63|8@0+ (1,0) [0|255] "" Vector__XXX

BO_ 2651869184 Status_5: 8 Vector__XXX
SG_ Status_5 : 7|32@0- (1,0) [0.00|99999.00] "None" Vector__XXX
SG_ Status : 63|8@0+ (1,0) [0|255] "" Vector__XXX

BO_ 2651885568 Status_6: 8 Vector__XXX
SG_ Status_6 : 7|32@0- (1,0) [0.00|99999.00] "None" Vector__XXX
SG_ Status : 63|8@0+ (1,0) [0|255] "" Vector__XXX

BO_ 2651901952 Status_7: 8 Vector__XXX
SG_ Status_7 : 7|32@0- (1,0) [0.00|99999.00] "None" Vector__XXX
SG_ Status : 63|8@0+ (1,0) [0|255] "" Vector__XXX

BO_ 2651918336 Status_8: 8 Vector__XXX
SG_ Status_8 : 7|32@0- (1,0) [0.00|99999.00] "None" Vector__XXX
SG_ Status : 63|8@0+ (1,0) [0|255] "" Vector__XXX

BO_ 2651934720 Injector_1_PPH: 8 Vector__XXX
SG_ Injector_1_PPH : 7|32@0- (1,0) [0.00|5000.00] "lb/h" Vector__XXX
SG_ Status : 63|8@0+ (1,0) [0|255] "" Vector__XXX

BO_ 2651951104 Injector_2_PPH: 8 Vector__XXX
SG_ Injector_2_PPH : 7|32@0- (1,0) [0.00|5000.00] "lb/h" Vector__XXX
SG_ Status : 63|8@0+ (1,0) [0|255] "" Vector__XXX

BO_ 2651967488 Injector_3_PPH: 8 Vector__XXX
SG_ Injector_3_PPH : 7|32@0- (1,0) [0.00|5000.00] "lb/h" Vector__XXX
SG_ Status : 63|8@0+ (1,0) [0|255] "" Vector__XXX

BO_ 2651983872 Injector_4_PPH: 8 Vector__XXX
SG_ Injector_4_PPH : 7|32@0- (1,0) [0.00|5000.00] "lb/h" Vector__XXX
SG_ Status : 63|8@0+ (1,0) [0|255] "" Vector__XXX

BO_ 2652000256 Injector_5_PPH: 8 Vector__XXX
SG_ Injector_5_PPH : 7|32@0- (1,0) [0.00|5000.00] "lb/h" Vector__XXX
SG_ Status : 63|8@0+ (1,0) [0|255] "" Vector__XXX

BO_ 2652016640 Injector_6_PPH: 8 Vector__XXX
SG_ Injector_6_PPH : 7|32@0- (1,0) [0.00|5000.00] "lb/h" Vector__XXX
SG_ Status : 63|8@0+ (1,0) [0|255] "" Vector__XXX

BO_ 2652033024 Injector_7_PPH: 8 Vector__XXX
SG_ Injector_7_PPH : 7|32@0- (1,0) [0.00|5000.00] "lb/h" Vector__XXX
SG_ Status : 63|8@0+ (1,0) [0|255] "" Vector__XXX

BO_ 2652049408 Injector_8_PPH: 8 Vector__XXX
SG_ Injector_8_PPH : 7|32@0- (1,0) [0.00|5000.00] "lb/h" Vector__XXX
SG_ Status : 63|8@0+ (1,0) [0|255] "" Vector__XXX

BO_ 2652065792 Injector_9_PPH: 8 Vector__XXX
SG_ Injector_9_PPH : 7|32@0- (1,0) [0.00|5000.00] "lb/h" Vector__XXX
SG_ Status : 63|8@0+ (1,0) [0|255] "" Vector__XXX

BO_ 2652082176 Injector_10_PPH: 8 Vector__XXX
SG_ Injector_10_PPH : 7|32@0- (1,0) [0.00|5000.00] "lb/h" Vector__XXX
SG_ Status : 63|8@0+ (1,0) [0|255] "" Vector__XXX

BO_ 2652098560 Injector_11_PPH: 8 Vector__XXX
SG_ Injector_11_PPH : 7|32@0- (1,0) [0.00|5000.00] "lb/h" Vector__XXX
SG_ Status : 63|8@0+ (1,0) [0|255] "" Vector__XXX

BO_ 2652114944 Injector_12_PPH: 8 Vector__XXX
SG_ Injector_12_PPH : 7|32@0- (1,0) [0.00|5000.00] "lb/h" Vector__XXX
SG_ Status : 63|8@0+ (1,0) [0|255] "" Vector__XXX

BO_ 2652131328 Injector_1_PW: 8 Vector__XXX
SG_ Injector_1_PW : 7|32@0- (1,0) [0.00|70.00] "µs" Vector__XXX
SG_ Status : 63|8@0+ (1,0) [0|255] "" Vector__XXX

BO_ 2652147712 Injector_2_PW: 8 Vector__XXX
SG_ Injector_2_PW : 7|32@0- (1,0) [0.00|70.00] "µs" Vector__XXX
SG_ Status : 63|8@0+ (1,0) [0|255] "" Vector__XXX

BO_ 2652164096 Injector_3_PW: 8 Vector__XXX
SG_ Injector_3_PW : 7|32@0- (1,0) [0.00|70.00] "µs" Vector__XXX
SG_ Status : 63|8@0+ (1,0) [0|255] "" Vector__XXX

BO_ 2652180480 Injector_4_PW: 8 Vector__XXX
SG_ Injector_4_PW : 7|32@0- (1,0) [0.00|70.00] "µs" Vector__XXX
SG_ Status : 63|8@0+ (1,0) [0|255] "" Vector__XXX

BO_ 2652196864 Injector_5_PW: 8 Vector__XXX
SG_ Injector_5_PW : 7|32@0- (1,0) [0.00|70.00] "µs" Vector__XXX
SG_ Status : 63|8@0+ (1,0) [0|255] "" Vector__XXX

BO_ 2652213248 Injector_6_PW: 8 Vector__XXX
SG_ Injector_6_PW : 7|32@0- (1,0) [0.00|70.00] "µs" Vector__XXX
SG_ Status : 63|8@0+ (1,0) [0|255] "" Vector__XXX

BO_ 2652229632 Injector_7_PW: 8 Vector__XXX
SG_ Injector_7_PW : 7|32@0- (1,0) [0.00|70.00] "µs" Vector__XXX
SG_ Status : 63|8@0+ (1,0) [0|255] "" Vector__XXX

BO_ 2652246016 Injector_8_PW: 8 Vector__XXX
SG_ Injector_8_PW : 7|32@0- (1,0) [0.00|70.00] "µs" Vector__XXX
SG_ Status : 63|8@0+ (1,0) [0|255] "" Vector__XXX

BO_ 2652262400 Injector_9_PW: 8 Vector__XXX
SG_ Injector_9_PW : 7|32@0- (1,0) [0.00|70.00] "µs" Vector__XXX
SG_ Status : 63|8@0+ (1,0) [0|255] "" Vector__XXX

BO_ 2652278784 Injector_10_PW: 8 Vector__XXX
SG_ Injector_10_PW : 7|32@0- (1,0) [0.00|70.00] "µs" Vector__XXX
SG_ Status : 63|8@0+ (1,0) [0|255] "" Vector__XXX

BO_ 2652295168 Injector_11_PW: 8 Vector__XXX
SG_ Injector_11_PW : 7|32@0- (1,0) [0.00|70.00] "µs" Vector__XXX
SG_ Status : 63|8@0+ (1,0) [0|255] "" Vector__XXX

BO_ 2652311552 Injector_12_PW: 8 Vector__XXX
SG_ Injector_12_PW : 7|32@0- (1,0) [0.00|70.00] "µs" Vector__XXX
SG_ Status : 63|8@0+ (1,0) [0|255] "" Vector__XXX

BO_ 2652327936 Cyl_1_Fuel_Cor: 8 Vector__XXX
SG_ Cyl_1_Fuel_Cor : 7|32@0- (1,0) [-50.00|50.00] "%" Vector__XXX
SG_ Status : 63|8@0+ (1,0) [0|255] "" Vector__XXX

BO_ 2652344320 Cyl_2_Fuel_Cor: 8 Vector__XXX
SG_ Cyl_2_Fuel_Cor : 7|32@0- (1,0) [-50.00|50.00] "%" Vector__XXX
SG_ Status : 63|8@0+ (1,0) [0|255] "" Vector__XXX

BO_ 2652360704 Cyl_3_Fuel_Cor: 8 Vector__XXX
SG_ Cyl_3_Fuel_Cor : 7|32@0- (1,0) [-50.00|50.00] "%" Vector__XXX
SG_ Status : 63|8@0+ (1,0) [0|255] "" Vector__XXX

BO_ 2652377088 Cyl_4_Fuel_Cor: 8 Vector__XXX
SG_ Cyl_4_Fuel_Cor : 7|32@0- (1,0) [-50.00|50.00] "%" Vector__XXX
SG_ Status : 63|8@0+ (1,0) [0|255] "" Vector__XXX

BO_ 2652393472 Cyl_5_Fuel_Cor: 8 Vector__XXX
SG_ Cyl_5_Fuel_Cor : 7|32@0- (1,0) [-50.00|50.00] "%" Vector__XXX
SG_ Status : 63|8@0+ (1,0) [0|255] "" Vector__XXX

BO_ 2652409856 Cyl_6_Fuel_Cor: 8 Vector__XXX
SG_ Cyl_6_Fuel_Cor : 7|32@0- (1,0) [-50.00|50.00] "%" Vector__XXX
SG_ Status : 63|8@0+ (1,0) [0|255] "" Vector__XXX

BO_ 2652426240 Cyl_7_Fuel_Cor: 8 Vector__XXX
SG_ Cyl_7_Fuel_Cor : 7|32@0- (1,0) [-50.00|50.00] "%" Vector__XXX
SG_ Status : 63|8@0+ (1,0) [0|255] "" Vector__XXX

BO_ 2652442624 Cyl_8_Fuel_Cor: 8 Vector__XXX
SG_ Cyl_8_Fuel_Cor : 7|32@0- (1,0) [-50.00|50.00] "%" Vector__XXX
SG_ Status : 63|8@0+ (1,0) [0|255] "" Vector__XXX

BO_ 2652459008 Cyl_9_Fuel_Cor: 8 Vector__XXX
SG_ Cyl_9_Fuel_Cor : 7|32@0- (1,0) [-50.00|50.00] "%" Vector__XXX
SG_ Status : 63|8@0+ (1,0) [0|255] "" Vector__XXX

BO_ 2652475392 Cyl_10_Fuel_Cor: 8 Vector__XXX
SG_ Cyl_10_Fuel_Cor : 7|32@0- (1,0) [-50.00|50.00] "%" Vector__XXX
SG_ Status : 63|8@0+ (1,0) [0|255] "" Vector__XXX

BO_ 2652491776 Cyl_11_Fuel_Cor: 8 Vector__XXX
SG_ Cyl_11_Fuel_Cor : 7|32@0- (1,0) [-50.00|50.00] "%" Vector__XXX
SG_ Status : 63|8@0+ (1,0) [0|255] "" Vector__XXX

BO_ 2652508160 Cyl_12_Fuel_Cor: 8 Vector__XXX
SG_ Cyl_12_Fuel_Cor : 7|32@0- (1,0) [-50.00|50.00] "%" Vector__XXX
SG_ Status : 63|8@0+ (1,0) [0|255] "" Vector__XXX

BO_ 2652524544 Cyl_13_Fuel_Cor: 8 Vector__XXX
SG_ Cyl_13_Fuel_Cor : 7|32@0- (1,0) [-50.00|50.00] "%" Vector__XXX
SG_ Status : 63|8@0+ (1,0) [0|255] "" Vector__XXX

BO_ 2652540928 Cyl_14_Fuel_Cor: 8 Vector__XXX
SG_ Cyl_14_Fuel_Cor : 7|32@0- (1,0) [-50.00|50.00] "%" Vector__XXX
SG_ Status : 63|8@0+ (1,0) [0|255] "" Vector__XXX

BO_ 2652557312 Cyl_15_Fuel_Cor: 8 Vector__XXX
SG_ Cyl_15_Fuel_Cor : 7|32@0- (1,0) [-50.00|50.00] "%" Vector__XXX
SG_ Status : 63|8@0+ (1,0) [0|255] "" Vector__XXX

BO_ 2652573696 Cyl_16_Fuel_Cor: 8 Vector__XXX
SG_ Cyl_16_Fuel_Cor : 7|32@0- (1,0) [-50.00|50.00] "%" Vector__XXX
SG_ Status : 63|8@0+ (1,0) [0|255] "" Vector__XXX

BO_ 2652590080 Cyl_1_Timing_Cor: 8 Vector__XXX
SG_ Cyl_1_Timing_Cor : 7|32@0- (1,0) [-50.00|50.00] "°" Vector__XXX
SG_ Status : 63|8@0+ (1,0) [0|255] "" Vector__XXX

BO_ 2652606464 Cyl_2_Timing_Cor: 8 Vector__XXX
SG_ Cyl_2_Timing_Cor : 7|32@0- (1,0) [-50.00|50.00] "°" Vector__XXX
SG_ Status : 63|8@0+ (1,0) [0|255] "" Vector__XXX

BO_ 2652622848 Cyl_3_Timing_Cor: 8 Vector__XXX
SG_ Cyl_3_Timing_Cor : 7|32@0- (1,0) [-50.00|50.00] "°" Vector__XXX
SG_ Status : 63|8@0+ (1,0) [0|255] "" Vector__XXX

BO_ 2652639232 Cyl_4_Timing_Cor: 8 Vector__XXX
SG_ Cyl_4_Timing_Cor : 7|32@0- (1,0) [-50.00|50.00] "°" Vector__XXX
SG_ Status : 63|8@0+ (1,0) [0|255] "" Vector__XXX

BO_ 2652655616 Cyl_5_Timing_Cor: 8 Vector__XXX
SG_ Cyl_5_Timing_Cor : 7|32@0- (1,0) [-50.00|50.00] "°" Vector__XXX
SG_ Status : 63|8@0+ (1,0) [0|255] "" Vector__XXX

BO_ 2652672000 Cyl_6_Timing_Cor: 8 Vector__XXX
SG_ Cyl_6_Timing_Cor : 7|32@0- (1,0) [-50.00|50.00] "°" Vector__XXX
SG_ Status : 63|8@0+ (1,0) [0|255] "" Vector__XXX

BO_ 2652688384 Cyl_7_Timing_Cor: 8 Vector__XXX
SG_ Cyl_7_Timing_Cor : 7|32@0- (1,0) [-50.00|50.00] "°" Vector__XXX
SG_ Status : 63|8@0+ (1,0) [0|255] "" Vector__XXX

BO_ 2652704768 Cyl_8_Timing_Cor: 8 Vector__XXX
SG_ Cyl_8_Timing_Cor : 7|32@0- (1,0) [-50.00|50.00] "°" Vector__XXX
SG_ Status : 63|8@0+ (1,0) [0|255] "" Vector__XXX

BO_ 2652721152 Cyl_9_Timing_Cor: 8 Vector__XXX
SG_ Cyl_9_Timing_Cor : 7|32@0- (1,0) [-50.00|50.00] "°" Vector__XXX
SG_ Status : 63|8@0+ (1,0) [0|255] "" Vector__XXX

BO_ 2652737536 Cyl_10_Timing_Cor: 8 Vector__XXX
SG_ Cyl_10_Timing_Cor : 7|32@0- (1,0) [-50.00|50.00] "°" Vector__XXX
SG_ Status : 63|8@0+ (1,0) [0|255] "" Vector__XXX

BO_ 2652753920 Cyl_11_Timing_Cor: 8 Vector__XXX
SG_ Cyl_11_Timing_Cor : 7|32@0- (1,0) [-50.00|50.00] "°" Vector__XXX
SG_ Status : 63|8@0+ (1,0) [0|255] "" Vector__XXX

BO_ 2652770304 Cyl_12_Timing_Cor: 8 Vector__XXX
SG_ Cyl_12_Timing_Cor : 7|32@0- (1,0) [-50.00|50.00] "°" Vector__XXX
SG_ Status : 63|8@0+ (1,0) [0|255] "" Vector__XXX

BO_ 2652786688 Cyl_13_Timing_Cor: 8 Vector__XXX
SG_ Cyl_13_Timing_Cor : 7|32@0- (1,0) [-50.00|50.00] "°" Vector__XXX
SG_ Status : 63|8@0+ (1,0) [0|255] "" Vector__XXX

BO_ 2652803072 Cyl_14_Timing_Cor: 8 Vector__XXX
SG_ Cyl_14_Timing_Cor : 7|32@0- (1,0) [-50.00|50.00] "°" Vector__XXX
SG_ Status : 63|8@0+ (1,0) [0|255] "" Vector__XXX

BO_ 2652819456 Cyl_15_Timing_Cor: 8 Vector__XXX
SG_ Cyl_15_Timing_Cor : 7|32@0- (1,0) [-50.00|50.00] "°" Vector__XXX
SG_ Status : 63|8@0+ (1,0) [0|255] "" Vector__XXX

BO_ 2652835840 Cyl_16_Timing_Cor: 8 Vector__XXX
SG_ Cyl_16_Timing_Cor : 7|32@0- (1,0) [-50.00|50.00] "°" Vector__XXX
SG_ Status : 63|8@0+ (1,0) [0|255] "" Vector__XXX

BO_ 2652852224 DI_Target_FP: 8 Vector__XXX
SG_ DI_Target_FP : 7|32@0- (1,0) [0.00|100.00] "PSIa" Vector__XXX
SG_ Status : 63|8@0+ (1,0) [0|255] "" Vector__XXX

BO_ 2652868608 Boost_PSIG: 8 Vector__XXX
SG_ Boost_PSIG : 7|32@0- (1,0) [0.00|999.00] "PSIa" Vector__XXX
SG_ Status : 63|8@0+ (1,0) [0|255] "" Vector__XXX

BO_ 2652934144 Boost_Gear: 8 Vector__XXX
SG_ Boost_Gear : 7|32@0- (1,0) [0.00|8.00] "None" Vector__XXX
SG_ Status : 63|8@0+ (1,0) [0|255] "" Vector__XXX

BO_ 2652950528 Boost_Stage: 8 Vector__XXX
SG_ Boost_Stage : 7|32@0- (1,0) [0.00|6.00] "None" Vector__XXX
SG_ Status : 63|8@0+ (1,0) [0|255] "" Vector__XXX

BO_ 2652966912 Boost: 8 Vector__XXX
SG_ Boost : 7|32@0- (1,0) [0.00|100.00] "PSIa" Vector__XXX
SG_ Status : 63|8@0+ (1,0) [0|255] "" Vector__XXX

BO_ 2652983296 Boost_Speed: 8 Vector__XXX
SG_ Boost_Speed : 7|32@0- (1,0) [0.00|300.00] "mph" Vector__XXX
SG_ Status : 63|8@0+ (1,0) [0|255] "" Vector__XXX

BO_ 2652999680 Boost_Time: 8 Vector__XXX
SG_ Boost_Time : 7|32@0- (1,0) [0.00|99.00] "s" Vector__XXX
SG_ Status : 63|8@0+ (1,0) [0|255] "" Vector__XXX

BO_ 2653016064 Target_Boost: 8 Vector__XXX
SG_ Target_Boost : 7|32@0- (1,0) [0.00|110.00] "psi/sec" Vector__XXX
SG_ Status : 63|8@0+ (1,0) [0|255] "" Vector__XXX

BO_ 2653032448 Trans_Brake: 8 Vector__XXX
SG_ Trans_Brake : 7|32@0- (1,0) [0.00|1.00] "" Vector__XXX
SG_ Status : 63|8@0+ (1,0) [0|255] "" Vector__XXX

BO_ 2653048832 Boost_Scramble_: 8 Vector__XXX
SG_ Boost_Scramble_ : 7|32@0- (1,0) [0.00|1.00] "" Vector__XXX
SG_ Status : 63|8@0+ (1,0) [0|255] "" Vector__XXX

BO_ 2653065216 Boost_Scramble__: 8 Vector__XXX
SG_ Boost_Scramble__ : 7|32@0- (1,0) [0.00|1.00] "" Vector__XXX
SG_ Status : 63|8@0+ (1,0) [0|255] "" Vector__XXX

BO_ 2653081600 Manual_Boost_Build: 8 Vector__XXX
SG_ Manual_Boost_Build : 7|32@0- (1,0) [0.00|1.00] "" Vector__XXX
SG_ Status : 63|8@0+ (1,0) [0|255] "" Vector__XXX

BO_ 2653097984 Manual_Boost_Reset: 8 Vector__XXX
SG_ Manual_Boost_Reset : 7|32@0- (1,0) [0.00|1.00] "" Vector__XXX
SG_ Status : 63|8@0+ (1,0) [0|255] "" Vector__XXX

BO_ 2653114368 Boost_Build: 8 Vector__XXX
SG_ Boost_Build : 7|32@0- (1,0) [0.00|1.00] "" Vector__XXX
SG_ Status : 63|8@0+ (1,0) [0|255] "" Vector__XXX

BO_ 2653130752 Boost_Solenoid_Duty: 8 Vector__XXX
SG_ Boost_Solenoid_Duty : 7|32@0- (1,0) [-100.00|100.00] "%" Vector__XXX
SG_ Status : 63|8@0+ (1,0) [0|255] "" Vector__XXX

BO_ 2653147136 Boost_Safety: 8 Vector__XXX
SG_ Boost_Safety : 7|32@0- (1,0) [0.00|1.00] "" Vector__XXX
SG_ Status : 63|8@0+ (1,0) [0|255] "" Vector__XXX

BO_ 2653163520 Boost_Master_Enbl: 8 Vector__XXX
SG_ Boost_Master_Enbl : 7|32@0- (1,0) [0.00|1.00] "" Vector__XXX
SG_ Status : 63|8@0+ (1,0) [0|255] "" Vector__XXX

BO_ 2653179904 Boost_Man_Shift_Inp: 8 Vector__XXX
SG_ Boost_Man_Shift_Inp : 7|32@0- (1,0) [0.00|1.00] "" Vector__XXX
SG_ Status : 63|8@0+ (1,0) [0|255] "" Vector__XXX

BO_ 2653196288 Boost_Man_Stage_Inp: 8 Vector__XXX
SG_ Boost_Man_Stage_Inp : 7|32@0- (1,0) [0.00|1.00] "" Vector__XXX
SG_ Status : 63|8@0+ (1,0) [0|255] "" Vector__XXX

BO_ 2653212672 Boost_Fill_Sol_DC: 8 Vector__XXX
SG_ Boost_Fill_Sol_DC : 7|32@0- (1,0) [0.00|100.00] "%" Vector__XXX
SG_ Status : 63|8@0+ (1,0) [0|255] "" Vector__XXX

BO_ 2653229056 Boost_Vent_Sol_DC: 8 Vector__XXX
SG_ Boost_Vent_Sol_DC : 7|32@0- (1,0) [0.00|100.00] "%" Vector__XXX
SG_ Status : 63|8@0+ (1,0) [0|255] "" Vector__XXX

BO_ 2653245440 WM_Injection: 8 Vector__XXX
SG_ WM_Injection : 7|32@0- (1,0) [0.00|100.00] "%" Vector__XXX
SG_ Status : 63|8@0+ (1,0) [0|255] "" Vector__XXX

BO_ 2653261824 WM_Manual_Enable: 8 Vector__XXX
SG_ WM_Manual_Enable : 7|32@0- (1,0) [0.00|1.00] "" Vector__XXX
SG_ Status : 63|8@0+ (1,0) [0|255] "" Vector__XXX

BO_ 2653278208 WM_Low_Fluid: 8 Vector__XXX
SG_ WM_Low_Fluid : 7|32@0- (1,0) [0.00|1.00] "" Vector__XXX
SG_ Status : 63|8@0+ (1,0) [0|255] "" Vector__XXX

BO_ 2653294592 WM_Pump: 8 Vector__XXX
SG_ WM_Pump : 7|32@0- (1,0) [0.00|1.00] "" Vector__XXX
SG_ Status : 63|8@0+ (1,0) [0|255] "" Vector__XXX

BO_ 2653310976 WM_Sol_1_Flow: 8 Vector__XXX
SG_ WM_Sol_1_Flow : 7|32@0- (1,0) [0.00|2000.00] "lb/h" Vector__XXX
SG_ Status : 63|8@0+ (1,0) [0|255] "" Vector__XXX

BO_ 2653327360 WM_Sol_2_Flow: 8 Vector__XXX
SG_ WM_Sol_2_Flow : 7|32@0- (1,0) [0.00|2000.00] "lb/h" Vector__XXX
SG_ Status : 63|8@0+ (1,0) [0|255] "" Vector__XXX

BO_ 2653343744 WM_Flow_Total: 8 Vector__XXX
SG_ WM_Flow_Total : 7|32@0- (1,0) [0.00|2000.00] "lb/h" Vector__XXX
SG_ Status : 63|8@0+ (1,0) [0|255] "" Vector__XXX

BO_ 2653360128 WM_Sol_1_DC: 8 Vector__XXX
SG_ WM_Sol_1_DC : 7|32@0- (1,0) [0.00|100.00] "%" Vector__XXX
SG_ Status : 63|8@0+ (1,0) [0|255] "" Vector__XXX

BO_ 2653376512 WM_Sol_2_DC: 8 Vector__XXX
SG_ WM_Sol_2_DC : 7|32@0- (1,0) [0.00|100.00] "%" Vector__XXX
SG_ Status : 63|8@0+ (1,0) [0|255] "" Vector__XXX

BO_ 2653425664 N2O_Stage_1: 8 Vector__XXX
SG_ N2O_Stage_1 : 7|32@0- (1,0) [0.00|100.00] "%" Vector__XXX
SG_ Status : 63|8@0+ (1,0) [0|255] "" Vector__XXX

BO_ 2653442048 N2O_Stage_2: 8 Vector__XXX
SG_ N2O_Stage_2 : 7|32@0- (1,0) [0.00|100.00] "%" Vector__XXX
SG_ Status : 63|8@0+ (1,0) [0|255] "" Vector__XXX

BO_ 2653458432 N2O_Stage_3: 8 Vector__XXX
SG_ N2O_Stage_3 : 7|32@0- (1,0) [0.00|100.00] "%" Vector__XXX
SG_ Status : 63|8@0+ (1,0) [0|255] "" Vector__XXX

BO_ 2653474816 N2O_Stage_4: 8 Vector__XXX
SG_ N2O_Stage_4 : 7|32@0- (1,0) [0.00|100.00] "%" Vector__XXX
SG_ Status : 63|8@0+ (1,0) [0|255] "" Vector__XXX

BO_ 2653491200 N2O_Stage_5: 8 Vector__XXX
SG_ N2O_Stage_5 : 7|32@0- (1,0) [0.00|100.00] "%" Vector__XXX
SG_ Status : 63|8@0+ (1,0) [0|255] "" Vector__XXX

BO_ 2653507584 N2O_Stage_6: 8 Vector__XXX
SG_ N2O_Stage_6 : 7|32@0- (1,0) [0.00|100.00] "%" Vector__XXX
SG_ Status : 63|8@0+ (1,0) [0|255] "" Vector__XXX

BO_ 2653523968 N2O_Stage_7: 8 Vector__XXX
SG_ N2O_Stage_7 : 7|32@0- (1,0) [0.00|100.00] "%" Vector__XXX
SG_ Status : 63|8@0+ (1,0) [0|255] "" Vector__XXX

BO_ 2653540352 N2O_Stage_8: 8 Vector__XXX
SG_ N2O_Stage_8 : 7|32@0- (1,0) [0.00|100.00] "%" Vector__XXX
SG_ Status : 63|8@0+ (1,0) [0|255] "" Vector__XXX

BO_ 2653556736 GPO_1: 8 Vector__XXX
SG_ GPO_1 : 7|32@0- (1,0) [0.00|1.00] "" Vector__XXX
SG_ Status : 63|8@0+ (1,0) [0|255] "" Vector__XXX

BO_ 2653573120 GPO_2: 8 Vector__XXX
SG_ GPO_2 : 7|32@0- (1,0) [0.00|1.00] "" Vector__XXX
SG_ Status : 63|8@0+ (1,0) [0|255] "" Vector__XXX

BO_ 2653589504 GPO_3: 8 Vector__XXX
SG_ GPO_3 : 7|32@0- (1,0) [0.00|1.00] "" Vector__XXX
SG_ Status : 63|8@0+ (1,0) [0|255] "" Vector__XXX

BO_ 2653605888 GPO_4: 8 Vector__XXX
SG_ GPO_4 : 7|32@0- (1,0) [0.00|1.00] "" Vector__XXX
SG_ Status : 63|8@0+ (1,0) [0|255] "" Vector__XXX

BO_ 2653622272 GPO_5: 8 Vector__XXX
SG_ GPO_5 : 7|32@0- (1,0) [0.00|1.00] "" Vector__XXX
SG_ Status : 63|8@0+ (1,0) [0|255] "" Vector__XXX

BO_ 2653638656 GPO_6: 8 Vector__XXX
SG_ GPO_6 : 7|32@0- (1,0) [0.00|1.00] "" Vector__XXX
SG_ Status : 63|8@0+ (1,0) [0|255] "" Vector__XXX

BA_DEF_  "BusType" STRING ;

BA_DEF_DEF_  "BusType" "CAN";

VAL_ 2650820608 Status 0 "OK" 1 "Disabled" 2 "Initializing" 3 "Heating" 4 "WB_Active" 5 "Too Cold" 6 "Too Hot" 7 "Unplugged" 8 "Slow!" 9 "Uncal Yellow" 10 "Uncal Red" 11 "Replace" 12 "Disabled" 13 "Shorted" 14 "Open" 15 "Over Range" 16 "Under Range" 17 "Undefined" 18 "Error!" 19 "Low Error" 20 "High Error" 21 "Non Critical No LED" 27 "Critical Green LED" 32 "Stall!" 33 "Synchronized" 34 "Syncing" 35 "Error!" 36 "Error!" 37 "Uncalibrated" 38 "Open Loop" 39 "Closed Loop" 40 "Not Learn" 41 "Learning" 42 "Off" 43 "On" 44 "Not Rev Limiting" 45 "Rev Limit" 46 "No Cut Off" 47 "CutOff!" 48 "Off" 49 "Warning!" 50 "Caution!" 51 "No Timing modifier" 52 "Timing is being modified" 53 "Timing Value is being replaced" 54 "Acq Sat" 55 "No GPS" 56 "No Data" 22 "Non Critical Green LED" 23 "Non Critical Yellow LED" 24 "Non Critical Red LED" 25 "Non Critical Blue LED" 26 "Non Critical Grey LED" 28 "Critical Yellow LED" 29 "Critical Red LED" 30 "Critical Blue LED" 31 "Critical Grey LED";
VAL_ 2650836992 Status 0 "OK" 1 "Disabled" 2 "Initializing" 3 "Heating" 4 "WB_Active" 5 "Too Cold" 6 "Too Hot" 7 "Unplugged" 8 "Slow!" 9 "Uncal Yellow" 10 "Uncal Red" 11 "Replace" 12 "Disabled" 13 "Shorted" 14 "Open" 15 "Over Range" 16 "Under Range" 17 "Undefined" 18 "Error!" 19 "Low Error" 20 "High Error" 21 "Non Critical No LED" 27 "Critical Green LED" 32 "Stall!" 33 "Synchronized" 34 "Syncing" 35 "Error!" 36 "Error!" 37 "Uncalibrated" 38 "Open Loop" 39 "Closed Loop" 40 "Not Learn" 41 "Learning" 42 "Off" 43 "On" 44 "Not Rev Limiting" 45 "Rev Limit" 46 "No Cut Off" 47 "CutOff!" 48 "Off" 49 "Warning!" 50 "Caution!" 51 "No Timing modifier" 52 "Timing is being modified" 53 "Timing Value is being replaced" 54 "Acq Sat" 55 "No GPS" 56 "No Data" 22 "Non Critical Green LED" 23 "Non Critical Yellow LED" 24 "Non Critical Red LED" 25 "Non Critical Blue LED" 26 "Non Critical Grey LED" 28 "Critical Yellow LED" 29 "Critical Red LED" 30 "Critical Blue LED" 31 "Critical Grey LED";
VAL_ 2650853376 Status 0 "OK" 1 "Disabled" 2 "Initializing" 3 "Heating" 4 "WB_Active" 5 "Too Cold" 6 "Too Hot" 7 "Unplugged" 8 "Slow!" 9 "Uncal Yellow" 10 "Uncal Red" 11 "Replace" 12 "Disabled" 13 "Shorted" 14 "Open" 15 "Over Range" 16 "Under Range" 17 "Undefined" 18 "Error!" 19 "Low Error" 20 "High Error" 21 "Non Critical No LED" 27 "Critical Green LED" 32 "Stall!" 33 "Synchronized" 34 "Syncing" 35 "Error!" 36 "Error!" 37 "Uncalibrated" 38 "Open Loop" 39 "Closed Loop" 40 "Not Learn" 41 "Learning" 42 "Off" 43 "On" 44 "Not Rev Limiting" 45 "Rev Limit" 46 "No Cut Off" 47 "CutOff!" 48 "Off" 49 "Warning!" 50 "Caution!" 51 "No Timing modifier" 52 "Timing is being modified" 53 "Timing Value is being replaced" 54 "Acq Sat" 55 "No GPS" 56 "No Data" 22 "Non Critical Green LED" 23 "Non Critical Yellow LED" 24 "Non Critical Red LED" 25 "Non Critical Blue LED" 26 "Non Critical Grey LED" 28 "Critical Yellow LED" 29 "Critical Red LED" 30 "Critical Blue LED" 31 "Critical Grey LED";
VAL_ 2650869760 Status 0 "OK" 1 "Disabled" 2 "Initializing" 3 "Heating" 4 "WB_Active" 5 "Too Cold" 6 "Too Hot" 7 "Unplugged" 8 "Slow!" 9 "Uncal Yellow" 10 "Uncal Red" 11 "Replace" 12 "Disabled" 13 "Shorted" 14 "Open" 15 "Over Range" 16 "Under Range" 17 "Undefined" 18 "Error!" 19 "Low Error" 20 "High Error" 21 "Non Critical No LED" 27 "Critical Green LED" 32 "Stall!" 33 "Synchronized" 34 "Syncing" 35 "Error!" 36 "Error!" 37 "Uncalibrated" 38 "Open Loop" 39 "Closed Loop" 40 "Not Learn" 41 "Learning" 42 "Off" 43 "On" 44 "Not Rev Limiting" 45 "Rev Limit" 46 "No Cut Off" 47 "CutOff!" 48 "Off" 49 "Warning!" 50 "Caution!" 51 "No Timing modifier" 52 "Timing is being modified" 53 "Timing Value is being replaced" 54 "Acq Sat" 55 "No GPS" 56 "No Data" 22 "Non Critical Green LED" 23 "Non Critical Yellow LED" 24 "Non Critical Red LED" 25 "Non Critical Blue LED" 26 "Non Critical Grey LED" 28 "Critical Yellow LED" 29 "Critical Red LED" 30 "Critical Blue LED" 31 "Critical Grey LED";
VAL_ 2650886144 Status 0 "OK" 1 "Disabled" 2 "Initializing" 3 "Heating" 4 "WB_Active" 5 "Too Cold" 6 "Too Hot" 7 "Unplugged" 8 "Slow!" 9 "Uncal Yellow" 10 "Uncal Red" 11 "Replace" 12 "Disabled" 13 "Shorted" 14 "Open" 15 "Over Range" 16 "Under Range" 17 "Undefined" 18 "Error!" 19 "Low Error" 20 "High Error" 21 "Non Critical No LED" 27 "Critical Green LED" 32 "Stall!" 33 "Synchronized" 34 "Syncing" 35 "Error!" 36 "Error!" 37 "Uncalibrated" 38 "Open Loop" 39 "Closed Loop" 40 "Not Learn" 41 "Learning" 42 "Off" 43 "On" 44 "Not Rev Limiting" 45 "Rev Limit" 46 "No Cut Off" 47 "CutOff!" 48 "Off" 49 "Warning!" 50 "Caution!" 51 "No Timing modifier" 52 "Timing is being modified" 53 "Timing Value is being replaced" 54 "Acq Sat" 55 "No GPS" 56 "No Data" 22 "Non Critical Green LED" 23 "Non Critical Yellow LED" 24 "Non Critical Red LED" 25 "Non Critical Blue LED" 26 "Non Critical Grey LED" 28 "Critical Yellow LED" 29 "Critical Red LED" 30 "Critical Blue LED" 31 "Critical Grey LED";
VAL_ 2650902528 Status 0 "OK" 1 "Disabled" 2 "Initializing" 3 "Heating" 4 "WB_Active" 5 "Too Cold" 6 "Too Hot" 7 "Unplugged" 8 "Slow!" 9 "Uncal Yellow" 10 "Uncal Red" 11 "Replace" 12 "Disabled" 13 "Shorted" 14 "Open" 15 "Over Range" 16 "Under Range" 17 "Undefined" 18 "Error!" 19 "Low Error" 20 "High Error" 21 "Non Critical No LED" 27 "Critical Green LED" 32 "Stall!" 33 "Synchronized" 34 "Syncing" 35 "Error!" 36 "Error!" 37 "Uncalibrated" 38 "Open Loop" 39 "Closed Loop" 40 "Not Learn" 41 "Learning" 42 "Off" 43 "On" 44 "Not Rev Limiting" 45 "Rev Limit" 46 "No Cut Off" 47 "CutOff!" 48 "Off" 49 "Warning!" 50 "Caution!" 51 "No Timing modifier" 52 "Timing is being modified" 53 "Timing Value is being replaced" 54 "Acq Sat" 55 "No GPS" 56 "No Data" 22 "Non Critical Green LED" 23 "Non Critical Yellow LED" 24 "Non Critical Red LED" 25 "Non Critical Blue LED" 26 "Non Critical Grey LED" 28 "Critical Yellow LED" 29 "Critical Red LED" 30 "Critical Blue LED" 31 "Critical Grey LED";
VAL_ 2650918912 Status 0 "OK" 1 "Disabled" 2 "Initializing" 3 "Heating" 4 "WB_Active" 5 "Too Cold" 6 "Too Hot" 7 "Unplugged" 8 "Slow!" 9 "Uncal Yellow" 10 "Uncal Red" 11 "Replace" 12 "Disabled" 13 "Shorted" 14 "Open" 15 "Over Range" 16 "Under Range" 17 "Undefined" 18 "Error!" 19 "Low Error" 20 "High Error" 21 "Non Critical No LED" 27 "Critical Green LED" 32 "Stall!" 33 "Synchronized" 34 "Syncing" 35 "Error!" 36 "Error!" 37 "Uncalibrated" 38 "Open Loop" 39 "Closed Loop" 40 "Not Learn" 41 "Learning" 42 "Off" 43 "On" 44 "Not Rev Limiting" 45 "Rev Limit" 46 "No Cut Off" 47 "CutOff!" 48 "Off" 49 "Warning!" 50 "Caution!" 51 "No Timing modifier" 52 "Timing is being modified" 53 "Timing Value is being replaced" 54 "Acq Sat" 55 "No GPS" 56 "No Data" 22 "Non Critical Green LED" 23 "Non Critical Yellow LED" 24 "Non Critical Red LED" 25 "Non Critical Blue LED" 26 "Non Critical Grey LED" 28 "Critical Yellow LED" 29 "Critical Red LED" 30 "Critical Blue LED" 31 "Critical Grey LED";
VAL_ 2650935296 Status 0 "OK" 1 "Disabled" 2 "Initializing" 3 "Heating" 4 "WB_Active" 5 "Too Cold" 6 "Too Hot" 7 "Unplugged" 8 "Slow!" 9 "Uncal Yellow" 10 "Uncal Red" 11 "Replace" 12 "Disabled" 13 "Shorted" 14 "Open" 15 "Over Range" 16 "Under Range" 17 "Undefined" 18 "Error!" 19 "Low Error" 20 "High Error" 21 "Non Critical No LED" 27 "Critical Green LED" 32 "Stall!" 33 "Synchronized" 34 "Syncing" 35 "Error!" 36 "Error!" 37 "Uncalibrated" 38 "Open Loop" 39 "Closed Loop" 40 "Not Learn" 41 "Learning" 42 "Off" 43 "On" 44 "Not Rev Limiting" 45 "Rev Limit" 46 "No Cut Off" 47 "CutOff!" 48 "Off" 49 "Warning!" 50 "Caution!" 51 "No Timing modifier" 52 "Timing is being modified" 53 "Timing Value is being replaced" 54 "Acq Sat" 55 "No GPS" 56 "No Data" 22 "Non Critical Green LED" 23 "Non Critical Yellow LED" 24 "Non Critical Red LED" 25 "Non Critical Blue LED" 26 "Non Critical Grey LED" 28 "Critical Yellow LED" 29 "Critical Red LED" 30 "Critical Blue LED" 31 "Critical Grey LED";
VAL_ 2650951680 Status 0 "OK" 1 "Disabled" 2 "Initializing" 3 "Heating" 4 "WB_Active" 5 "Too Cold" 6 "Too Hot" 7 "Unplugged" 8 "Slow!" 9 "Uncal Yellow" 10 "Uncal Red" 11 "Replace" 12 "Disabled" 13 "Shorted" 14 "Open" 15 "Over Range" 16 "Under Range" 17 "Undefined" 18 "Error!" 19 "Low Error" 20 "High Error" 21 "Non Critical No LED" 27 "Critical Green LED" 32 "Stall!" 33 "Synchronized" 34 "Syncing" 35 "Error!" 36 "Error!" 37 "Uncalibrated" 38 "Open Loop" 39 "Closed Loop" 40 "Not Learn" 41 "Learning" 42 "Off" 43 "On" 44 "Not Rev Limiting" 45 "Rev Limit" 46 "No Cut Off" 47 "CutOff!" 48 "Off" 49 "Warning!" 50 "Caution!" 51 "No Timing modifier" 52 "Timing is being modified" 53 "Timing Value is being replaced" 54 "Acq Sat" 55 "No GPS" 56 "No Data" 22 "Non Critical Green LED" 23 "Non Critical Yellow LED" 24 "Non Critical Red LED" 25 "Non Critical Blue LED" 26 "Non Critical Grey LED" 28 "Critical Yellow LED" 29 "Critical Red LED" 30 "Critical Blue LED" 31 "Critical Grey LED";
VAL_ 2650968064 Status 0 "OK" 1 "Disabled" 2 "Initializing" 3 "Heating" 4 "WB_Active" 5 "Too Cold" 6 "Too Hot" 7 "Unplugged" 8 "Slow!" 9 "Uncal Yellow" 10 "Uncal Red" 11 "Replace" 12 "Disabled" 13 "Shorted" 14 "Open" 15 "Over Range" 16 "Under Range" 17 "Undefined" 18 "Error!" 19 "Low Error" 20 "High Error" 21 "Non Critical No LED" 27 "Critical Green LED" 32 "Stall!" 33 "Synchronized" 34 "Syncing" 35 "Error!" 36 "Error!" 37 "Uncalibrated" 38 "Open Loop" 39 "Closed Loop" 40 "Not Learn" 41 "Learning" 42 "Off" 43 "On" 44 "Not Rev Limiting" 45 "Rev Limit" 46 "No Cut Off" 47 "CutOff!" 48 "Off" 49 "Warning!" 50 "Caution!" 51 "No Timing modifier" 52 "Timing is being modified" 53 "Timing Value is being replaced" 54 "Acq Sat" 55 "No GPS" 56 "No Data" 22 "Non Critical Green LED" 23 "Non Critical Yellow LED" 24 "Non Critical Red LED" 25 "Non Critical Blue LED" 26 "Non Critical Grey LED" 28 "Critical Yellow LED" 29 "Critical Red LED" 30 "Critical Blue LED" 31 "Critical Grey LED";
VAL_ 2650984448 Status 0 "OK" 1 "Disabled" 2 "Initializing" 3 "Heating" 4 "WB_Active" 5 "Too Cold" 6 "Too Hot" 7 "Unplugged" 8 "Slow!" 9 "Uncal Yellow" 10 "Uncal Red" 11 "Replace" 12 "Disabled" 13 "Shorted" 14 "Open" 15 "Over Range" 16 "Under Range" 17 "Undefined" 18 "Error!" 19 "Low Error" 20 "High Error" 21 "Non Critical No LED" 27 "Critical Green LED" 32 "Stall!" 33 "Synchronized" 34 "Syncing" 35 "Error!" 36 "Error!" 37 "Uncalibrated" 38 "Open Loop" 39 "Closed Loop" 40 "Not Learn" 41 "Learning" 42 "Off" 43 "On" 44 "Not Rev Limiting" 45 "Rev Limit" 46 "No Cut Off" 47 "CutOff!" 48 "Off" 49 "Warning!" 50 "Caution!" 51 "No Timing modifier" 52 "Timing is being modified" 53 "Timing Value is being replaced" 54 "Acq Sat" 55 "No GPS" 56 "No Data" 22 "Non Critical Green LED" 23 "Non Critical Yellow LED" 24 "Non Critical Red LED" 25 "Non Critical Blue LED" 26 "Non Critical Grey LED" 28 "Critical Yellow LED" 29 "Critical Red LED" 30 "Critical Blue LED" 31 "Critical Grey LED";
VAL_ 2651000832 Status 0 "OK" 1 "Disabled" 2 "Initializing" 3 "Heating" 4 "WB_Active" 5 "Too Cold" 6 "Too Hot" 7 "Unplugged" 8 "Slow!" 9 "Uncal Yellow" 10 "Uncal Red" 11 "Replace" 12 "Disabled" 13 "Shorted" 14 "Open" 15 "Over Range" 16 "Under Range" 17 "Undefined" 18 "Error!" 19 "Low Error" 20 "High Error" 21 "Non Critical No LED" 27 "Critical Green LED" 32 "Stall!" 33 "Synchronized" 34 "Syncing" 35 "Error!" 36 "Error!" 37 "Uncalibrated" 38 "Open Loop" 39 "Closed Loop" 40 "Not Learn" 41 "Learning" 42 "Off" 43 "On" 44 "Not Rev Limiting" 45 "Rev Limit" 46 "No Cut Off" 47 "CutOff!" 48 "Off" 49 "Warning!" 50 "Caution!" 51 "No Timing modifier" 52 "Timing is being modified" 53 "Timing Value is being replaced" 54 "Acq Sat" 55 "No GPS" 56 "No Data" 22 "Non Critical Green LED" 23 "Non Critical Yellow LED" 24 "Non Critical Red LED" 25 "Non Critical Blue LED" 26 "Non Critical Grey LED" 28 "Critical Yellow LED" 29 "Critical Red LED" 30 "Critical Blue LED" 31 "Critical Grey LED";
VAL_ 2651017216 Status 0 "OK" 1 "Disabled" 2 "Initializing" 3 "Heating" 4 "WB_Active" 5 "Too Cold" 6 "Too Hot" 7 "Unplugged" 8 "Slow!" 9 "Uncal Yellow" 10 "Uncal Red" 11 "Replace" 12 "Disabled" 13 "Shorted" 14 "Open" 15 "Over Range" 16 "Under Range" 17 "Undefined" 18 "Error!" 19 "Low Error" 20 "High Error" 21 "Non Critical No LED" 27 "Critical Green LED" 32 "Stall!" 33 "Synchronized" 34 "Syncing" 35 "Error!" 36 "Error!" 37 "Uncalibrated" 38 "Open Loop" 39 "Closed Loop" 40 "Not Learn" 41 "Learning" 42 "Off" 43 "On" 44 "Not Rev Limiting" 45 "Rev Limit" 46 "No Cut Off" 47 "CutOff!" 48 "Off" 49 "Warning!" 50 "Caution!" 51 "No Timing modifier" 52 "Timing is being modified" 53 "Timing Value is being replaced" 54 "Acq Sat" 55 "No GPS" 56 "No Data" 22 "Non Critical Green LED" 23 "Non Critical Yellow LED" 24 "Non Critical Red LED" 25 "Non Critical Blue LED" 26 "Non Critical Grey LED" 28 "Critical Yellow LED" 29 "Critical Red LED" 30 "Critical Blue LED" 31 "Critical Grey LED";
VAL_ 2651033600 Status 0 "OK" 1 "Disabled" 2 "Initializing" 3 "Heating" 4 "WB_Active" 5 "Too Cold" 6 "Too Hot" 7 "Unplugged" 8 "Slow!" 9 "Uncal Yellow" 10 "Uncal Red" 11 "Replace" 12 "Disabled" 13 "Shorted" 14 "Open" 15 "Over Range" 16 "Under Range" 17 "Undefined" 18 "Error!" 19 "Low Error" 20 "High Error" 21 "Non Critical No LED" 27 "Critical Green LED" 32 "Stall!" 33 "Synchronized" 34 "Syncing" 35 "Error!" 36 "Error!" 37 "Uncalibrated" 38 "Open Loop" 39 "Closed Loop" 40 "Not Learn" 41 "Learning" 42 "Off" 43 "On" 44 "Not Rev Limiting" 45 "Rev Limit" 46 "No Cut Off" 47 "CutOff!" 48 "Off" 49 "Warning!" 50 "Caution!" 51 "No Timing modifier" 52 "Timing is being modified" 53 "Timing Value is being replaced" 54 "Acq Sat" 55 "No GPS" 56 "No Data" 22 "Non Critical Green LED" 23 "Non Critical Yellow LED" 24 "Non Critical Red LED" 25 "Non Critical Blue LED" 26 "Non Critical Grey LED" 28 "Critical Yellow LED" 29 "Critical Red LED" 30 "Critical Blue LED" 31 "Critical Grey LED";
VAL_ 2651049984 Status 0 "OK" 1 "Disabled" 2 "Initializing" 3 "Heating" 4 "WB_Active" 5 "Too Cold" 6 "Too Hot" 7 "Unplugged" 8 "Slow!" 9 "Uncal Yellow" 10 "Uncal Red" 11 "Replace" 12 "Disabled" 13 "Shorted" 14 "Open" 15 "Over Range" 16 "Under Range" 17 "Undefined" 18 "Error!" 19 "Low Error" 20 "High Error" 21 "Non Critical No LED" 27 "Critical Green LED" 32 "Stall!" 33 "Synchronized" 34 "Syncing" 35 "Error!" 36 "Error!" 37 "Uncalibrated" 38 "Open Loop" 39 "Closed Loop" 40 "Not Learn" 41 "Learning" 42 "Off" 43 "On" 44 "Not Rev Limiting" 45 "Rev Limit" 46 "No Cut Off" 47 "CutOff!" 48 "Off" 49 "Warning!" 50 "Caution!" 51 "No Timing modifier" 52 "Timing is being modified" 53 "Timing Value is being replaced" 54 "Acq Sat" 55 "No GPS" 56 "No Data" 22 "Non Critical Green LED" 23 "Non Critical Yellow LED" 24 "Non Critical Red LED" 25 "Non Critical Blue LED" 26 "Non Critical Grey LED" 28 "Critical Yellow LED" 29 "Critical Red LED" 30 "Critical Blue LED" 31 "Critical Grey LED";
VAL_ 2651066368 Status 0 "OK" 1 "Disabled" 2 "Initializing" 3 "Heating" 4 "WB_Active" 5 "Too Cold" 6 "Too Hot" 7 "Unplugged" 8 "Slow!" 9 "Uncal Yellow" 10 "Uncal Red" 11 "Replace" 12 "Disabled" 13 "Shorted" 14 "Open" 15 "Over Range" 16 "Under Range" 17 "Undefined" 18 "Error!" 19 "Low Error" 20 "High Error" 21 "Non Critical No LED" 27 "Critical Green LED" 32 "Stall!" 33 "Synchronized" 34 "Syncing" 35 "Error!" 36 "Error!" 37 "Uncalibrated" 38 "Open Loop" 39 "Closed Loop" 40 "Not Learn" 41 "Learning" 42 "Off" 43 "On" 44 "Not Rev Limiting" 45 "Rev Limit" 46 "No Cut Off" 47 "CutOff!" 48 "Off" 49 "Warning!" 50 "Caution!" 51 "No Timing modifier" 52 "Timing is being modified" 53 "Timing Value is being replaced" 54 "Acq Sat" 55 "No GPS" 56 "No Data" 22 "Non Critical Green LED" 23 "Non Critical Yellow LED" 24 "Non Critical Red LED" 25 "Non Critical Blue LED" 26 "Non Critical Grey LED" 28 "Critical Yellow LED" 29 "Critical Red LED" 30 "Critical Blue LED" 31 "Critical Grey LED";
VAL_ 2651082752 Status 0 "OK" 1 "Disabled" 2 "Initializing" 3 "Heating" 4 "WB_Active" 5 "Too Cold" 6 "Too Hot" 7 "Unplugged" 8 "Slow!" 9 "Uncal Yellow" 10 "Uncal Red" 11 "Replace" 12 "Disabled" 13 "Shorted" 14 "Open" 15 "Over Range" 16 "Under Range" 17 "Undefined" 18 "Error!" 19 "Low Error" 20 "High Error" 21 "Non Critical No LED" 27 "Critical Green LED" 32 "Stall!" 33 "Synchronized" 34 "Syncing" 35 "Error!" 36 "Error!" 37 "Uncalibrated" 38 "Open Loop" 39 "Closed Loop" 40 "Not Learn" 41 "Learning" 42 "Off" 43 "On" 44 "Not Rev Limiting" 45 "Rev Limit" 46 "No Cut Off" 47 "CutOff!" 48 "Off" 49 "Warning!" 50 "Caution!" 51 "No Timing modifier" 52 "Timing is being modified" 53 "Timing Value is being replaced" 54 "Acq Sat" 55 "No GPS" 56 "No Data" 22 "Non Critical Green LED" 23 "Non Critical Yellow LED" 24 "Non Critical Red LED" 25 "Non Critical Blue LED" 26 "Non Critical Grey LED" 28 "Critical Yellow LED" 29 "Critical Red LED" 30 "Critical Blue LED" 31 "Critical Grey LED";
VAL_ 2651099136 Status 0 "OK" 1 "Disabled" 2 "Initializing" 3 "Heating" 4 "WB_Active" 5 "Too Cold" 6 "Too Hot" 7 "Unplugged" 8 "Slow!" 9 "Uncal Yellow" 10 "Uncal Red" 11 "Replace" 12 "Disabled" 13 "Shorted" 14 "Open" 15 "Over Range" 16 "Under Range" 17 "Undefined" 18 "Error!" 19 "Low Error" 20 "High Error" 21 "Non Critical No LED" 27 "Critical Green LED" 32 "Stall!" 33 "Synchronized" 34 "Syncing" 35 "Error!" 36 "Error!" 37 "Uncalibrated" 38 "Open Loop" 39 "Closed Loop" 40 "Not Learn" 41 "Learning" 42 "Off" 43 "On" 44 "Not Rev Limiting" 45 "Rev Limit" 46 "No Cut Off" 47 "CutOff!" 48 "Off" 49 "Warning!" 50 "Caution!" 51 "No Timing modifier" 52 "Timing is being modified" 53 "Timing Value is being replaced" 54 "Acq Sat" 55 "No GPS" 56 "No Data" 22 "Non Critical Green LED" 23 "Non Critical Yellow LED" 24 "Non Critical Red LED" 25 "Non Critical Blue LED" 26 "Non Critical Grey LED" 28 "Critical Yellow LED" 29 "Critical Red LED" 30 "Critical Blue LED" 31 "Critical Grey LED";
VAL_ 2651115520 Status 0 "OK" 1 "Disabled" 2 "Initializing" 3 "Heating" 4 "WB_Active" 5 "Too Cold" 6 "Too Hot" 7 "Unplugged" 8 "Slow!" 9 "Uncal Yellow" 10 "Uncal Red" 11 "Replace" 12 "Disabled" 13 "Shorted" 14 "Open" 15 "Over Range" 16 "Under Range" 17 "Undefined" 18 "Error!" 19 "Low Error" 20 "High Error" 21 "Non Critical No LED" 27 "Critical Green LED" 32 "Stall!" 33 "Synchronized" 34 "Syncing" 35 "Error!" 36 "Error!" 37 "Uncalibrated" 38 "Open Loop" 39 "Closed Loop" 40 "Not Learn" 41 "Learning" 42 "Off" 43 "On" 44 "Not Rev Limiting" 45 "Rev Limit" 46 "No Cut Off" 47 "CutOff!" 48 "Off" 49 "Warning!" 50 "Caution!" 51 "No Timing modifier" 52 "Timing is being modified" 53 "Timing Value is being replaced" 54 "Acq Sat" 55 "No GPS" 56 "No Data" 22 "Non Critical Green LED" 23 "Non Critical Yellow LED" 24 "Non Critical Red LED" 25 "Non Critical Blue LED" 26 "Non Critical Grey LED" 28 "Critical Yellow LED" 29 "Critical Red LED" 30 "Critical Blue LED" 31 "Critical Grey LED";
VAL_ 2651131904 Status 0 "OK" 1 "Disabled" 2 "Initializing" 3 "Heating" 4 "WB_Active" 5 "Too Cold" 6 "Too Hot" 7 "Unplugged" 8 "Slow!" 9 "Uncal Yellow" 10 "Uncal Red" 11 "Replace" 12 "Disabled" 13 "Shorted" 14 "Open" 15 "Over Range" 16 "Under Range" 17 "Undefined" 18 "Error!" 19 "Low Error" 20 "High Error" 21 "Non Critical No LED" 27 "Critical Green LED" 32 "Stall!" 33 "Synchronized" 34 "Syncing" 35 "Error!" 36 "Error!" 37 "Uncalibrated" 38 "Open Loop" 39 "Closed Loop" 40 "Not Learn" 41 "Learning" 42 "Off" 43 "On" 44 "Not Rev Limiting" 45 "Rev Limit" 46 "No Cut Off" 47 "CutOff!" 48 "Off" 49 "Warning!" 50 "Caution!" 51 "No Timing modifier" 52 "Timing is being modified" 53 "Timing Value is being replaced" 54 "Acq Sat" 55 "No GPS" 56 "No Data" 22 "Non Critical Green LED" 23 "Non Critical Yellow LED" 24 "Non Critical Red LED" 25 "Non Critical Blue LED" 26 "Non Critical Grey LED" 28 "Critical Yellow LED" 29 "Critical Red LED" 30 "Critical Blue LED" 31 "Critical Grey LED";
VAL_ 2651148288 Status 0 "OK" 1 "Disabled" 2 "Initializing" 3 "Heating" 4 "WB_Active" 5 "Too Cold" 6 "Too Hot" 7 "Unplugged" 8 "Slow!" 9 "Uncal Yellow" 10 "Uncal Red" 11 "Replace" 12 "Disabled" 13 "Shorted" 14 "Open" 15 "Over Range" 16 "Under Range" 17 "Undefined" 18 "Error!" 19 "Low Error" 20 "High Error" 21 "Non Critical No LED" 27 "Critical Green LED" 32 "Stall!" 33 "Synchronized" 34 "Syncing" 35 "Error!" 36 "Error!" 37 "Uncalibrated" 38 "Open Loop" 39 "Closed Loop" 40 "Not Learn" 41 "Learning" 42 "Off" 43 "On" 44 "Not Rev Limiting" 45 "Rev Limit" 46 "No Cut Off" 47 "CutOff!" 48 "Off" 49 "Warning!" 50 "Caution!" 51 "No Timing modifier" 52 "Timing is being modified" 53 "Timing Value is being replaced" 54 "Acq Sat" 55 "No GPS" 56 "No Data" 22 "Non Critical Green LED" 23 "Non Critical Yellow LED" 24 "Non Critical Red LED" 25 "Non Critical Blue LED" 26 "Non Critical Grey LED" 28 "Critical Yellow LED" 29 "Critical Red LED" 30 "Critical Blue LED" 31 "Critical Grey LED";
VAL_ 2651164672 Status 0 "OK" 1 "Disabled" 2 "Initializing" 3 "Heating" 4 "WB_Active" 5 "Too Cold" 6 "Too Hot" 7 "Unplugged" 8 "Slow!" 9 "Uncal Yellow" 10 "Uncal Red" 11 "Replace" 12 "Disabled" 13 "Shorted" 14 "Open" 15 "Over Range" 16 "Under Range" 17 "Undefined" 18 "Error!" 19 "Low Error" 20 "High Error" 21 "Non Critical No LED" 27 "Critical Green LED" 32 "Stall!" 33 "Synchronized" 34 "Syncing" 35 "Error!" 36 "Error!" 37 "Uncalibrated" 38 "Open Loop" 39 "Closed Loop" 40 "Not Learn" 41 "Learning" 42 "Off" 43 "On" 44 "Not Rev Limiting" 45 "Rev Limit" 46 "No Cut Off" 47 "CutOff!" 48 "Off" 49 "Warning!" 50 "Caution!" 51 "No Timing modifier" 52 "Timing is being modified" 53 "Timing Value is being replaced" 54 "Acq Sat" 55 "No GPS" 56 "No Data" 22 "Non Critical Green LED" 23 "Non Critical Yellow LED" 24 "Non Critical Red LED" 25 "Non Critical Blue LED" 26 "Non Critical Grey LED" 28 "Critical Yellow LED" 29 "Critical Red LED" 30 "Critical Blue LED" 31 "Critical Grey LED";
VAL_ 2651181056 Status 0 "OK" 1 "Disabled" 2 "Initializing" 3 "Heating" 4 "WB_Active" 5 "Too Cold" 6 "Too Hot" 7 "Unplugged" 8 "Slow!" 9 "Uncal Yellow" 10 "Uncal Red" 11 "Replace" 12 "Disabled" 13 "Shorted" 14 "Open" 15 "Over Range" 16 "Under Range" 17 "Undefined" 18 "Error!" 19 "Low Error" 20 "High Error" 21 "Non Critical No LED" 27 "Critical Green LED" 32 "Stall!" 33 "Synchronized" 34 "Syncing" 35 "Error!" 36 "Error!" 37 "Uncalibrated" 38 "Open Loop" 39 "Closed Loop" 40 "Not Learn" 41 "Learning" 42 "Off" 43 "On" 44 "Not Rev Limiting" 45 "Rev Limit" 46 "No Cut Off" 47 "CutOff!" 48 "Off" 49 "Warning!" 50 "Caution!" 51 "No Timing modifier" 52 "Timing is being modified" 53 "Timing Value is being replaced" 54 "Acq Sat" 55 "No GPS" 56 "No Data" 22 "Non Critical Green LED" 23 "Non Critical Yellow LED" 24 "Non Critical Red LED" 25 "Non Critical Blue LED" 26 "Non Critical Grey LED" 28 "Critical Yellow LED" 29 "Critical Red LED" 30 "Critical Blue LED" 31 "Critical Grey LED";
VAL_ 2651197440 Status 0 "OK" 1 "Disabled" 2 "Initializing" 3 "Heating" 4 "WB_Active" 5 "Too Cold" 6 "Too Hot" 7 "Unplugged" 8 "Slow!" 9 "Uncal Yellow" 10 "Uncal Red" 11 "Replace" 12 "Disabled" 13 "Shorted" 14 "Open" 15 "Over Range" 16 "Under Range" 17 "Undefined" 18 "Error!" 19 "Low Error" 20 "High Error" 21 "Non Critical No LED" 27 "Critical Green LED" 32 "Stall!" 33 "Synchronized" 34 "Syncing" 35 "Error!" 36 "Error!" 37 "Uncalibrated" 38 "Open Loop" 39 "Closed Loop" 40 "Not Learn" 41 "Learning" 42 "Off" 43 "On" 44 "Not Rev Limiting" 45 "Rev Limit" 46 "No Cut Off" 47 "CutOff!" 48 "Off" 49 "Warning!" 50 "Caution!" 51 "No Timing modifier" 52 "Timing is being modified" 53 "Timing Value is being replaced" 54 "Acq Sat" 55 "No GPS" 56 "No Data" 22 "Non Critical Green LED" 23 "Non Critical Yellow LED" 24 "Non Critical Red LED" 25 "Non Critical Blue LED" 26 "Non Critical Grey LED" 28 "Critical Yellow LED" 29 "Critical Red LED" 30 "Critical Blue LED" 31 "Critical Grey LED";
VAL_ 2651230208 Status 0 "OK" 1 "Disabled" 2 "Initializing" 3 "Heating" 4 "WB_Active" 5 "Too Cold" 6 "Too Hot" 7 "Unplugged" 8 "Slow!" 9 "Uncal Yellow" 10 "Uncal Red" 11 "Replace" 12 "Disabled" 13 "Shorted" 14 "Open" 15 "Over Range" 16 "Under Range" 17 "Undefined" 18 "Error!" 19 "Low Error" 20 "High Error" 21 "Non Critical No LED" 27 "Critical Green LED" 32 "Stall!" 33 "Synchronized" 34 "Syncing" 35 "Error!" 36 "Error!" 37 "Uncalibrated" 38 "Open Loop" 39 "Closed Loop" 40 "Not Learn" 41 "Learning" 42 "Off" 43 "On" 44 "Not Rev Limiting" 45 "Rev Limit" 46 "No Cut Off" 47 "CutOff!" 48 "Off" 49 "Warning!" 50 "Caution!" 51 "No Timing modifier" 52 "Timing is being modified" 53 "Timing Value is being replaced" 54 "Acq Sat" 55 "No GPS" 56 "No Data" 22 "Non Critical Green LED" 23 "Non Critical Yellow LED" 24 "Non Critical Red LED" 25 "Non Critical Blue LED" 26 "Non Critical Grey LED" 28 "Critical Yellow LED" 29 "Critical Red LED" 30 "Critical Blue LED" 31 "Critical Grey LED";
VAL_ 2651246592 Status 0 "OK" 1 "Disabled" 2 "Initializing" 3 "Heating" 4 "WB_Active" 5 "Too Cold" 6 "Too Hot" 7 "Unplugged" 8 "Slow!" 9 "Uncal Yellow" 10 "Uncal Red" 11 "Replace" 12 "Disabled" 13 "Shorted" 14 "Open" 15 "Over Range" 16 "Under Range" 17 "Undefined" 18 "Error!" 19 "Low Error" 20 "High Error" 21 "Non Critical No LED" 27 "Critical Green LED" 32 "Stall!" 33 "Synchronized" 34 "Syncing" 35 "Error!" 36 "Error!" 37 "Uncalibrated" 38 "Open Loop" 39 "Closed Loop" 40 "Not Learn" 41 "Learning" 42 "Off" 43 "On" 44 "Not Rev Limiting" 45 "Rev Limit" 46 "No Cut Off" 47 "CutOff!" 48 "Off" 49 "Warning!" 50 "Caution!" 51 "No Timing modifier" 52 "Timing is being modified" 53 "Timing Value is being replaced" 54 "Acq Sat" 55 "No GPS" 56 "No Data" 22 "Non Critical Green LED" 23 "Non Critical Yellow LED" 24 "Non Critical Red LED" 25 "Non Critical Blue LED" 26 "Non Critical Grey LED" 28 "Critical Yellow LED" 29 "Critical Red LED" 30 "Critical Blue LED" 31 "Critical Grey LED";
VAL_ 2651262976 Status 0 "OK" 1 "Disabled" 2 "Initializing" 3 "Heating" 4 "WB_Active" 5 "Too Cold" 6 "Too Hot" 7 "Unplugged" 8 "Slow!" 9 "Uncal Yellow" 10 "Uncal Red" 11 "Replace" 12 "Disabled" 13 "Shorted" 14 "Open" 15 "Over Range" 16 "Under Range" 17 "Undefined" 18 "Error!" 19 "Low Error" 20 "High Error" 21 "Non Critical No LED" 27 "Critical Green LED" 32 "Stall!" 33 "Synchronized" 34 "Syncing" 35 "Error!" 36 "Error!" 37 "Uncalibrated" 38 "Open Loop" 39 "Closed Loop" 40 "Not Learn" 41 "Learning" 42 "Off" 43 "On" 44 "Not Rev Limiting" 45 "Rev Limit" 46 "No Cut Off" 47 "CutOff!" 48 "Off" 49 "Warning!" 50 "Caution!" 51 "No Timing modifier" 52 "Timing is being modified" 53 "Timing Value is being replaced" 54 "Acq Sat" 55 "No GPS" 56 "No Data" 22 "Non Critical Green LED" 23 "Non Critical Yellow LED" 24 "Non Critical Red LED" 25 "Non Critical Blue LED" 26 "Non Critical Grey LED" 28 "Critical Yellow LED" 29 "Critical Red LED" 30 "Critical Blue LED" 31 "Critical Grey LED";
VAL_ 2651279360 Status 0 "OK" 1 "Disabled" 2 "Initializing" 3 "Heating" 4 "WB_Active" 5 "Too Cold" 6 "Too Hot" 7 "Unplugged" 8 "Slow!" 9 "Uncal Yellow" 10 "Uncal Red" 11 "Replace" 12 "Disabled" 13 "Shorted" 14 "Open" 15 "Over Range" 16 "Under Range" 17 "Undefined" 18 "Error!" 19 "Low Error" 20 "High Error" 21 "Non Critical No LED" 27 "Critical Green LED" 32 "Stall!" 33 "Synchronized" 34 "Syncing" 35 "Error!" 36 "Error!" 37 "Uncalibrated" 38 "Open Loop" 39 "Closed Loop" 40 "Not Learn" 41 "Learning" 42 "Off" 43 "On" 44 "Not Rev Limiting" 45 "Rev Limit" 46 "No Cut Off" 47 "CutOff!" 48 "Off" 49 "Warning!" 50 "Caution!" 51 "No Timing modifier" 52 "Timing is being modified" 53 "Timing Value is being replaced" 54 "Acq Sat" 55 "No GPS" 56 "No Data" 22 "Non Critical Green LED" 23 "Non Critical Yellow LED" 24 "Non Critical Red LED" 25 "Non Critical Blue LED" 26 "Non Critical Grey LED" 28 "Critical Yellow LED" 29 "Critical Red LED" 30 "Critical Blue LED" 31 "Critical Grey LED";
VAL_ 2651295744 Status 0 "OK" 1 "Disabled" 2 "Initializing" 3 "Heating" 4 "WB_Active" 5 "Too Cold" 6 "Too Hot" 7 "Unplugged" 8 "Slow!" 9 "Uncal Yellow" 10 "Uncal Red" 11 "Replace" 12 "Disabled" 13 "Shorted" 14 "Open" 15 "Over Range" 16 "Under Range" 17 "Undefined" 18 "Error!" 19 "Low Error" 20 "High Error" 21 "Non Critical No LED" 27 "Critical Green LED" 32 "Stall!" 33 "Synchronized" 34 "Syncing" 35 "Error!" 36 "Error!" 37 "Uncalibrated" 38 "Open Loop" 39 "Closed Loop" 40 "Not Learn" 41 "Learning" 42 "Off" 43 "On" 44 "Not Rev Limiting" 45 "Rev Limit" 46 "No Cut Off" 47 "CutOff!" 48 "Off" 49 "Warning!" 50 "Caution!" 51 "No Timing modifier" 52 "Timing is being modified" 53 "Timing Value is being replaced" 54 "Acq Sat" 55 "No GPS" 56 "No Data" 22 "Non Critical Green LED" 23 "Non Critical Yellow LED" 24 "Non Critical Red LED" 25 "Non Critical Blue LED" 26 "Non Critical Grey LED" 28 "Critical Yellow LED" 29 "Critical Red LED" 30 "Critical Blue LED" 31 "Critical Grey LED";
VAL_ 2651312128 Status 0 "OK" 1 "Disabled" 2 "Initializing" 3 "Heating" 4 "WB_Active" 5 "Too Cold" 6 "Too Hot" 7 "Unplugged" 8 "Slow!" 9 "Uncal Yellow" 10 "Uncal Red" 11 "Replace" 12 "Disabled" 13 "Shorted" 14 "Open" 15 "Over Range" 16 "Under Range" 17 "Undefined" 18 "Error!" 19 "Low Error" 20 "High Error" 21 "Non Critical No LED" 27 "Critical Green LED" 32 "Stall!" 33 "Synchronized" 34 "Syncing" 35 "Error!" 36 "Error!" 37 "Uncalibrated" 38 "Open Loop" 39 "Closed Loop" 40 "Not Learn" 41 "Learning" 42 "Off" 43 "On" 44 "Not Rev Limiting" 45 "Rev Limit" 46 "No Cut Off" 47 "CutOff!" 48 "Off" 49 "Warning!" 50 "Caution!" 51 "No Timing modifier" 52 "Timing is being modified" 53 "Timing Value is being replaced" 54 "Acq Sat" 55 "No GPS" 56 "No Data" 22 "Non Critical Green LED" 23 "Non Critical Yellow LED" 24 "Non Critical Red LED" 25 "Non Critical Blue LED" 26 "Non Critical Grey LED" 28 "Critical Yellow LED" 29 "Critical Red LED" 30 "Critical Blue LED" 31 "Critical Grey LED";
VAL_ 2651328512 Status 0 "OK" 1 "Disabled" 2 "Initializing" 3 "Heating" 4 "WB_Active" 5 "Too Cold" 6 "Too Hot" 7 "Unplugged" 8 "Slow!" 9 "Uncal Yellow" 10 "Uncal Red" 11 "Replace" 12 "Disabled" 13 "Shorted" 14 "Open" 15 "Over Range" 16 "Under Range" 17 "Undefined" 18 "Error!" 19 "Low Error" 20 "High Error" 21 "Non Critical No LED" 27 "Critical Green LED" 32 "Stall!" 33 "Synchronized" 34 "Syncing" 35 "Error!" 36 "Error!" 37 "Uncalibrated" 38 "Open Loop" 39 "Closed Loop" 40 "Not Learn" 41 "Learning" 42 "Off" 43 "On" 44 "Not Rev Limiting" 45 "Rev Limit" 46 "No Cut Off" 47 "CutOff!" 48 "Off" 49 "Warning!" 50 "Caution!" 51 "No Timing modifier" 52 "Timing is being modified" 53 "Timing Value is being replaced" 54 "Acq Sat" 55 "No GPS" 56 "No Data" 22 "Non Critical Green LED" 23 "Non Critical Yellow LED" 24 "Non Critical Red LED" 25 "Non Critical Blue LED" 26 "Non Critical Grey LED" 28 "Critical Yellow LED" 29 "Critical Red LED" 30 "Critical Blue LED" 31 "Critical Grey LED";
VAL_ 2651344896 Status 0 "OK" 1 "Disabled" 2 "Initializing" 3 "Heating" 4 "WB_Active" 5 "Too Cold" 6 "Too Hot" 7 "Unplugged" 8 "Slow!" 9 "Uncal Yellow" 10 "Uncal Red" 11 "Replace" 12 "Disabled" 13 "Shorted" 14 "Open" 15 "Over Range" 16 "Under Range" 17 "Undefined" 18 "Error!" 19 "Low Error" 20 "High Error" 21 "Non Critical No LED" 27 "Critical Green LED" 32 "Stall!" 33 "Synchronized" 34 "Syncing" 35 "Error!" 36 "Error!" 37 "Uncalibrated" 38 "Open Loop" 39 "Closed Loop" 40 "Not Learn" 41 "Learning" 42 "Off" 43 "On" 44 "Not Rev Limiting" 45 "Rev Limit" 46 "No Cut Off" 47 "CutOff!" 48 "Off" 49 "Warning!" 50 "Caution!" 51 "No Timing modifier" 52 "Timing is being modified" 53 "Timing Value is being replaced" 54 "Acq Sat" 55 "No GPS" 56 "No Data" 22 "Non Critical Green LED" 23 "Non Critical Yellow LED" 24 "Non Critical Red LED" 25 "Non Critical Blue LED" 26 "Non Critical Grey LED" 28 "Critical Yellow LED" 29 "Critical Red LED" 30 "Critical Blue LED" 31 "Critical Grey LED";
VAL_ 2651361280 Status 0 "OK" 1 "Disabled" 2 "Initializing" 3 "Heating" 4 "WB_Active" 5 "Too Cold" 6 "Too Hot" 7 "Unplugged" 8 "Slow!" 9 "Uncal Yellow" 10 "Uncal Red" 11 "Replace" 12 "Disabled" 13 "Shorted" 14 "Open" 15 "Over Range" 16 "Under Range" 17 "Undefined" 18 "Error!" 19 "Low Error" 20 "High Error" 21 "Non Critical No LED" 27 "Critical Green LED" 32 "Stall!" 33 "Synchronized" 34 "Syncing" 35 "Error!" 36 "Error!" 37 "Uncalibrated" 38 "Open Loop" 39 "Closed Loop" 40 "Not Learn" 41 "Learning" 42 "Off" 43 "On" 44 "Not Rev Limiting" 45 "Rev Limit" 46 "No Cut Off" 47 "CutOff!" 48 "Off" 49 "Warning!" 50 "Caution!" 51 "No Timing modifier" 52 "Timing is being modified" 53 "Timing Value is being replaced" 54 "Acq Sat" 55 "No GPS" 56 "No Data" 22 "Non Critical Green LED" 23 "Non Critical Yellow LED" 24 "Non Critical Red LED" 25 "Non Critical Blue LED" 26 "Non Critical Grey LED" 28 "Critical Yellow LED" 29 "Critical Red LED" 30 "Critical Blue LED" 31 "Critical Grey LED";
VAL_ 2651377664 Status 0 "OK" 1 "Disabled" 2 "Initializing" 3 "Heating" 4 "WB_Active" 5 "Too Cold" 6 "Too Hot" 7 "Unplugged" 8 "Slow!" 9 "Uncal Yellow" 10 "Uncal Red" 11 "Replace" 12 "Disabled" 13 "Shorted" 14 "Open" 15 "Over Range" 16 "Under Range" 17 "Undefined" 18 "Error!" 19 "Low Error" 20 "High Error" 21 "Non Critical No LED" 27 "Critical Green LED" 32 "Stall!" 33 "Synchronized" 34 "Syncing" 35 "Error!" 36 "Error!" 37 "Uncalibrated" 38 "Open Loop" 39 "Closed Loop" 40 "Not Learn" 41 "Learning" 42 "Off" 43 "On" 44 "Not Rev Limiting" 45 "Rev Limit" 46 "No Cut Off" 47 "CutOff!" 48 "Off" 49 "Warning!" 50 "Caution!" 51 "No Timing modifier" 52 "Timing is being modified" 53 "Timing Value is being replaced" 54 "Acq Sat" 55 "No GPS" 56 "No Data" 22 "Non Critical Green LED" 23 "Non Critical Yellow LED" 24 "Non Critical Red LED" 25 "Non Critical Blue LED" 26 "Non Critical Grey LED" 28 "Critical Yellow LED" 29 "Critical Red LED" 30 "Critical Blue LED" 31 "Critical Grey LED";
VAL_ 2651394048 Status 0 "OK" 1 "Disabled" 2 "Initializing" 3 "Heating" 4 "WB_Active" 5 "Too Cold" 6 "Too Hot" 7 "Unplugged" 8 "Slow!" 9 "Uncal Yellow" 10 "Uncal Red" 11 "Replace" 12 "Disabled" 13 "Shorted" 14 "Open" 15 "Over Range" 16 "Under Range" 17 "Undefined" 18 "Error!" 19 "Low Error" 20 "High Error" 21 "Non Critical No LED" 27 "Critical Green LED" 32 "Stall!" 33 "Synchronized" 34 "Syncing" 35 "Error!" 36 "Error!" 37 "Uncalibrated" 38 "Open Loop" 39 "Closed Loop" 40 "Not Learn" 41 "Learning" 42 "Off" 43 "On" 44 "Not Rev Limiting" 45 "Rev Limit" 46 "No Cut Off" 47 "CutOff!" 48 "Off" 49 "Warning!" 50 "Caution!" 51 "No Timing modifier" 52 "Timing is being modified" 53 "Timing Value is being replaced" 54 "Acq Sat" 55 "No GPS" 56 "No Data" 22 "Non Critical Green LED" 23 "Non Critical Yellow LED" 24 "Non Critical Red LED" 25 "Non Critical Blue LED" 26 "Non Critical Grey LED" 28 "Critical Yellow LED" 29 "Critical Red LED" 30 "Critical Blue LED" 31 "Critical Grey LED";
VAL_ 2651410432 Status 0 "OK" 1 "Disabled" 2 "Initializing" 3 "Heating" 4 "WB_Active" 5 "Too Cold" 6 "Too Hot" 7 "Unplugged" 8 "Slow!" 9 "Uncal Yellow" 10 "Uncal Red" 11 "Replace" 12 "Disabled" 13 "Shorted" 14 "Open" 15 "Over Range" 16 "Under Range" 17 "Undefined" 18 "Error!" 19 "Low Error" 20 "High Error" 21 "Non Critical No LED" 27 "Critical Green LED" 32 "Stall!" 33 "Synchronized" 34 "Syncing" 35 "Error!" 36 "Error!" 37 "Uncalibrated" 38 "Open Loop" 39 "Closed Loop" 40 "Not Learn" 41 "Learning" 42 "Off" 43 "On" 44 "Not Rev Limiting" 45 "Rev Limit" 46 "No Cut Off" 47 "CutOff!" 48 "Off" 49 "Warning!" 50 "Caution!" 51 "No Timing modifier" 52 "Timing is being modified" 53 "Timing Value is being replaced" 54 "Acq Sat" 55 "No GPS" 56 "No Data" 22 "Non Critical Green LED" 23 "Non Critical Yellow LED" 24 "Non Critical Red LED" 25 "Non Critical Blue LED" 26 "Non Critical Grey LED" 28 "Critical Yellow LED" 29 "Critical Red LED" 30 "Critical Blue LED" 31 "Critical Grey LED";
VAL_ 2651426816 Status 0 "OK" 1 "Disabled" 2 "Initializing" 3 "Heating" 4 "WB_Active" 5 "Too Cold" 6 "Too Hot" 7 "Unplugged" 8 "Slow!" 9 "Uncal Yellow" 10 "Uncal Red" 11 "Replace" 12 "Disabled" 13 "Shorted" 14 "Open" 15 "Over Range" 16 "Under Range" 17 "Undefined" 18 "Error!" 19 "Low Error" 20 "High Error" 21 "Non Critical No LED" 27 "Critical Green LED" 32 "Stall!" 33 "Synchronized" 34 "Syncing" 35 "Error!" 36 "Error!" 37 "Uncalibrated" 38 "Open Loop" 39 "Closed Loop" 40 "Not Learn" 41 "Learning" 42 "Off" 43 "On" 44 "Not Rev Limiting" 45 "Rev Limit" 46 "No Cut Off" 47 "CutOff!" 48 "Off" 49 "Warning!" 50 "Caution!" 51 "No Timing modifier" 52 "Timing is being modified" 53 "Timing Value is being replaced" 54 "Acq Sat" 55 "No GPS" 56 "No Data" 22 "Non Critical Green LED" 23 "Non Critical Yellow LED" 24 "Non Critical Red LED" 25 "Non Critical Blue LED" 26 "Non Critical Grey LED" 28 "Critical Yellow LED" 29 "Critical Red LED" 30 "Critical Blue LED" 31 "Critical Grey LED";
VAL_ 2651443200 Status 0 "OK" 1 "Disabled" 2 "Initializing" 3 "Heating" 4 "WB_Active" 5 "Too Cold" 6 "Too Hot" 7 "Unplugged" 8 "Slow!" 9 "Uncal Yellow" 10 "Uncal Red" 11 "Replace" 12 "Disabled" 13 "Shorted" 14 "Open" 15 "Over Range" 16 "Under Range" 17 "Undefined" 18 "Error!" 19 "Low Error" 20 "High Error" 21 "Non Critical No LED" 27 "Critical Green LED" 32 "Stall!" 33 "Synchronized" 34 "Syncing" 35 "Error!" 36 "Error!" 37 "Uncalibrated" 38 "Open Loop" 39 "Closed Loop" 40 "Not Learn" 41 "Learning" 42 "Off" 43 "On" 44 "Not Rev Limiting" 45 "Rev Limit" 46 "No Cut Off" 47 "CutOff!" 48 "Off" 49 "Warning!" 50 "Caution!" 51 "No Timing modifier" 52 "Timing is being modified" 53 "Timing Value is being replaced" 54 "Acq Sat" 55 "No GPS" 56 "No Data" 22 "Non Critical Green LED" 23 "Non Critical Yellow LED" 24 "Non Critical Red LED" 25 "Non Critical Blue LED" 26 "Non Critical Grey LED" 28 "Critical Yellow LED" 29 "Critical Red LED" 30 "Critical Blue LED" 31 "Critical Grey LED";
VAL_ 2651459584 Status 0 "OK" 1 "Disabled" 2 "Initializing" 3 "Heating" 4 "WB_Active" 5 "Too Cold" 6 "Too Hot" 7 "Unplugged" 8 "Slow!" 9 "Uncal Yellow" 10 "Uncal Red" 11 "Replace" 12 "Disabled" 13 "Shorted" 14 "Open" 15 "Over Range" 16 "Under Range" 17 "Undefined" 18 "Error!" 19 "Low Error" 20 "High Error" 21 "Non Critical No LED" 27 "Critical Green LED" 32 "Stall!" 33 "Synchronized" 34 "Syncing" 35 "Error!" 36 "Error!" 37 "Uncalibrated" 38 "Open Loop" 39 "Closed Loop" 40 "Not Learn" 41 "Learning" 42 "Off" 43 "On" 44 "Not Rev Limiting" 45 "Rev Limit" 46 "No Cut Off" 47 "CutOff!" 48 "Off" 49 "Warning!" 50 "Caution!" 51 "No Timing modifier" 52 "Timing is being modified" 53 "Timing Value is being replaced" 54 "Acq Sat" 55 "No GPS" 56 "No Data" 22 "Non Critical Green LED" 23 "Non Critical Yellow LED" 24 "Non Critical Red LED" 25 "Non Critical Blue LED" 26 "Non Critical Grey LED" 28 "Critical Yellow LED" 29 "Critical Red LED" 30 "Critical Blue LED" 31 "Critical Grey LED";
VAL_ 2651475968 Status 0 "OK" 1 "Disabled" 2 "Initializing" 3 "Heating" 4 "WB_Active" 5 "Too Cold" 6 "Too Hot" 7 "Unplugged" 8 "Slow!" 9 "Uncal Yellow" 10 "Uncal Red" 11 "Replace" 12 "Disabled" 13 "Shorted" 14 "Open" 15 "Over Range" 16 "Under Range" 17 "Undefined" 18 "Error!" 19 "Low Error" 20 "High Error" 21 "Non Critical No LED" 27 "Critical Green LED" 32 "Stall!" 33 "Synchronized" 34 "Syncing" 35 "Error!" 36 "Error!" 37 "Uncalibrated" 38 "Open Loop" 39 "Closed Loop" 40 "Not Learn" 41 "Learning" 42 "Off" 43 "On" 44 "Not Rev Limiting" 45 "Rev Limit" 46 "No Cut Off" 47 "CutOff!" 48 "Off" 49 "Warning!" 50 "Caution!" 51 "No Timing modifier" 52 "Timing is being modified" 53 "Timing Value is being replaced" 54 "Acq Sat" 55 "No GPS" 56 "No Data" 22 "Non Critical Green LED" 23 "Non Critical Yellow LED" 24 "Non Critical Red LED" 25 "Non Critical Blue LED" 26 "Non Critical Grey LED" 28 "Critical Yellow LED" 29 "Critical Red LED" 30 "Critical Blue LED" 31 "Critical Grey LED";
VAL_ 2651492352 Status 0 "OK" 1 "Disabled" 2 "Initializing" 3 "Heating" 4 "WB_Active" 5 "Too Cold" 6 "Too Hot" 7 "Unplugged" 8 "Slow!" 9 "Uncal Yellow" 10 "Uncal Red" 11 "Replace" 12 "Disabled" 13 "Shorted" 14 "Open" 15 "Over Range" 16 "Under Range" 17 "Undefined" 18 "Error!" 19 "Low Error" 20 "High Error" 21 "Non Critical No LED" 27 "Critical Green LED" 32 "Stall!" 33 "Synchronized" 34 "Syncing" 35 "Error!" 36 "Error!" 37 "Uncalibrated" 38 "Open Loop" 39 "Closed Loop" 40 "Not Learn" 41 "Learning" 42 "Off" 43 "On" 44 "Not Rev Limiting" 45 "Rev Limit" 46 "No Cut Off" 47 "CutOff!" 48 "Off" 49 "Warning!" 50 "Caution!" 51 "No Timing modifier" 52 "Timing is being modified" 53 "Timing Value is being replaced" 54 "Acq Sat" 55 "No GPS" 56 "No Data" 22 "Non Critical Green LED" 23 "Non Critical Yellow LED" 24 "Non Critical Red LED" 25 "Non Critical Blue LED" 26 "Non Critical Grey LED" 28 "Critical Yellow LED" 29 "Critical Red LED" 30 "Critical Blue LED" 31 "Critical Grey LED";
VAL_ 2651508736 Status 0 "OK" 1 "Disabled" 2 "Initializing" 3 "Heating" 4 "WB_Active" 5 "Too Cold" 6 "Too Hot" 7 "Unplugged" 8 "Slow!" 9 "Uncal Yellow" 10 "Uncal Red" 11 "Replace" 12 "Disabled" 13 "Shorted" 14 "Open" 15 "Over Range" 16 "Under Range" 17 "Undefined" 18 "Error!" 19 "Low Error" 20 "High Error" 21 "Non Critical No LED" 27 "Critical Green LED" 32 "Stall!" 33 "Synchronized" 34 "Syncing" 35 "Error!" 36 "Error!" 37 "Uncalibrated" 38 "Open Loop" 39 "Closed Loop" 40 "Not Learn" 41 "Learning" 42 "Off" 43 "On" 44 "Not Rev Limiting" 45 "Rev Limit" 46 "No Cut Off" 47 "CutOff!" 48 "Off" 49 "Warning!" 50 "Caution!" 51 "No Timing modifier" 52 "Timing is being modified" 53 "Timing Value is being replaced" 54 "Acq Sat" 55 "No GPS" 56 "No Data" 22 "Non Critical Green LED" 23 "Non Critical Yellow LED" 24 "Non Critical Red LED" 25 "Non Critical Blue LED" 26 "Non Critical Grey LED" 28 "Critical Yellow LED" 29 "Critical Red LED" 30 "Critical Blue LED" 31 "Critical Grey LED";
VAL_ 2651525120 Status 0 "OK" 1 "Disabled" 2 "Initializing" 3 "Heating" 4 "WB_Active" 5 "Too Cold" 6 "Too Hot" 7 "Unplugged" 8 "Slow!" 9 "Uncal Yellow" 10 "Uncal Red" 11 "Replace" 12 "Disabled" 13 "Shorted" 14 "Open" 15 "Over Range" 16 "Under Range" 17 "Undefined" 18 "Error!" 19 "Low Error" 20 "High Error" 21 "Non Critical No LED" 27 "Critical Green LED" 32 "Stall!" 33 "Synchronized" 34 "Syncing" 35 "Error!" 36 "Error!" 37 "Uncalibrated" 38 "Open Loop" 39 "Closed Loop" 40 "Not Learn" 41 "Learning" 42 "Off" 43 "On" 44 "Not Rev Limiting" 45 "Rev Limit" 46 "No Cut Off" 47 "CutOff!" 48 "Off" 49 "Warning!" 50 "Caution!" 51 "No Timing modifier" 52 "Timing is being modified" 53 "Timing Value is being replaced" 54 "Acq Sat" 55 "No GPS" 56 "No Data" 22 "Non Critical Green LED" 23 "Non Critical Yellow LED" 24 "Non Critical Red LED" 25 "Non Critical Blue LED" 26 "Non Critical Grey LED" 28 "Critical Yellow LED" 29 "Critical Red LED" 30 "Critical Blue LED" 31 "Critical Grey LED";
VAL_ 2651541504 Status 0 "OK" 1 "Disabled" 2 "Initializing" 3 "Heating" 4 "WB_Active" 5 "Too Cold" 6 "Too Hot" 7 "Unplugged" 8 "Slow!" 9 "Uncal Yellow" 10 "Uncal Red" 11 "Replace" 12 "Disabled" 13 "Shorted" 14 "Open" 15 "Over Range" 16 "Under Range" 17 "Undefined" 18 "Error!" 19 "Low Error" 20 "High Error" 21 "Non Critical No LED" 27 "Critical Green LED" 32 "Stall!" 33 "Synchronized" 34 "Syncing" 35 "Error!" 36 "Error!" 37 "Uncalibrated" 38 "Open Loop" 39 "Closed Loop" 40 "Not Learn" 41 "Learning" 42 "Off" 43 "On" 44 "Not Rev Limiting" 45 "Rev Limit" 46 "No Cut Off" 47 "CutOff!" 48 "Off" 49 "Warning!" 50 "Caution!" 51 "No Timing modifier" 52 "Timing is being modified" 53 "Timing Value is being replaced" 54 "Acq Sat" 55 "No GPS" 56 "No Data" 22 "Non Critical Green LED" 23 "Non Critical Yellow LED" 24 "Non Critical Red LED" 25 "Non Critical Blue LED" 26 "Non Critical Grey LED" 28 "Critical Yellow LED" 29 "Critical Red LED" 30 "Critical Blue LED" 31 "Critical Grey LED";
VAL_ 2651557888 Status 0 "OK" 1 "Disabled" 2 "Initializing" 3 "Heating" 4 "WB_Active" 5 "Too Cold" 6 "Too Hot" 7 "Unplugged" 8 "Slow!" 9 "Uncal Yellow" 10 "Uncal Red" 11 "Replace" 12 "Disabled" 13 "Shorted" 14 "Open" 15 "Over Range" 16 "Under Range" 17 "Undefined" 18 "Error!" 19 "Low Error" 20 "High Error" 21 "Non Critical No LED" 27 "Critical Green LED" 32 "Stall!" 33 "Synchronized" 34 "Syncing" 35 "Error!" 36 "Error!" 37 "Uncalibrated" 38 "Open Loop" 39 "Closed Loop" 40 "Not Learn" 41 "Learning" 42 "Off" 43 "On" 44 "Not Rev Limiting" 45 "Rev Limit" 46 "No Cut Off" 47 "CutOff!" 48 "Off" 49 "Warning!" 50 "Caution!" 51 "No Timing modifier" 52 "Timing is being modified" 53 "Timing Value is being replaced" 54 "Acq Sat" 55 "No GPS" 56 "No Data" 22 "Non Critical Green LED" 23 "Non Critical Yellow LED" 24 "Non Critical Red LED" 25 "Non Critical Blue LED" 26 "Non Critical Grey LED" 28 "Critical Yellow LED" 29 "Critical Red LED" 30 "Critical Blue LED" 31 "Critical Grey LED";
VAL_ 2651574272 Status 0 "OK" 1 "Disabled" 2 "Initializing" 3 "Heating" 4 "WB_Active" 5 "Too Cold" 6 "Too Hot" 7 "Unplugged" 8 "Slow!" 9 "Uncal Yellow" 10 "Uncal Red" 11 "Replace" 12 "Disabled" 13 "Shorted" 14 "Open" 15 "Over Range" 16 "Under Range" 17 "Undefined" 18 "Error!" 19 "Low Error" 20 "High Error" 21 "Non Critical No LED" 27 "Critical Green LED" 32 "Stall!" 33 "Synchronized" 34 "Syncing" 35 "Error!" 36 "Error!" 37 "Uncalibrated" 38 "Open Loop" 39 "Closed Loop" 40 "Not Learn" 41 "Learning" 42 "Off" 43 "On" 44 "Not Rev Limiting" 45 "Rev Limit" 46 "No Cut Off" 47 "CutOff!" 48 "Off" 49 "Warning!" 50 "Caution!" 51 "No Timing modifier" 52 "Timing is being modified" 53 "Timing Value is being replaced" 54 "Acq Sat" 55 "No GPS" 56 "No Data" 22 "Non Critical Green LED" 23 "Non Critical Yellow LED" 24 "Non Critical Red LED" 25 "Non Critical Blue LED" 26 "Non Critical Grey LED" 28 "Critical Yellow LED" 29 "Critical Red LED" 30 "Critical Blue LED" 31 "Critical Grey LED";
VAL_ 2651590656 Status 0 "OK" 1 "Disabled" 2 "Initializing" 3 "Heating" 4 "WB_Active" 5 "Too Cold" 6 "Too Hot" 7 "Unplugged" 8 "Slow!" 9 "Uncal Yellow" 10 "Uncal Red" 11 "Replace" 12 "Disabled" 13 "Shorted" 14 "Open" 15 "Over Range" 16 "Under Range" 17 "Undefined" 18 "Error!" 19 "Low Error" 20 "High Error" 21 "Non Critical No LED" 27 "Critical Green LED" 32 "Stall!" 33 "Synchronized" 34 "Syncing" 35 "Error!" 36 "Error!" 37 "Uncalibrated" 38 "Open Loop" 39 "Closed Loop" 40 "Not Learn" 41 "Learning" 42 "Off" 43 "On" 44 "Not Rev Limiting" 45 "Rev Limit" 46 "No Cut Off" 47 "CutOff!" 48 "Off" 49 "Warning!" 50 "Caution!" 51 "No Timing modifier" 52 "Timing is being modified" 53 "Timing Value is being replaced" 54 "Acq Sat" 55 "No GPS" 56 "No Data" 22 "Non Critical Green LED" 23 "Non Critical Yellow LED" 24 "Non Critical Red LED" 25 "Non Critical Blue LED" 26 "Non Critical Grey LED" 28 "Critical Yellow LED" 29 "Critical Red LED" 30 "Critical Blue LED" 31 "Critical Grey LED";
VAL_ 2651607040 Status 0 "OK" 1 "Disabled" 2 "Initializing" 3 "Heating" 4 "WB_Active" 5 "Too Cold" 6 "Too Hot" 7 "Unplugged" 8 "Slow!" 9 "Uncal Yellow" 10 "Uncal Red" 11 "Replace" 12 "Disabled" 13 "Shorted" 14 "Open" 15 "Over Range" 16 "Under Range" 17 "Undefined" 18 "Error!" 19 "Low Error" 20 "High Error" 21 "Non Critical No LED" 27 "Critical Green LED" 32 "Stall!" 33 "Synchronized" 34 "Syncing" 35 "Error!" 36 "Error!" 37 "Uncalibrated" 38 "Open Loop" 39 "Closed Loop" 40 "Not Learn" 41 "Learning" 42 "Off" 43 "On" 44 "Not Rev Limiting" 45 "Rev Limit" 46 "No Cut Off" 47 "CutOff!" 48 "Off" 49 "Warning!" 50 "Caution!" 51 "No Timing modifier" 52 "Timing is being modified" 53 "Timing Value is being replaced" 54 "Acq Sat" 55 "No GPS" 56 "No Data" 22 "Non Critical Green LED" 23 "Non Critical Yellow LED" 24 "Non Critical Red LED" 25 "Non Critical Blue LED" 26 "Non Critical Grey LED" 28 "Critical Yellow LED" 29 "Critical Red LED" 30 "Critical Blue LED" 31 "Critical Grey LED";
VAL_ 2651623424 Status 0 "OK" 1 "Disabled" 2 "Initializing" 3 "Heating" 4 "WB_Active" 5 "Too Cold" 6 "Too Hot" 7 "Unplugged" 8 "Slow!" 9 "Uncal Yellow" 10 "Uncal Red" 11 "Replace" 12 "Disabled" 13 "Shorted" 14 "Open" 15 "Over Range" 16 "Under Range" 17 "Undefined" 18 "Error!" 19 "Low Error" 20 "High Error" 21 "Non Critical No LED" 27 "Critical Green LED" 32 "Stall!" 33 "Synchronized" 34 "Syncing" 35 "Error!" 36 "Error!" 37 "Uncalibrated" 38 "Open Loop" 39 "Closed Loop" 40 "Not Learn" 41 "Learning" 42 "Off" 43 "On" 44 "Not Rev Limiting" 45 "Rev Limit" 46 "No Cut Off" 47 "CutOff!" 48 "Off" 49 "Warning!" 50 "Caution!" 51 "No Timing modifier" 52 "Timing is being modified" 53 "Timing Value is being replaced" 54 "Acq Sat" 55 "No GPS" 56 "No Data" 22 "Non Critical Green LED" 23 "Non Critical Yellow LED" 24 "Non Critical Red LED" 25 "Non Critical Blue LED" 26 "Non Critical Grey LED" 28 "Critical Yellow LED" 29 "Critical Red LED" 30 "Critical Blue LED" 31 "Critical Grey LED";
VAL_ 2651639808 Status 0 "OK" 1 "Disabled" 2 "Initializing" 3 "Heating" 4 "WB_Active" 5 "Too Cold" 6 "Too Hot" 7 "Unplugged" 8 "Slow!" 9 "Uncal Yellow" 10 "Uncal Red" 11 "Replace" 12 "Disabled" 13 "Shorted" 14 "Open" 15 "Over Range" 16 "Under Range" 17 "Undefined" 18 "Error!" 19 "Low Error" 20 "High Error" 21 "Non Critical No LED" 27 "Critical Green LED" 32 "Stall!" 33 "Synchronized" 34 "Syncing" 35 "Error!" 36 "Error!" 37 "Uncalibrated" 38 "Open Loop" 39 "Closed Loop" 40 "Not Learn" 41 "Learning" 42 "Off" 43 "On" 44 "Not Rev Limiting" 45 "Rev Limit" 46 "No Cut Off" 47 "CutOff!" 48 "Off" 49 "Warning!" 50 "Caution!" 51 "No Timing modifier" 52 "Timing is being modified" 53 "Timing Value is being replaced" 54 "Acq Sat" 55 "No GPS" 56 "No Data" 22 "Non Critical Green LED" 23 "Non Critical Yellow LED" 24 "Non Critical Red LED" 25 "Non Critical Blue LED" 26 "Non Critical Grey LED" 28 "Critical Yellow LED" 29 "Critical Red LED" 30 "Critical Blue LED" 31 "Critical Grey LED";
VAL_ 2651656192 Status 0 "OK" 1 "Disabled" 2 "Initializing" 3 "Heating" 4 "WB_Active" 5 "Too Cold" 6 "Too Hot" 7 "Unplugged" 8 "Slow!" 9 "Uncal Yellow" 10 "Uncal Red" 11 "Replace" 12 "Disabled" 13 "Shorted" 14 "Open" 15 "Over Range" 16 "Under Range" 17 "Undefined" 18 "Error!" 19 "Low Error" 20 "High Error" 21 "Non Critical No LED" 27 "Critical Green LED" 32 "Stall!" 33 "Synchronized" 34 "Syncing" 35 "Error!" 36 "Error!" 37 "Uncalibrated" 38 "Open Loop" 39 "Closed Loop" 40 "Not Learn" 41 "Learning" 42 "Off" 43 "On" 44 "Not Rev Limiting" 45 "Rev Limit" 46 "No Cut Off" 47 "CutOff!" 48 "Off" 49 "Warning!" 50 "Caution!" 51 "No Timing modifier" 52 "Timing is being modified" 53 "Timing Value is being replaced" 54 "Acq Sat" 55 "No GPS" 56 "No Data" 22 "Non Critical Green LED" 23 "Non Critical Yellow LED" 24 "Non Critical Red LED" 25 "Non Critical Blue LED" 26 "Non Critical Grey LED" 28 "Critical Yellow LED" 29 "Critical Red LED" 30 "Critical Blue LED" 31 "Critical Grey LED";
VAL_ 2651672576 Status 0 "OK" 1 "Disabled" 2 "Initializing" 3 "Heating" 4 "WB_Active" 5 "Too Cold" 6 "Too Hot" 7 "Unplugged" 8 "Slow!" 9 "Uncal Yellow" 10 "Uncal Red" 11 "Replace" 12 "Disabled" 13 "Shorted" 14 "Open" 15 "Over Range" 16 "Under Range" 17 "Undefined" 18 "Error!" 19 "Low Error" 20 "High Error" 21 "Non Critical No LED" 27 "Critical Green LED" 32 "Stall!" 33 "Synchronized" 34 "Syncing" 35 "Error!" 36 "Error!" 37 "Uncalibrated" 38 "Open Loop" 39 "Closed Loop" 40 "Not Learn" 41 "Learning" 42 "Off" 43 "On" 44 "Not Rev Limiting" 45 "Rev Limit" 46 "No Cut Off" 47 "CutOff!" 48 "Off" 49 "Warning!" 50 "Caution!" 51 "No Timing modifier" 52 "Timing is being modified" 53 "Timing Value is being replaced" 54 "Acq Sat" 55 "No GPS" 56 "No Data" 22 "Non Critical Green LED" 23 "Non Critical Yellow LED" 24 "Non Critical Red LED" 25 "Non Critical Blue LED" 26 "Non Critical Grey LED" 28 "Critical Yellow LED" 29 "Critical Red LED" 30 "Critical Blue LED" 31 "Critical Grey LED";
VAL_ 2651688960 Status 0 "OK" 1 "Disabled" 2 "Initializing" 3 "Heating" 4 "WB_Active" 5 "Too Cold" 6 "Too Hot" 7 "Unplugged" 8 "Slow!" 9 "Uncal Yellow" 10 "Uncal Red" 11 "Replace" 12 "Disabled" 13 "Shorted" 14 "Open" 15 "Over Range" 16 "Under Range" 17 "Undefined" 18 "Error!" 19 "Low Error" 20 "High Error" 21 "Non Critical No LED" 27 "Critical Green LED" 32 "Stall!" 33 "Synchronized" 34 "Syncing" 35 "Error!" 36 "Error!" 37 "Uncalibrated" 38 "Open Loop" 39 "Closed Loop" 40 "Not Learn" 41 "Learning" 42 "Off" 43 "On" 44 "Not Rev Limiting" 45 "Rev Limit" 46 "No Cut Off" 47 "CutOff!" 48 "Off" 49 "Warning!" 50 "Caution!" 51 "No Timing modifier" 52 "Timing is being modified" 53 "Timing Value is being replaced" 54 "Acq Sat" 55 "No GPS" 56 "No Data" 22 "Non Critical Green LED" 23 "Non Critical Yellow LED" 24 "Non Critical Red LED" 25 "Non Critical Blue LED" 26 "Non Critical Grey LED" 28 "Critical Yellow LED" 29 "Critical Red LED" 30 "Critical Blue LED" 31 "Critical Grey LED";
VAL_ 2651705344 Status 0 "OK" 1 "Disabled" 2 "Initializing" 3 "Heating" 4 "WB_Active" 5 "Too Cold" 6 "Too Hot" 7 "Unplugged" 8 "Slow!" 9 "Uncal Yellow" 10 "Uncal Red" 11 "Replace" 12 "Disabled" 13 "Shorted" 14 "Open" 15 "Over Range" 16 "Under Range" 17 "Undefined" 18 "Error!" 19 "Low Error" 20 "High Error" 21 "Non Critical No LED" 27 "Critical Green LED" 32 "Stall!" 33 "Synchronized" 34 "Syncing" 35 "Error!" 36 "Error!" 37 "Uncalibrated" 38 "Open Loop" 39 "Closed Loop" 40 "Not Learn" 41 "Learning" 42 "Off" 43 "On" 44 "Not Rev Limiting" 45 "Rev Limit" 46 "No Cut Off" 47 "CutOff!" 48 "Off" 49 "Warning!" 50 "Caution!" 51 "No Timing modifier" 52 "Timing is being modified" 53 "Timing Value is being replaced" 54 "Acq Sat" 55 "No GPS" 56 "No Data" 22 "Non Critical Green LED" 23 "Non Critical Yellow LED" 24 "Non Critical Red LED" 25 "Non Critical Blue LED" 26 "Non Critical Grey LED" 28 "Critical Yellow LED" 29 "Critical Red LED" 30 "Critical Blue LED" 31 "Critical Grey LED";
VAL_ 2651721728 Status 0 "OK" 1 "Disabled" 2 "Initializing" 3 "Heating" 4 "WB_Active" 5 "Too Cold" 6 "Too Hot" 7 "Unplugged" 8 "Slow!" 9 "Uncal Yellow" 10 "Uncal Red" 11 "Replace" 12 "Disabled" 13 "Shorted" 14 "Open" 15 "Over Range" 16 "Under Range" 17 "Undefined" 18 "Error!" 19 "Low Error" 20 "High Error" 21 "Non Critical No LED" 27 "Critical Green LED" 32 "Stall!" 33 "Synchronized" 34 "Syncing" 35 "Error!" 36 "Error!" 37 "Uncalibrated" 38 "Open Loop" 39 "Closed Loop" 40 "Not Learn" 41 "Learning" 42 "Off" 43 "On" 44 "Not Rev Limiting" 45 "Rev Limit" 46 "No Cut Off" 47 "CutOff!" 48 "Off" 49 "Warning!" 50 "Caution!" 51 "No Timing modifier" 52 "Timing is being modified" 53 "Timing Value is being replaced" 54 "Acq Sat" 55 "No GPS" 56 "No Data" 22 "Non Critical Green LED" 23 "Non Critical Yellow LED" 24 "Non Critical Red LED" 25 "Non Critical Blue LED" 26 "Non Critical Grey LED" 28 "Critical Yellow LED" 29 "Critical Red LED" 30 "Critical Blue LED" 31 "Critical Grey LED";
VAL_ 2651738112 Status 0 "OK" 1 "Disabled" 2 "Initializing" 3 "Heating" 4 "WB_Active" 5 "Too Cold" 6 "Too Hot" 7 "Unplugged" 8 "Slow!" 9 "Uncal Yellow" 10 "Uncal Red" 11 "Replace" 12 "Disabled" 13 "Shorted" 14 "Open" 15 "Over Range" 16 "Under Range" 17 "Undefined" 18 "Error!" 19 "Low Error" 20 "High Error" 21 "Non Critical No LED" 27 "Critical Green LED" 32 "Stall!" 33 "Synchronized" 34 "Syncing" 35 "Error!" 36 "Error!" 37 "Uncalibrated" 38 "Open Loop" 39 "Closed Loop" 40 "Not Learn" 41 "Learning" 42 "Off" 43 "On" 44 "Not Rev Limiting" 45 "Rev Limit" 46 "No Cut Off" 47 "CutOff!" 48 "Off" 49 "Warning!" 50 "Caution!" 51 "No Timing modifier" 52 "Timing is being modified" 53 "Timing Value is being replaced" 54 "Acq Sat" 55 "No GPS" 56 "No Data" 22 "Non Critical Green LED" 23 "Non Critical Yellow LED" 24 "Non Critical Red LED" 25 "Non Critical Blue LED" 26 "Non Critical Grey LED" 28 "Critical Yellow LED" 29 "Critical Red LED" 30 "Critical Blue LED" 31 "Critical Grey LED";
VAL_ 2651754496 Status 0 "OK" 1 "Disabled" 2 "Initializing" 3 "Heating" 4 "WB_Active" 5 "Too Cold" 6 "Too Hot" 7 "Unplugged" 8 "Slow!" 9 "Uncal Yellow" 10 "Uncal Red" 11 "Replace" 12 "Disabled" 13 "Shorted" 14 "Open" 15 "Over Range" 16 "Under Range" 17 "Undefined" 18 "Error!" 19 "Low Error" 20 "High Error" 21 "Non Critical No LED" 27 "Critical Green LED" 32 "Stall!" 33 "Synchronized" 34 "Syncing" 35 "Error!" 36 "Error!" 37 "Uncalibrated" 38 "Open Loop" 39 "Closed Loop" 40 "Not Learn" 41 "Learning" 42 "Off" 43 "On" 44 "Not Rev Limiting" 45 "Rev Limit" 46 "No Cut Off" 47 "CutOff!" 48 "Off" 49 "Warning!" 50 "Caution!" 51 "No Timing modifier" 52 "Timing is being modified" 53 "Timing Value is being replaced" 54 "Acq Sat" 55 "No GPS" 56 "No Data" 22 "Non Critical Green LED" 23 "Non Critical Yellow LED" 24 "Non Critical Red LED" 25 "Non Critical Blue LED" 26 "Non Critical Grey LED" 28 "Critical Yellow LED" 29 "Critical Red LED" 30 "Critical Blue LED" 31 "Critical Grey LED";
VAL_ 2651770880 Status 0 "OK" 1 "Disabled" 2 "Initializing" 3 "Heating" 4 "WB_Active" 5 "Too Cold" 6 "Too Hot" 7 "Unplugged" 8 "Slow!" 9 "Uncal Yellow" 10 "Uncal Red" 11 "Replace" 12 "Disabled" 13 "Shorted" 14 "Open" 15 "Over Range" 16 "Under Range" 17 "Undefined" 18 "Error!" 19 "Low Error" 20 "High Error" 21 "Non Critical No LED" 27 "Critical Green LED" 32 "Stall!" 33 "Synchronized" 34 "Syncing" 35 "Error!" 36 "Error!" 37 "Uncalibrated" 38 "Open Loop" 39 "Closed Loop" 40 "Not Learn" 41 "Learning" 42 "Off" 43 "On" 44 "Not Rev Limiting" 45 "Rev Limit" 46 "No Cut Off" 47 "CutOff!" 48 "Off" 49 "Warning!" 50 "Caution!" 51 "No Timing modifier" 52 "Timing is being modified" 53 "Timing Value is being replaced" 54 "Acq Sat" 55 "No GPS" 56 "No Data" 22 "Non Critical Green LED" 23 "Non Critical Yellow LED" 24 "Non Critical Red LED" 25 "Non Critical Blue LED" 26 "Non Critical Grey LED" 28 "Critical Yellow LED" 29 "Critical Red LED" 30 "Critical Blue LED" 31 "Critical Grey LED";
VAL_ 2651787264 Status 0 "OK" 1 "Disabled" 2 "Initializing" 3 "Heating" 4 "WB_Active" 5 "Too Cold" 6 "Too Hot" 7 "Unplugged" 8 "Slow!" 9 "Uncal Yellow" 10 "Uncal Red" 11 "Replace" 12 "Disabled" 13 "Shorted" 14 "Open" 15 "Over Range" 16 "Under Range" 17 "Undefined" 18 "Error!" 19 "Low Error" 20 "High Error" 21 "Non Critical No LED" 27 "Critical Green LED" 32 "Stall!" 33 "Synchronized" 34 "Syncing" 35 "Error!" 36 "Error!" 37 "Uncalibrated" 38 "Open Loop" 39 "Closed Loop" 40 "Not Learn" 41 "Learning" 42 "Off" 43 "On" 44 "Not Rev Limiting" 45 "Rev Limit" 46 "No Cut Off" 47 "CutOff!" 48 "Off" 49 "Warning!" 50 "Caution!" 51 "No Timing modifier" 52 "Timing is being modified" 53 "Timing Value is being replaced" 54 "Acq Sat" 55 "No GPS" 56 "No Data" 22 "Non Critical Green LED" 23 "Non Critical Yellow LED" 24 "Non Critical Red LED" 25 "Non Critical Blue LED" 26 "Non Critical Grey LED" 28 "Critical Yellow LED" 29 "Critical Red LED" 30 "Critical Blue LED" 31 "Critical Grey LED";
VAL_ 2651803648 Status 0 "OK" 1 "Disabled" 2 "Initializing" 3 "Heating" 4 "WB_Active" 5 "Too Cold" 6 "Too Hot" 7 "Unplugged" 8 "Slow!" 9 "Uncal Yellow" 10 "Uncal Red" 11 "Replace" 12 "Disabled" 13 "Shorted" 14 "Open" 15 "Over Range" 16 "Under Range" 17 "Undefined" 18 "Error!" 19 "Low Error" 20 "High Error" 21 "Non Critical No LED" 27 "Critical Green LED" 32 "Stall!" 33 "Synchronized" 34 "Syncing" 35 "Error!" 36 "Error!" 37 "Uncalibrated" 38 "Open Loop" 39 "Closed Loop" 40 "Not Learn" 41 "Learning" 42 "Off" 43 "On" 44 "Not Rev Limiting" 45 "Rev Limit" 46 "No Cut Off" 47 "CutOff!" 48 "Off" 49 "Warning!" 50 "Caution!" 51 "No Timing modifier" 52 "Timing is being modified" 53 "Timing Value is being replaced" 54 "Acq Sat" 55 "No GPS" 56 "No Data" 22 "Non Critical Green LED" 23 "Non Critical Yellow LED" 24 "Non Critical Red LED" 25 "Non Critical Blue LED" 26 "Non Critical Grey LED" 28 "Critical Yellow LED" 29 "Critical Red LED" 30 "Critical Blue LED" 31 "Critical Grey LED";
VAL_ 2651820032 Status 0 "OK" 1 "Disabled" 2 "Initializing" 3 "Heating" 4 "WB_Active" 5 "Too Cold" 6 "Too Hot" 7 "Unplugged" 8 "Slow!" 9 "Uncal Yellow" 10 "Uncal Red" 11 "Replace" 12 "Disabled" 13 "Shorted" 14 "Open" 15 "Over Range" 16 "Under Range" 17 "Undefined" 18 "Error!" 19 "Low Error" 20 "High Error" 21 "Non Critical No LED" 27 "Critical Green LED" 32 "Stall!" 33 "Synchronized" 34 "Syncing" 35 "Error!" 36 "Error!" 37 "Uncalibrated" 38 "Open Loop" 39 "Closed Loop" 40 "Not Learn" 41 "Learning" 42 "Off" 43 "On" 44 "Not Rev Limiting" 45 "Rev Limit" 46 "No Cut Off" 47 "CutOff!" 48 "Off" 49 "Warning!" 50 "Caution!" 51 "No Timing modifier" 52 "Timing is being modified" 53 "Timing Value is being replaced" 54 "Acq Sat" 55 "No GPS" 56 "No Data" 22 "Non Critical Green LED" 23 "Non Critical Yellow LED" 24 "Non Critical Red LED" 25 "Non Critical Blue LED" 26 "Non Critical Grey LED" 28 "Critical Yellow LED" 29 "Critical Red LED" 30 "Critical Blue LED" 31 "Critical Grey LED";
VAL_ 2651836416 Status 0 "OK" 1 "Disabled" 2 "Initializing" 3 "Heating" 4 "WB_Active" 5 "Too Cold" 6 "Too Hot" 7 "Unplugged" 8 "Slow!" 9 "Uncal Yellow" 10 "Uncal Red" 11 "Replace" 12 "Disabled" 13 "Shorted" 14 "Open" 15 "Over Range" 16 "Under Range" 17 "Undefined" 18 "Error!" 19 "Low Error" 20 "High Error" 21 "Non Critical No LED" 27 "Critical Green LED" 32 "Stall!" 33 "Synchronized" 34 "Syncing" 35 "Error!" 36 "Error!" 37 "Uncalibrated" 38 "Open Loop" 39 "Closed Loop" 40 "Not Learn" 41 "Learning" 42 "Off" 43 "On" 44 "Not Rev Limiting" 45 "Rev Limit" 46 "No Cut Off" 47 "CutOff!" 48 "Off" 49 "Warning!" 50 "Caution!" 51 "No Timing modifier" 52 "Timing is being modified" 53 "Timing Value is being replaced" 54 "Acq Sat" 55 "No GPS" 56 "No Data" 22 "Non Critical Green LED" 23 "Non Critical Yellow LED" 24 "Non Critical Red LED" 25 "Non Critical Blue LED" 26 "Non Critical Grey LED" 28 "Critical Yellow LED" 29 "Critical Red LED" 30 "Critical Blue LED" 31 "Critical Grey LED";
VAL_ 2651852800 Status 0 "OK" 1 "Disabled" 2 "Initializing" 3 "Heating" 4 "WB_Active" 5 "Too Cold" 6 "Too Hot" 7 "Unplugged" 8 "Slow!" 9 "Uncal Yellow" 10 "Uncal Red" 11 "Replace" 12 "Disabled" 13 "Shorted" 14 "Open" 15 "Over Range" 16 "Under Range" 17 "Undefined" 18 "Error!" 19 "Low Error" 20 "High Error" 21 "Non Critical No LED" 27 "Critical Green LED" 32 "Stall!" 33 "Synchronized" 34 "Syncing" 35 "Error!" 36 "Error!" 37 "Uncalibrated" 38 "Open Loop" 39 "Closed Loop" 40 "Not Learn" 41 "Learning" 42 "Off" 43 "On" 44 "Not Rev Limiting" 45 "Rev Limit" 46 "No Cut Off" 47 "CutOff!" 48 "Off" 49 "Warning!" 50 "Caution!" 51 "No Timing modifier" 52 "Timing is being modified" 53 "Timing Value is being replaced" 54 "Acq Sat" 55 "No GPS" 56 "No Data" 22 "Non Critical Green LED" 23 "Non Critical Yellow LED" 24 "Non Critical Red LED" 25 "Non Critical Blue LED" 26 "Non Critical Grey LED" 28 "Critical Yellow LED" 29 "Critical Red LED" 30 "Critical Blue LED" 31 "Critical Grey LED";
VAL_ 2651869184 Status 0 "OK" 1 "Disabled" 2 "Initializing" 3 "Heating" 4 "WB_Active" 5 "Too Cold" 6 "Too Hot" 7 "Unplugged" 8 "Slow!" 9 "Uncal Yellow" 10 "Uncal Red" 11 "Replace" 12 "Disabled" 13 "Shorted" 14 "Open" 15 "Over Range" 16 "Under Range" 17 "Undefined" 18 "Error!" 19 "Low Error" 20 "High Error" 21 "Non Critical No LED" 27 "Critical Green LED" 32 "Stall!" 33 "Synchronized" 34 "Syncing" 35 "Error!" 36 "Error!" 37 "Uncalibrated" 38 "Open Loop" 39 "Closed Loop" 40 "Not Learn" 41 "Learning" 42 "Off" 43 "On" 44 "Not Rev Limiting" 45 "Rev Limit" 46 "No Cut Off" 47 "CutOff!" 48 "Off" 49 "Warning!" 50 "Caution!" 51 "No Timing modifier" 52 "Timing is being modified" 53 "Timing Value is being replaced" 54 "Acq Sat" 55 "No GPS" 56 "No Data" 22 "Non Critical Green LED" 23 "Non Critical Yellow LED" 24 "Non Critical Red LED" 25 "Non Critical Blue LED" 26 "Non Critical Grey LED" 28 "Critical Yellow LED" 29 "Critical Red LED" 30 "Critical Blue LED" 31 "Critical Grey LED";
VAL_ 2651885568 Status 0 "OK" 1 "Disabled" 2 "Initializing" 3 "Heating" 4 "WB_Active" 5 "Too Cold" 6 "Too Hot" 7 "Unplugged" 8 "Slow!" 9 "Uncal Yellow" 10 "Uncal Red" 11 "Replace" 12 "Disabled" 13 "Shorted" 14 "Open" 15 "Over Range" 16 "Under Range" 17 "Undefined" 18 "Error!" 19 "Low Error" 20 "High Error" 21 "Non Critical No LED" 27 "Critical Green LED" 32 "Stall!" 33 "Synchronized" 34 "Syncing" 35 "Error!" 36 "Error!" 37 "Uncalibrated" 38 "Open Loop" 39 "Closed Loop" 40 "Not Learn" 41 "Learning" 42 "Off" 43 "On" 44 "Not Rev Limiting" 45 "Rev Limit" 46 "No Cut Off" 47 "CutOff!" 48 "Off" 49 "Warning!" 50 "Caution!" 51 "No Timing modifier" 52 "Timing is being modified" 53 "Timing Value is being replaced" 54 "Acq Sat" 55 "No GPS" 56 "No Data" 22 "Non Critical Green LED" 23 "Non Critical Yellow LED" 24 "Non Critical Red LED" 25 "Non Critical Blue LED" 26 "Non Critical Grey LED" 28 "Critical Yellow LED" 29 "Critical Red LED" 30 "Critical Blue LED" 31 "Critical Grey LED";
VAL_ 2651901952 Status 0 "OK" 1 "Disabled" 2 "Initializing" 3 "Heating" 4 "WB_Active" 5 "Too Cold" 6 "Too Hot" 7 "Unplugged" 8 "Slow!" 9 "Uncal Yellow" 10 "Uncal Red" 11 "Replace" 12 "Disabled" 13 "Shorted" 14 "Open" 15 "Over Range" 16 "Under Range" 17 "Undefined" 18 "Error!" 19 "Low Error" 20 "High Error" 21 "Non Critical No LED" 27 "Critical Green LED" 32 "Stall!" 33 "Synchronized" 34 "Syncing" 35 "Error!" 36 "Error!" 37 "Uncalibrated" 38 "Open Loop" 39 "Closed Loop" 40 "Not Learn" 41 "Learning" 42 "Off" 43 "On" 44 "Not Rev Limiting" 45 "Rev Limit" 46 "No Cut Off" 47 "CutOff!" 48 "Off" 49 "Warning!" 50 "Caution!" 51 "No Timing modifier" 52 "Timing is being modified" 53 "Timing Value is being replaced" 54 "Acq Sat" 55 "No GPS" 56 "No Data" 22 "Non Critical Green LED" 23 "Non Critical Yellow LED" 24 "Non Critical Red LED" 25 "Non Critical Blue LED" 26 "Non Critical Grey LED" 28 "Critical Yellow LED" 29 "Critical Red LED" 30 "Critical Blue LED" 31 "Critical Grey LED";
VAL_ 2651918336 Status 0 "OK" 1 "Disabled" 2 "Initializing" 3 "Heating" 4 "WB_Active" 5 "Too Cold" 6 "Too Hot" 7 "Unplugged" 8 "Slow!" 9 "Uncal Yellow" 10 "Uncal Red" 11 "Replace" 12 "Disabled" 13 "Shorted" 14 "Open" 15 "Over Range" 16 "Under Range" 17 "Undefined" 18 "Error!" 19 "Low Error" 20 "High Error" 21 "Non Critical No LED" 27 "Critical Green LED" 32 "Stall!" 33 "Synchronized" 34 "Syncing" 35 "Error!" 36 "Error!" 37 "Uncalibrated" 38 "Open Loop" 39 "Closed Loop" 40 "Not Learn" 41 "Learning" 42 "Off" 43 "On" 44 "Not Rev Limiting" 45 "Rev Limit" 46 "No Cut Off" 47 "CutOff!" 48 "Off" 49 "Warning!" 50 "Caution!" 51 "No Timing modifier" 52 "Timing is being modified" 53 "Timing Value is being replaced" 54 "Acq Sat" 55 "No GPS" 56 "No Data" 22 "Non Critical Green LED" 23 "Non Critical Yellow LED" 24 "Non Critical Red LED" 25 "Non Critical Blue LED" 26 "Non Critical Grey LED" 28 "Critical Yellow LED" 29 "Critical Red LED" 30 "Critical Blue LED" 31 "Critical Grey LED";
VAL_ 2651934720 Status 0 "OK" 1 "Disabled" 2 "Initializing" 3 "Heating" 4 "WB_Active" 5 "Too Cold" 6 "Too Hot" 7 "Unplugged" 8 "Slow!" 9 "Uncal Yellow" 10 "Uncal Red" 11 "Replace" 12 "Disabled" 13 "Shorted" 14 "Open" 15 "Over Range" 16 "Under Range" 17 "Undefined" 18 "Error!" 19 "Low Error" 20 "High Error" 21 "Non Critical No LED" 27 "Critical Green LED" 32 "Stall!" 33 "Synchronized" 34 "Syncing" 35 "Error!" 36 "Error!" 37 "Uncalibrated" 38 "Open Loop" 39 "Closed Loop" 40 "Not Learn" 41 "Learning" 42 "Off" 43 "On" 44 "Not Rev Limiting" 45 "Rev Limit" 46 "No Cut Off" 47 "CutOff!" 48 "Off" 49 "Warning!" 50 "Caution!" 51 "No Timing modifier" 52 "Timing is being modified" 53 "Timing Value is being replaced" 54 "Acq Sat" 55 "No GPS" 56 "No Data" 22 "Non Critical Green LED" 23 "Non Critical Yellow LED" 24 "Non Critical Red LED" 25 "Non Critical Blue LED" 26 "Non Critical Grey LED" 28 "Critical Yellow LED" 29 "Critical Red LED" 30 "Critical Blue LED" 31 "Critical Grey LED";
VAL_ 2651951104 Status 0 "OK" 1 "Disabled" 2 "Initializing" 3 "Heating" 4 "WB_Active" 5 "Too Cold" 6 "Too Hot" 7 "Unplugged" 8 "Slow!" 9 "Uncal Yellow" 10 "Uncal Red" 11 "Replace" 12 "Disabled" 13 "Shorted" 14 "Open" 15 "Over Range" 16 "Under Range" 17 "Undefined" 18 "Error!" 19 "Low Error" 20 "High Error" 21 "Non Critical No LED" 27 "Critical Green LED" 32 "Stall!" 33 "Synchronized" 34 "Syncing" 35 "Error!" 36 "Error!" 37 "Uncalibrated" 38 "Open Loop" 39 "Closed Loop" 40 "Not Learn" 41 "Learning" 42 "Off" 43 "On" 44 "Not Rev Limiting" 45 "Rev Limit" 46 "No Cut Off" 47 "CutOff!" 48 "Off" 49 "Warning!" 50 "Caution!" 51 "No Timing modifier" 52 "Timing is being modified" 53 "Timing Value is being replaced" 54 "Acq Sat" 55 "No GPS" 56 "No Data" 22 "Non Critical Green LED" 23 "Non Critical Yellow LED" 24 "Non Critical Red LED" 25 "Non Critical Blue LED" 26 "Non Critical Grey LED" 28 "Critical Yellow LED" 29 "Critical Red LED" 30 "Critical Blue LED" 31 "Critical Grey LED";
VAL_ 2651967488 Status 0 "OK" 1 "Disabled" 2 "Initializing" 3 "Heating" 4 "WB_Active" 5 "Too Cold" 6 "Too Hot" 7 "Unplugged" 8 "Slow!" 9 "Uncal Yellow" 10 "Uncal Red" 11 "Replace" 12 "Disabled" 13 "Shorted" 14 "Open" 15 "Over Range" 16 "Under Range" 17 "Undefined" 18 "Error!" 19 "Low Error" 20 "High Error" 21 "Non Critical No LED" 27 "Critical Green LED" 32 "Stall!" 33 "Synchronized" 34 "Syncing" 35 "Error!" 36 "Error!" 37 "Uncalibrated" 38 "Open Loop" 39 "Closed Loop" 40 "Not Learn" 41 "Learning" 42 "Off" 43 "On" 44 "Not Rev Limiting" 45 "Rev Limit" 46 "No Cut Off" 47 "CutOff!" 48 "Off" 49 "Warning!" 50 "Caution!" 51 "No Timing modifier" 52 "Timing is being modified" 53 "Timing Value is being replaced" 54 "Acq Sat" 55 "No GPS" 56 "No Data" 22 "Non Critical Green LED" 23 "Non Critical Yellow LED" 24 "Non Critical Red LED" 25 "Non Critical Blue LED" 26 "Non Critical Grey LED" 28 "Critical Yellow LED" 29 "Critical Red LED" 30 "Critical Blue LED" 31 "Critical Grey LED";
VAL_ 2651983872 Status 0 "OK" 1 "Disabled" 2 "Initializing" 3 "Heating" 4 "WB_Active" 5 "Too Cold" 6 "Too Hot" 7 "Unplugged" 8 "Slow!" 9 "Uncal Yellow" 10 "Uncal Red" 11 "Replace" 12 "Disabled" 13 "Shorted" 14 "Open" 15 "Over Range" 16 "Under Range" 17 "Undefined" 18 "Error!" 19 "Low Error" 20 "High Error" 21 "Non Critical No LED" 27 "Critical Green LED" 32 "Stall!" 33 "Synchronized" 34 "Syncing" 35 "Error!" 36 "Error!" 37 "Uncalibrated" 38 "Open Loop" 39 "Closed Loop" 40 "Not Learn" 41 "Learning" 42 "Off" 43 "On" 44 "Not Rev Limiting" 45 "Rev Limit" 46 "No Cut Off" 47 "CutOff!" 48 "Off" 49 "Warning!" 50 "Caution!" 51 "No Timing modifier" 52 "Timing is being modified" 53 "Timing Value is being replaced" 54 "Acq Sat" 55 "No GPS" 56 "No Data" 22 "Non Critical Green LED" 23 "Non Critical Yellow LED" 24 "Non Critical Red LED" 25 "Non Critical Blue LED" 26 "Non Critical Grey LED" 28 "Critical Yellow LED" 29 "Critical Red LED" 30 "Critical Blue LED" 31 "Critical Grey LED";
VAL_ 2652000256 Status 0 "OK" 1 "Disabled" 2 "Initializing" 3 "Heating" 4 "WB_Active" 5 "Too Cold" 6 "Too Hot" 7 "Unplugged" 8 "Slow!" 9 "Uncal Yellow" 10 "Uncal Red" 11 "Replace" 12 "Disabled" 13 "Shorted" 14 "Open" 15 "Over Range" 16 "Under Range" 17 "Undefined" 18 "Error!" 19 "Low Error" 20 "High Error" 21 "Non Critical No LED" 27 "Critical Green LED" 32 "Stall!" 33 "Synchronized" 34 "Syncing" 35 "Error!" 36 "Error!" 37 "Uncalibrated" 38 "Open Loop" 39 "Closed Loop" 40 "Not Learn" 41 "Learning" 42 "Off" 43 "On" 44 "Not Rev Limiting" 45 "Rev Limit" 46 "No Cut Off" 47 "CutOff!" 48 "Off" 49 "Warning!" 50 "Caution!" 51 "No Timing modifier" 52 "Timing is being modified" 53 "Timing Value is being replaced" 54 "Acq Sat" 55 "No GPS" 56 "No Data" 22 "Non Critical Green LED" 23 "Non Critical Yellow LED" 24 "Non Critical Red LED" 25 "Non Critical Blue LED" 26 "Non Critical Grey LED" 28 "Critical Yellow LED" 29 "Critical Red LED" 30 "Critical Blue LED" 31 "Critical Grey LED";
VAL_ 2652016640 Status 0 "OK" 1 "Disabled" 2 "Initializing" 3 "Heating" 4 "WB_Active" 5 "Too Cold" 6 "Too Hot" 7 "Unplugged" 8 "Slow!" 9 "Uncal Yellow" 10 "Uncal Red" 11 "Replace" 12 "Disabled" 13 "Shorted" 14 "Open" 15 "Over Range" 16 "Under Range" 17 "Undefined" 18 "Error!" 19 "Low Error" 20 "High Error" 21 "Non Critical No LED" 27 "Critical Green LED" 32 "Stall!" 33 "Synchronized" 34 "Syncing" 35 "Error!" 36 "Error!" 37 "Uncalibrated" 38 "Open Loop" 39 "Closed Loop" 40 "Not Learn" 41 "Learning" 42 "Off" 43 "On" 44 "Not Rev Limiting" 45 "Rev Limit" 46 "No Cut Off" 47 "CutOff!" 48 "Off" 49 "Warning!" 50 "Caution!" 51 "No Timing modifier" 52 "Timing is being modified" 53 "Timing Value is being replaced" 54 "Acq Sat" 55 "No GPS" 56 "No Data" 22 "Non Critical Green LED" 23 "Non Critical Yellow LED" 24 "Non Critical Red LED" 25 "Non Critical Blue LED" 26 "Non Critical Grey LED" 28 "Critical Yellow LED" 29 "Critical Red LED" 30 "Critical Blue LED" 31 "Critical Grey LED";
VAL_ 2652033024 Status 0 "OK" 1 "Disabled" 2 "Initializing" 3 "Heating" 4 "WB_Active" 5 "Too Cold" 6 "Too Hot" 7 "Unplugged" 8 "Slow!" 9 "Uncal Yellow" 10 "Uncal Red" 11 "Replace" 12 "Disabled" 13 "Shorted" 14 "Open" 15 "Over Range" 16 "Under Range" 17 "Undefined" 18 "Error!" 19 "Low Error" 20 "High Error" 21 "Non Critical No LED" 27 "Critical Green LED" 32 "Stall!" 33 "Synchronized" 34 "Syncing" 35 "Error!" 36 "Error!" 37 "Uncalibrated" 38 "Open Loop" 39 "Closed Loop" 40 "Not Learn" 41 "Learning" 42 "Off" 43 "On" 44 "Not Rev Limiting" 45 "Rev Limit" 46 "No Cut Off" 47 "CutOff!" 48 "Off" 49 "Warning!" 50 "Caution!" 51 "No Timing modifier" 52 "Timing is being modified" 53 "Timing Value is being replaced" 54 "Acq Sat" 55 "No GPS" 56 "No Data" 22 "Non Critical Green LED" 23 "Non Critical Yellow LED" 24 "Non Critical Red LED" 25 "Non Critical Blue LED" 26 "Non Critical Grey LED" 28 "Critical Yellow LED" 29 "Critical Red LED" 30 "Critical Blue LED" 31 "Critical Grey LED";
VAL_ 2652049408 Status 0 "OK" 1 "Disabled" 2 "Initializing" 3 "Heating" 4 "WB_Active" 5 "Too Cold" 6 "Too Hot" 7 "Unplugged" 8 "Slow!" 9 "Uncal Yellow" 10 "Uncal Red" 11 "Replace" 12 "Disabled" 13 "Shorted" 14 "Open" 15 "Over Range" 16 "Under Range" 17 "Undefined" 18 "Error!" 19 "Low Error" 20 "High Error" 21 "Non Critical No LED" 27 "Critical Green LED" 32 "Stall!" 33 "Synchronized" 34 "Syncing" 35 "Error!" 36 "Error!" 37 "Uncalibrated" 38 "Open Loop" 39 "Closed Loop" 40 "Not Learn" 41 "Learning" 42 "Off" 43 "On" 44 "Not Rev Limiting" 45 "Rev Limit" 46 "No Cut Off" 47 "CutOff!" 48 "Off" 49 "Warning!" 50 "Caution!" 51 "No Timing modifier" 52 "Timing is being modified" 53 "Timing Value is being replaced" 54 "Acq Sat" 55 "No GPS" 56 "No Data" 22 "Non Critical Green LED" 23 "Non Critical Yellow LED" 24 "Non Critical Red LED" 25 "Non Critical Blue LED" 26 "Non Critical Grey LED" 28 "Critical Yellow LED" 29 "Critical Red LED" 30 "Critical Blue LED" 31 "Critical Grey LED";
VAL_ 2652065792 Status 0 "OK" 1 "Disabled" 2 "Initializing" 3 "Heating" 4 "WB_Active" 5 "Too Cold" 6 "Too Hot" 7 "Unplugged" 8 "Slow!" 9 "Uncal Yellow" 10 "Uncal Red" 11 "Replace" 12 "Disabled" 13 "Shorted" 14 "Open" 15 "Over Range" 16 "Under Range" 17 "Undefined" 18 "Error!" 19 "Low Error" 20 "High Error" 21 "Non Critical No LED" 27 "Critical Green LED" 32 "Stall!" 33 "Synchronized" 34 "Syncing" 35 "Error!" 36 "Error!" 37 "Uncalibrated" 38 "Open Loop" 39 "Closed Loop" 40 "Not Learn" 41 "Learning" 42 "Off" 43 "On" 44 "Not Rev Limiting" 45 "Rev Limit" 46 "No Cut Off" 47 "CutOff!" 48 "Off" 49 "Warning!" 50 "Caution!" 51 "No Timing modifier" 52 "Timing is being modified" 53 "Timing Value is being replaced" 54 "Acq Sat" 55 "No GPS" 56 "No Data" 22 "Non Critical Green LED" 23 "Non Critical Yellow LED" 24 "Non Critical Red LED" 25 "Non Critical Blue LED" 26 "Non Critical Grey LED" 28 "Critical Yellow LED" 29 "Critical Red LED" 30 "Critical Blue LED" 31 "Critical Grey LED";
VAL_ 2652082176 Status 0 "OK" 1 "Disabled" 2 "Initializing" 3 "Heating" 4 "WB_Active" 5 "Too Cold" 6 "Too Hot" 7 "Unplugged" 8 "Slow!" 9 "Uncal Yellow" 10 "Uncal Red" 11 "Replace" 12 "Disabled" 13 "Shorted" 14 "Open" 15 "Over Range" 16 "Under Range" 17 "Undefined" 18 "Error!" 19 "Low Error" 20 "High Error" 21 "Non Critical No LED" 27 "Critical Green LED" 32 "Stall!" 33 "Synchronized" 34 "Syncing" 35 "Error!" 36 "Error!" 37 "Uncalibrated" 38 "Open Loop" 39 "Closed Loop" 40 "Not Learn" 41 "Learning" 42 "Off" 43 "On" 44 "Not Rev Limiting" 45 "Rev Limit" 46 "No Cut Off" 47 "CutOff!" 48 "Off" 49 "Warning!" 50 "Caution!" 51 "No Timing modifier" 52 "Timing is being modified" 53 "Timing Value is being replaced" 54 "Acq Sat" 55 "No GPS" 56 "No Data" 22 "Non Critical Green LED" 23 "Non Critical Yellow LED" 24 "Non Critical Red LED" 25 "Non Critical Blue LED" 26 "Non Critical Grey LED" 28 "Critical Yellow LED" 29 "Critical Red LED" 30 "Critical Blue LED" 31 "Critical Grey LED";
VAL_ 2652098560 Status 0 "OK" 1 "Disabled" 2 "Initializing" 3 "Heating" 4 "WB_Active" 5 "Too Cold" 6 "Too Hot" 7 "Unplugged" 8 "Slow!" 9 "Uncal Yellow" 10 "Uncal Red" 11 "Replace" 12 "Disabled" 13 "Shorted" 14 "Open" 15 "Over Range" 16 "Under Range" 17 "Undefined" 18 "Error!" 19 "Low Error" 20 "High Error" 21 "Non Critical No LED" 27 "Critical Green LED" 32 "Stall!" 33 "Synchronized" 34 "Syncing" 35 "Error!" 36 "Error!" 37 "Uncalibrated" 38 "Open Loop" 39 "Closed Loop" 40 "Not Learn" 41 "Learning" 42 "Off" 43 "On" 44 "Not Rev Limiting" 45 "Rev Limit" 46 "No Cut Off" 47 "CutOff!" 48 "Off" 49 "Warning!" 50 "Caution!" 51 "No Timing modifier" 52 "Timing is being modified" 53 "Timing Value is being replaced" 54 "Acq Sat" 55 "No GPS" 56 "No Data" 22 "Non Critical Green LED" 23 "Non Critical Yellow LED" 24 "Non Critical Red LED" 25 "Non Critical Blue LED" 26 "Non Critical Grey LED" 28 "Critical Yellow LED" 29 "Critical Red LED" 30 "Critical Blue LED" 31 "Critical Grey LED";
VAL_ 2652114944 Status 0 "OK" 1 "Disabled" 2 "Initializing" 3 "Heating" 4 "WB_Active" 5 "Too Cold" 6 "Too Hot" 7 "Unplugged" 8 "Slow!" 9 "Uncal Yellow" 10 "Uncal Red" 11 "Replace" 12 "Disabled" 13 "Shorted" 14 "Open" 15 "Over Range" 16 "Under Range" 17 "Undefined" 18 "Error!" 19 "Low Error" 20 "High Error" 21 "Non Critical No LED" 27 "Critical Green LED" 32 "Stall!" 33 "Synchronized" 34 "Syncing" 35 "Error!" 36 "Error!" 37 "Uncalibrated" 38 "Open Loop" 39 "Closed Loop" 40 "Not Learn" 41 "Learning" 42 "Off" 43 "On" 44 "Not Rev Limiting" 45 "Rev Limit" 46 "No Cut Off" 47 "CutOff!" 48 "Off" 49 "Warning!" 50 "Caution!" 51 "No Timing modifier" 52 "Timing is being modified" 53 "Timing Value is being replaced" 54 "Acq Sat" 55 "No GPS" 56 "No Data" 22 "Non Critical Green LED" 23 "Non Critical Yellow LED" 24 "Non Critical Red LED" 25 "Non Critical Blue LED" 26 "Non Critical Grey LED" 28 "Critical Yellow LED" 29 "Critical Red LED" 30 "Critical Blue LED" 31 "Critical Grey LED";
VAL_ 2652131328 Status 0 "OK" 1 "Disabled" 2 "Initializing" 3 "Heating" 4 "WB_Active" 5 "Too Cold" 6 "Too Hot" 7 "Unplugged" 8 "Slow!" 9 "Uncal Yellow" 10 "Uncal Red" 11 "Replace" 12 "Disabled" 13 "Shorted" 14 "Open" 15 "Over Range" 16 "Under Range" 17 "Undefined" 18 "Error!" 19 "Low Error" 20 "High Error" 21 "Non Critical No LED" 27 "Critical Green LED" 32 "Stall!" 33 "Synchronized" 34 "Syncing" 35 "Error!" 36 "Error!" 37 "Uncalibrated" 38 "Open Loop" 39 "Closed Loop" 40 "Not Learn" 41 "Learning" 42 "Off" 43 "On" 44 "Not Rev Limiting" 45 "Rev Limit" 46 "No Cut Off" 47 "CutOff!" 48 "Off" 49 "Warning!" 50 "Caution!" 51 "No Timing modifier" 52 "Timing is being modified" 53 "Timing Value is being replaced" 54 "Acq Sat" 55 "No GPS" 56 "No Data" 22 "Non Critical Green LED" 23 "Non Critical Yellow LED" 24 "Non Critical Red LED" 25 "Non Critical Blue LED" 26 "Non Critical Grey LED" 28 "Critical Yellow LED" 29 "Critical Red LED" 30 "Critical Blue LED" 31 "Critical Grey LED";
VAL_ 2652147712 Status 0 "OK" 1 "Disabled" 2 "Initializing" 3 "Heating" 4 "WB_Active" 5 "Too Cold" 6 "Too Hot" 7 "Unplugged" 8 "Slow!" 9 "Uncal Yellow" 10 "Uncal Red" 11 "Replace" 12 "Disabled" 13 "Shorted" 14 "Open" 15 "Over Range" 16 "Under Range" 17 "Undefined" 18 "Error!" 19 "Low Error" 20 "High Error" 21 "Non Critical No LED" 27 "Critical Green LED" 32 "Stall!" 33 "Synchronized" 34 "Syncing" 35 "Error!" 36 "Error!" 37 "Uncalibrated" 38 "Open Loop" 39 "Closed Loop" 40 "Not Learn" 41 "Learning" 42 "Off" 43 "On" 44 "Not Rev Limiting" 45 "Rev Limit" 46 "No Cut Off" 47 "CutOff!" 48 "Off" 49 "Warning!" 50 "Caution!" 51 "No Timing modifier" 52 "Timing is being modified" 53 "Timing Value is being replaced" 54 "Acq Sat" 55 "No GPS" 56 "No Data" 22 "Non Critical Green LED" 23 "Non Critical Yellow LED" 24 "Non Critical Red LED" 25 "Non Critical Blue LED" 26 "Non Critical Grey LED" 28 "Critical Yellow LED" 29 "Critical Red LED" 30 "Critical Blue LED" 31 "Critical Grey LED";
VAL_ 2652164096 Status 0 "OK" 1 "Disabled" 2 "Initializing" 3 "Heating" 4 "WB_Active" 5 "Too Cold" 6 "Too Hot" 7 "Unplugged" 8 "Slow!" 9 "Uncal Yellow" 10 "Uncal Red" 11 "Replace" 12 "Disabled" 13 "Shorted" 14 "Open" 15 "Over Range" 16 "Under Range" 17 "Undefined" 18 "Error!" 19 "Low Error" 20 "High Error" 21 "Non Critical No LED" 27 "Critical Green LED" 32 "Stall!" 33 "Synchronized" 34 "Syncing" 35 "Error!" 36 "Error!" 37 "Uncalibrated" 38 "Open Loop" 39 "Closed Loop" 40 "Not Learn" 41 "Learning" 42 "Off" 43 "On" 44 "Not Rev Limiting" 45 "Rev Limit" 46 "No Cut Off" 47 "CutOff!" 48 "Off" 49 "Warning!" 50 "Caution!" 51 "No Timing modifier" 52 "Timing is being modified" 53 "Timing Value is being replaced" 54 "Acq Sat" 55 "No GPS" 56 "No Data" 22 "Non Critical Green LED" 23 "Non Critical Yellow LED" 24 "Non Critical Red LED" 25 "Non Critical Blue LED" 26 "Non Critical Grey LED" 28 "Critical Yellow LED" 29 "Critical Red LED" 30 "Critical Blue LED" 31 "Critical Grey LED";
VAL_ 2652180480 Status 0 "OK" 1 "Disabled" 2 "Initializing" 3 "Heating" 4 "WB_Active" 5 "Too Cold" 6 "Too Hot" 7 "Unplugged" 8 "Slow!" 9 "Uncal Yellow" 10 "Uncal Red" 11 "Replace" 12 "Disabled" 13 "Shorted" 14 "Open" 15 "Over Range" 16 "Under Range" 17 "Undefined" 18 "Error!" 19 "Low Error" 20 "High Error" 21 "Non Critical No LED" 27 "Critical Green LED" 32 "Stall!" 33 "Synchronized" 34 "Syncing" 35 "Error!" 36 "Error!" 37 "Uncalibrated" 38 "Open Loop" 39 "Closed Loop" 40 "Not Learn" 41 "Learning" 42 "Off" 43 "On" 44 "Not Rev Limiting" 45 "Rev Limit" 46 "No Cut Off" 47 "CutOff!" 48 "Off" 49 "Warning!" 50 "Caution!" 51 "No Timing modifier" 52 "Timing is being modified" 53 "Timing Value is being replaced" 54 "Acq Sat" 55 "No GPS" 56 "No Data" 22 "Non Critical Green LED" 23 "Non Critical Yellow LED" 24 "Non Critical Red LED" 25 "Non Critical Blue LED" 26 "Non Critical Grey LED" 28 "Critical Yellow LED" 29 "Critical Red LED" 30 "Critical Blue LED" 31 "Critical Grey LED";
VAL_ 2652196864 Status 0 "OK" 1 "Disabled" 2 "Initializing" 3 "Heating" 4 "WB_Active" 5 "Too Cold" 6 "Too Hot" 7 "Unplugged" 8 "Slow!" 9 "Uncal Yellow" 10 "Uncal Red" 11 "Replace" 12 "Disabled" 13 "Shorted" 14 "Open" 15 "Over Range" 16 "Under Range" 17 "Undefined" 18 "Error!" 19 "Low Error" 20 "High Error" 21 "Non Critical No LED" 27 "Critical Green LED" 32 "Stall!" 33 "Synchronized" 34 "Syncing" 35 "Error!" 36 "Error!" 37 "Uncalibrated" 38 "Open Loop" 39 "Closed Loop" 40 "Not Learn" 41 "Learning" 42 "Off" 43 "On" 44 "Not Rev Limiting" 45 "Rev Limit" 46 "No Cut Off" 47 "CutOff!" 48 "Off" 49 "Warning!" 50 "Caution!" 51 "No Timing modifier" 52 "Timing is being modified" 53 "Timing Value is being replaced" 54 "Acq Sat" 55 "No GPS" 56 "No Data" 22 "Non Critical Green LED" 23 "Non Critical Yellow LED" 24 "Non Critical Red LED" 25 "Non Critical Blue LED" 26 "Non Critical Grey LED" 28 "Critical Yellow LED" 29 "Critical Red LED" 30 "Critical Blue LED" 31 "Critical Grey LED";
VAL_ 2652213248 Status 0 "OK" 1 "Disabled" 2 "Initializing" 3 "Heating" 4 "WB_Active" 5 "Too Cold" 6 "Too Hot" 7 "Unplugged" 8 "Slow!" 9 "Uncal Yellow" 10 "Uncal Red" 11 "Replace" 12 "Disabled" 13 "Shorted" 14 "Open" 15 "Over Range" 16 "Under Range" 17 "Undefined" 18 "Error!" 19 "Low Error" 20 "High Error" 21 "Non Critical No LED" 27 "Critical Green LED" 32 "Stall!" 33 "Synchronized" 34 "Syncing" 35 "Error!" 36 "Error!" 37 "Uncalibrated" 38 "Open Loop" 39 "Closed Loop" 40 "Not Learn" 41 "Learning" 42 "Off" 43 "On" 44 "Not Rev Limiting" 45 "Rev Limit" 46 "No Cut Off" 47 "CutOff!" 48 "Off" 49 "Warning!" 50 "Caution!" 51 "No Timing modifier" 52 "Timing is being modified" 53 "Timing Value is being replaced" 54 "Acq Sat" 55 "No GPS" 56 "No Data" 22 "Non Critical Green LED" 23 "Non Critical Yellow LED" 24 "Non Critical Red LED" 25 "Non Critical Blue LED" 26 "Non Critical Grey LED" 28 "Critical Yellow LED" 29 "Critical Red LED" 30 "Critical Blue LED" 31 "Critical Grey LED";
VAL_ 2652229632 Status 0 "OK" 1 "Disabled" 2 "Initializing" 3 "Heating" 4 "WB_Active" 5 "Too Cold" 6 "Too Hot" 7 "Unplugged" 8 "Slow!" 9 "Uncal Yellow" 10 "Uncal Red" 11 "Replace" 12 "Disabled" 13 "Shorted" 14 "Open" 15 "Over Range" 16 "Under Range" 17 "Undefined" 18 "Error!" 19 "Low Error" 20 "High Error" 21 "Non Critical No LED" 27 "Critical Green LED" 32 "Stall!" 33 "Synchronized" 34 "Syncing" 35 "Error!" 36 "Error!" 37 "Uncalibrated" 38 "Open Loop" 39 "Closed Loop" 40 "Not Learn" 41 "Learning" 42 "Off" 43 "On" 44 "Not Rev Limiting" 45 "Rev Limit" 46 "No Cut Off" 47 "CutOff!" 48 "Off" 49 "Warning!" 50 "Caution!" 51 "No Timing modifier" 52 "Timing is being modified" 53 "Timing Value is being replaced" 54 "Acq Sat" 55 "No GPS" 56 "No Data" 22 "Non Critical Green LED" 23 "Non Critical Yellow LED" 24 "Non Critical Red LED" 25 "Non Critical Blue LED" 26 "Non Critical Grey LED" 28 "Critical Yellow LED" 29 "Critical Red LED" 30 "Critical Blue LED" 31 "Critical Grey LED";
VAL_ 2652246016 Status 0 "OK" 1 "Disabled" 2 "Initializing" 3 "Heating" 4 "WB_Active" 5 "Too Cold" 6 "Too Hot" 7 "Unplugged" 8 "Slow!" 9 "Uncal Yellow" 10 "Uncal Red" 11 "Replace" 12 "Disabled" 13 "Shorted" 14 "Open" 15 "Over Range" 16 "Under Range" 17 "Undefined" 18 "Error!" 19 "Low Error" 20 "High Error" 21 "Non Critical No LED" 27 "Critical Green LED" 32 "Stall!" 33 "Synchronized" 34 "Syncing" 35 "Error!" 36 "Error!" 37 "Uncalibrated" 38 "Open Loop" 39 "Closed Loop" 40 "Not Learn" 41 "Learning" 42 "Off" 43 "On" 44 "Not Rev Limiting" 45 "Rev Limit" 46 "No Cut Off" 47 "CutOff!" 48 "Off" 49 "Warning!" 50 "Caution!" 51 "No Timing modifier" 52 "Timing is being modified" 53 "Timing Value is being replaced" 54 "Acq Sat" 55 "No GPS" 56 "No Data" 22 "Non Critical Green LED" 23 "Non Critical Yellow LED" 24 "Non Critical Red LED" 25 "Non Critical Blue LED" 26 "Non Critical Grey LED" 28 "Critical Yellow LED" 29 "Critical Red LED" 30 "Critical Blue LED" 31 "Critical Grey LED";
VAL_ 2652262400 Status 0 "OK" 1 "Disabled" 2 "Initializing" 3 "Heating" 4 "WB_Active" 5 "Too Cold" 6 "Too Hot" 7 "Unplugged" 8 "Slow!" 9 "Uncal Yellow" 10 "Uncal Red" 11 "Replace" 12 "Disabled" 13 "Shorted" 14 "Open" 15 "Over Range" 16 "Under Range" 17 "Undefined" 18 "Error!" 19 "Low Error" 20 "High Error" 21 "Non Critical No LED" 27 "Critical Green LED" 32 "Stall!" 33 "Synchronized" 34 "Syncing" 35 "Error!" 36 "Error!" 37 "Uncalibrated" 38 "Open Loop" 39 "Closed Loop" 40 "Not Learn" 41 "Learning" 42 "Off" 43 "On" 44 "Not Rev Limiting" 45 "Rev Limit" 46 "No Cut Off" 47 "CutOff!" 48 "Off" 49 "Warning!" 50 "Caution!" 51 "No Timing modifier" 52 "Timing is being modified" 53 "Timing Value is being replaced" 54 "Acq Sat" 55 "No GPS" 56 "No Data" 22 "Non Critical Green LED" 23 "Non Critical Yellow LED" 24 "Non Critical Red LED" 25 "Non Critical Blue LED" 26 "Non Critical Grey LED" 28 "Critical Yellow LED" 29 "Critical Red LED" 30 "Critical Blue LED" 31 "Critical Grey LED";
VAL_ 2652278784 Status 0 "OK" 1 "Disabled" 2 "Initializing" 3 "Heating" 4 "WB_Active" 5 "Too Cold" 6 "Too Hot" 7 "Unplugged" 8 "Slow!" 9 "Uncal Yellow" 10 "Uncal Red" 11 "Replace" 12 "Disabled" 13 "Shorted" 14 "Open" 15 "Over Range" 16 "Under Range" 17 "Undefined" 18 "Error!" 19 "Low Error" 20 "High Error" 21 "Non Critical No LED" 27 "Critical Green LED" 32 "Stall!" 33 "Synchronized" 34 "Syncing" 35 "Error!" 36 "Error!" 37 "Uncalibrated" 38 "Open Loop" 39 "Closed Loop" 40 "Not Learn" 41 "Learning" 42 "Off" 43 "On" 44 "Not Rev Limiting" 45 "Rev Limit" 46 "No Cut Off" 47 "CutOff!" 48 "Off" 49 "Warning!" 50 "Caution!" 51 "No Timing modifier" 52 "Timing is being modified" 53 "Timing Value is being replaced" 54 "Acq Sat" 55 "No GPS" 56 "No Data" 22 "Non Critical Green LED" 23 "Non Critical Yellow LED" 24 "Non Critical Red LED" 25 "Non Critical Blue LED" 26 "Non Critical Grey LED" 28 "Critical Yellow LED" 29 "Critical Red LED" 30 "Critical Blue LED" 31 "Critical Grey LED";
VAL_ 2652295168 Status 0 "OK" 1 "Disabled" 2 "Initializing" 3 "Heating" 4 "WB_Active" 5 "Too Cold" 6 "Too Hot" 7 "Unplugged" 8 "Slow!" 9 "Uncal Yellow" 10 "Uncal Red" 11 "Replace" 12 "Disabled" 13 "Shorted" 14 "Open" 15 "Over Range" 16 "Under Range" 17 "Undefined" 18 "Error!" 19 "Low Error" 20 "High Error" 21 "Non Critical No LED" 27 "Critical Green LED" 32 "Stall!" 33 "Synchronized" 34 "Syncing" 35 "Error!" 36 "Error!" 37 "Uncalibrated" 38 "Open Loop" 39 "Closed Loop" 40 "Not Learn" 41 "Learning" 42 "Off" 43 "On" 44 "Not Rev Limiting" 45 "Rev Limit" 46 "No Cut Off" 47 "CutOff!" 48 "Off" 49 "Warning!" 50 "Caution!" 51 "No Timing modifier" 52 "Timing is being modified" 53 "Timing Value is being replaced" 54 "Acq Sat" 55 "No GPS" 56 "No Data" 22 "Non Critical Green LED" 23 "Non Critical Yellow LED" 24 "Non Critical Red LED" 25 "Non Critical Blue LED" 26 "Non Critical Grey LED" 28 "Critical Yellow LED" 29 "Critical Red LED" 30 "Critical Blue LED" 31 "Critical Grey LED";
VAL_ 2652311552 Status 0 "OK" 1 "Disabled" 2 "Initializing" 3 "Heating" 4 "WB_Active" 5 "Too Cold" 6 "Too Hot" 7 "Unplugged" 8 "Slow!" 9 "Uncal Yellow" 10 "Uncal Red" 11 "Replace" 12 "Disabled" 13 "Shorted" 14 "Open" 15 "Over Range" 16 "Under Range" 17 "Undefined" 18 "Error!" 19 "Low Error" 20 "High Error" 21 "Non Critical No LED" 27 "Critical Green LED" 32 "Stall!" 33 "Synchronized" 34 "Syncing" 35 "Error!" 36 "Error!" 37 "Uncalibrated" 38 "Open Loop" 39 "Closed Loop" 40 "Not Learn" 41 "Learning" 42 "Off" 43 "On" 44 "Not Rev Limiting" 45 "Rev Limit" 46 "No Cut Off" 47 "CutOff!" 48 "Off" 49 "Warning!" 50 "Caution!" 51 "No Timing modifier" 52 "Timing is being modified" 53 "Timing Value is being replaced" 54 "Acq Sat" 55 "No GPS" 56 "No Data" 22 "Non Critical Green LED" 23 "Non Critical Yellow LED" 24 "Non Critical Red LED" 25 "Non Critical Blue LED" 26 "Non Critical Grey LED" 28 "Critical Yellow LED" 29 "Critical Red LED" 30 "Critical Blue LED" 31 "Critical Grey LED";
VAL_ 2652327936 Status 0 "OK" 1 "Disabled" 2 "Initializing" 3 "Heating" 4 "WB_Active" 5 "Too Cold" 6 "Too Hot" 7 "Unplugged" 8 "Slow!" 9 "Uncal Yellow" 10 "Uncal Red" 11 "Replace" 12 "Disabled" 13 "Shorted" 14 "Open" 15 "Over Range" 16 "Under Range" 17 "Undefined" 18 "Error!" 19 "Low Error" 20 "High Error" 21 "Non Critical No LED" 27 "Critical Green LED" 32 "Stall!" 33 "Synchronized" 34 "Syncing" 35 "Error!" 36 "Error!" 37 "Uncalibrated" 38 "Open Loop" 39 "Closed Loop" 40 "Not Learn" 41 "Learning" 42 "Off" 43 "On" 44 "Not Rev Limiting" 45 "Rev Limit" 46 "No Cut Off" 47 "CutOff!" 48 "Off" 49 "Warning!" 50 "Caution!" 51 "No Timing modifier" 52 "Timing is being modified" 53 "Timing Value is being replaced" 54 "Acq Sat" 55 "No GPS" 56 "No Data" 22 "Non Critical Green LED" 23 "Non Critical Yellow LED" 24 "Non Critical Red LED" 25 "Non Critical Blue LED" 26 "Non Critical Grey LED" 28 "Critical Yellow LED" 29 "Critical Red LED" 30 "Critical Blue LED" 31 "Critical Grey LED";
VAL_ 2652344320 Status 0 "OK" 1 "Disabled" 2 "Initializing" 3 "Heating" 4 "WB_Active" 5 "Too Cold" 6 "Too Hot" 7 "Unplugged" 8 "Slow!" 9 "Uncal Yellow" 10 "Uncal Red" 11 "Replace" 12 "Disabled" 13 "Shorted" 14 "Open" 15 "Over Range" 16 "Under Range" 17 "Undefined" 18 "Error!" 19 "Low Error" 20 "High Error" 21 "Non Critical No LED" 27 "Critical Green LED" 32 "Stall!" 33 "Synchronized" 34 "Syncing" 35 "Error!" 36 "Error!" 37 "Uncalibrated" 38 "Open Loop" 39 "Closed Loop" 40 "Not Learn" 41 "Learning" 42 "Off" 43 "On" 44 "Not Rev Limiting" 45 "Rev Limit" 46 "No Cut Off" 47 "CutOff!" 48 "Off" 49 "Warning!" 50 "Caution!" 51 "No Timing modifier" 52 "Timing is being modified" 53 "Timing Value is being replaced" 54 "Acq Sat" 55 "No GPS" 56 "No Data" 22 "Non Critical Green LED" 23 "Non Critical Yellow LED" 24 "Non Critical Red LED" 25 "Non Critical Blue LED" 26 "Non Critical Grey LED" 28 "Critical Yellow LED" 29 "Critical Red LED" 30 "Critical Blue LED" 31 "Critical Grey LED";
VAL_ 2652360704 Status 0 "OK" 1 "Disabled" 2 "Initializing" 3 "Heating" 4 "WB_Active" 5 "Too Cold" 6 "Too Hot" 7 "Unplugged" 8 "Slow!" 9 "Uncal Yellow" 10 "Uncal Red" 11 "Replace" 12 "Disabled" 13 "Shorted" 14 "Open" 15 "Over Range" 16 "Under Range" 17 "Undefined" 18 "Error!" 19 "Low Error" 20 "High Error" 21 "Non Critical No LED" 27 "Critical Green LED" 32 "Stall!" 33 "Synchronized" 34 "Syncing" 35 "Error!" 36 "Error!" 37 "Uncalibrated" 38 "Open Loop" 39 "Closed Loop" 40 "Not Learn" 41 "Learning" 42 "Off" 43 "On" 44 "Not Rev Limiting" 45 "Rev Limit" 46 "No Cut Off" 47 "CutOff!" 48 "Off" 49 "Warning!" 50 "Caution!" 51 "No Timing modifier" 52 "Timing is being modified" 53 "Timing Value is being replaced" 54 "Acq Sat" 55 "No GPS" 56 "No Data" 22 "Non Critical Green LED" 23 "Non Critical Yellow LED" 24 "Non Critical Red LED" 25 "Non Critical Blue LED" 26 "Non Critical Grey LED" 28 "Critical Yellow LED" 29 "Critical Red LED" 30 "Critical Blue LED" 31 "Critical Grey LED";
VAL_ 2652377088 Status 0 "OK" 1 "Disabled" 2 "Initializing" 3 "Heating" 4 "WB_Active" 5 "Too Cold" 6 "Too Hot" 7 "Unplugged" 8 "Slow!" 9 "Uncal Yellow" 10 "Uncal Red" 11 "Replace" 12 "Disabled" 13 "Shorted" 14 "Open" 15 "Over Range" 16 "Under Range" 17 "Undefined" 18 "Error!" 19 "Low Error" 20 "High Error" 21 "Non Critical No LED" 27 "Critical Green LED" 32 "Stall!" 33 "Synchronized" 34 "Syncing" 35 "Error!" 36 "Error!" 37 "Uncalibrated" 38 "Open Loop" 39 "Closed Loop" 40 "Not Learn" 41 "Learning" 42 "Off" 43 "On" 44 "Not Rev Limiting" 45 "Rev Limit" 46 "No Cut Off" 47 "CutOff!" 48 "Off" 49 "Warning!" 50 "Caution!" 51 "No Timing modifier" 52 "Timing is being modified" 53 "Timing Value is being replaced" 54 "Acq Sat" 55 "No GPS" 56 "No Data" 22 "Non Critical Green LED" 23 "Non Critical Yellow LED" 24 "Non Critical Red LED" 25 "Non Critical Blue LED" 26 "Non Critical Grey LED" 28 "Critical Yellow LED" 29 "Critical Red LED" 30 "Critical Blue LED" 31 "Critical Grey LED";
VAL_ 2652393472 Status 0 "OK" 1 "Disabled" 2 "Initializing" 3 "Heating" 4 "WB_Active" 5 "Too Cold" 6 "Too Hot" 7 "Unplugged" 8 "Slow!" 9 "Uncal Yellow" 10 "Uncal Red" 11 "Replace" 12 "Disabled" 13 "Shorted" 14 "Open" 15 "Over Range" 16 "Under Range" 17 "Undefined" 18 "Error!" 19 "Low Error" 20 "High Error" 21 "Non Critical No LED" 27 "Critical Green LED" 32 "Stall!" 33 "Synchronized" 34 "Syncing" 35 "Error!" 36 "Error!" 37 "Uncalibrated" 38 "Open Loop" 39 "Closed Loop" 40 "Not Learn" 41 "Learning" 42 "Off" 43 "On" 44 "Not Rev Limiting" 45 "Rev Limit" 46 "No Cut Off" 47 "CutOff!" 48 "Off" 49 "Warning!" 50 "Caution!" 51 "No Timing modifier" 52 "Timing is being modified" 53 "Timing Value is being replaced" 54 "Acq Sat" 55 "No GPS" 56 "No Data" 22 "Non Critical Green LED" 23 "Non Critical Yellow LED" 24 "Non Critical Red LED" 25 "Non Critical Blue LED" 26 "Non Critical Grey LED" 28 "Critical Yellow LED" 29 "Critical Red LED" 30 "Critical Blue LED" 31 "Critical Grey LED";
VAL_ 2652409856 Status 0 "OK" 1 "Disabled" 2 "Initializing" 3 "Heating" 4 "WB_Active" 5 "Too Cold" 6 "Too Hot" 7 "Unplugged" 8 "Slow!" 9 "Uncal Yellow" 10 "Uncal Red" 11 "Replace" 12 "Disabled" 13 "Shorted" 14 "Open" 15 "Over Range" 16 "Under Range" 17 "Undefined" 18 "Error!" 19 "Low Error" 20 "High Error" 21 "Non Critical No LED" 27 "Critical Green LED" 32 "Stall!" 33 "Synchronized" 34 "Syncing" 35 "Error!" 36 "Error!" 37 "Uncalibrated" 38 "Open Loop" 39 "Closed Loop" 40 "Not Learn" 41 "Learning" 42 "Off" 43 "On" 44 "Not Rev Limiting" 45 "Rev Limit" 46 "No Cut Off" 47 "CutOff!" 48 "Off" 49 "Warning!" 50 "Caution!" 51 "No Timing modifier" 52 "Timing is being modified" 53 "Timing Value is being replaced" 54 "Acq Sat" 55 "No GPS" 56 "No Data" 22 "Non Critical Green LED" 23 "Non Critical Yellow LED" 24 "Non Critical Red LED" 25 "Non Critical Blue LED" 26 "Non Critical Grey LED" 28 "Critical Yellow LED" 29 "Critical Red LED" 30 "Critical Blue LED" 31 "Critical Grey LED";
VAL_ 2652426240 Status 0 "OK" 1 "Disabled" 2 "Initializing" 3 "Heating" 4 "WB_Active" 5 "Too Cold" 6 "Too Hot" 7 "Unplugged" 8 "Slow!" 9 "Uncal Yellow" 10 "Uncal Red" 11 "Replace" 12 "Disabled" 13 "Shorted" 14 "Open" 15 "Over Range" 16 "Under Range" 17 "Undefined" 18 "Error!" 19 "Low Error" 20 "High Error" 21 "Non Critical No LED" 27 "Critical Green LED" 32 "Stall!" 33 "Synchronized" 34 "Syncing" 35 "Error!" 36 "Error!" 37 "Uncalibrated" 38 "Open Loop" 39 "Closed Loop" 40 "Not Learn" 41 "Learning" 42 "Off" 43 "On" 44 "Not Rev Limiting" 45 "Rev Limit" 46 "No Cut Off" 47 "CutOff!" 48 "Off" 49 "Warning!" 50 "Caution!" 51 "No Timing modifier" 52 "Timing is being modified" 53 "Timing Value is being replaced" 54 "Acq Sat" 55 "No GPS" 56 "No Data" 22 "Non Critical Green LED" 23 "Non Critical Yellow LED" 24 "Non Critical Red LED" 25 "Non Critical Blue LED" 26 "Non Critical Grey LED" 28 "Critical Yellow LED" 29 "Critical Red LED" 30 "Critical Blue LED" 31 "Critical Grey LED";
VAL_ 2652442624 Status 0 "OK" 1 "Disabled" 2 "Initializing" 3 "Heating" 4 "WB_Active" 5 "Too Cold" 6 "Too Hot" 7 "Unplugged" 8 "Slow!" 9 "Uncal Yellow" 10 "Uncal Red" 11 "Replace" 12 "Disabled" 13 "Shorted" 14 "Open" 15 "Over Range" 16 "Under Range" 17 "Undefined" 18 "Error!" 19 "Low Error" 20 "High Error" 21 "Non Critical No LED" 27 "Critical Green LED" 32 "Stall!" 33 "Synchronized" 34 "Syncing" 35 "Error!" 36 "Error!" 37 "Uncalibrated" 38 "Open Loop" 39 "Closed Loop" 40 "Not Learn" 41 "Learning" 42 "Off" 43 "On" 44 "Not Rev Limiting" 45 "Rev Limit" 46 "No Cut Off" 47 "CutOff!" 48 "Off" 49 "Warning!" 50 "Caution!" 51 "No Timing modifier" 52 "Timing is being modified" 53 "Timing Value is being replaced" 54 "Acq Sat" 55 "No GPS" 56 "No Data" 22 "Non Critical Green LED" 23 "Non Critical Yellow LED" 24 "Non Critical Red LED" 25 "Non Critical Blue LED" 26 "Non Critical Grey LED" 28 "Critical Yellow LED" 29 "Critical Red LED" 30 "Critical Blue LED" 31 "Critical Grey LED";
VAL_ 2652459008 Status 0 "OK" 1 "Disabled" 2 "Initializing" 3 "Heating" 4 "WB_Active" 5 "Too Cold" 6 "Too Hot" 7 "Unplugged" 8 "Slow!" 9 "Uncal Yellow" 10 "Uncal Red" 11 "Replace" 12 "Disabled" 13 "Shorted" 14 "Open" 15 "Over Range" 16 "Under Range" 17 "Undefined" 18 "Error!" 19 "Low Error" 20 "High Error" 21 "Non Critical No LED" 27 "Critical Green LED" 32 "Stall!" 33 "Synchronized" 34 "Syncing" 35 "Error!" 36 "Error!" 37 "Uncalibrated" 38 "Open Loop" 39 "Closed Loop" 40 "Not Learn" 41 "Learning" 42 "Off" 43 "On" 44 "Not Rev Limiting" 45 "Rev Limit" 46 "No Cut Off" 47 "CutOff!" 48 "Off" 49 "Warning!" 50 "Caution!" 51 "No Timing modifier" 52 "Timing is being modified" 53 "Timing Value is being replaced" 54 "Acq Sat" 55 "No GPS" 56 "No Data" 22 "Non Critical Green LED" 23 "Non Critical Yellow LED" 24 "Non Critical Red LED" 25 "Non Critical Blue LED" 26 "Non Critical Grey LED" 28 "Critical Yellow LED" 29 "Critical Red LED" 30 "Critical Blue LED" 31 "Critical Grey LED";
VAL_ 2652475392 Status 0 "OK" 1 "Disabled" 2 "Initializing" 3 "Heating" 4 "WB_Active" 5 "Too Cold" 6 "Too Hot" 7 "Unplugged" 8 "Slow!" 9 "Uncal Yellow" 10 "Uncal Red" 11 "Replace" 12 "Disabled" 13 "Shorted" 14 "Open" 15 "Over Range" 16 "Under Range" 17 "Undefined" 18 "Error!" 19 "Low Error" 20 "High Error" 21 "Non Critical No LED" 27 "Critical Green LED" 32 "Stall!" 33 "Synchronized" 34 "Syncing" 35 "Error!" 36 "Error!" 37 "Uncalibrated" 38 "Open Loop" 39 "Closed Loop" 40 "Not Learn" 41 "Learning" 42 "Off" 43 "On" 44 "Not Rev Limiting" 45 "Rev Limit" 46 "No Cut Off" 47 "CutOff!" 48 "Off" 49 "Warning!" 50 "Caution!" 51 "No Timing modifier" 52 "Timing is being modified" 53 "Timing Value is being replaced" 54 "Acq Sat" 55 "No GPS" 56 "No Data" 22 "Non Critical Green LED" 23 "Non Critical Yellow LED" 24 "Non Critical Red LED" 25 "Non Critical Blue LED" 26 "Non Critical Grey LED" 28 "Critical Yellow LED" 29 "Critical Red LED" 30 "Critical Blue LED" 31 "Critical Grey LED";
VAL_ 2652491776 Status 0 "OK" 1 "Disabled" 2 "Initializing" 3 "Heating" 4 "WB_Active" 5 "Too Cold" 6 "Too Hot" 7 "Unplugged" 8 "Slow!" 9 "Uncal Yellow" 10 "Uncal Red" 11 "Replace" 12 "Disabled" 13 "Shorted" 14 "Open" 15 "Over Range" 16 "Under Range" 17 "Undefined" 18 "Error!" 19 "Low Error" 20 "High Error" 21 "Non Critical No LED" 27 "Critical Green LED" 32 "Stall!" 33 "Synchronized" 34 "Syncing" 35 "Error!" 36 "Error!" 37 "Uncalibrated" 38 "Open Loop" 39 "Closed Loop" 40 "Not Learn" 41 "Learning" 42 "Off" 43 "On" 44 "Not Rev Limiting" 45 "Rev Limit" 46 "No Cut Off" 47 "CutOff!" 48 "Off" 49 "Warning!" 50 "Caution!" 51 "No Timing modifier" 52 "Timing is being modified" 53 "Timing Value is being replaced" 54 "Acq Sat" 55 "No GPS" 56 "No Data" 22 "Non Critical Green LED" 23 "Non Critical Yellow LED" 24 "Non Critical Red LED" 25 "Non Critical Blue LED" 26 "Non Critical Grey LED" 28 "Critical Yellow LED" 29 "Critical Red LED" 30 "Critical Blue LED" 31 "Critical Grey LED";
VAL_ 2652508160 Status 0 "OK" 1 "Disabled" 2 "Initializing" 3 "Heating" 4 "WB_Active" 5 "Too Cold" 6 "Too Hot" 7 "Unplugged" 8 "Slow!" 9 "Uncal Yellow" 10 "Uncal Red" 11 "Replace" 12 "Disabled" 13 "Shorted" 14 "Open" 15 "Over Range" 16 "Under Range" 17 "Undefined" 18 "Error!" 19 "Low Error" 20 "High Error" 21 "Non Critical No LED" 27 "Critical Green LED" 32 "Stall!" 33 "Synchronized" 34 "Syncing" 35 "Error!" 36 "Error!" 37 "Uncalibrated" 38 "Open Loop" 39 "Closed Loop" 40 "Not Learn" 41 "Learning" 42 "Off" 43 "On" 44 "Not Rev Limiting" 45 "Rev Limit" 46 "No Cut Off" 47 "CutOff!" 48 "Off" 49 "Warning!" 50 "Caution!" 51 "No Timing modifier" 52 "Timing is being modified" 53 "Timing Value is being replaced" 54 "Acq Sat" 55 "No GPS" 56 "No Data" 22 "Non Critical Green LED" 23 "Non Critical Yellow LED" 24 "Non Critical Red LED" 25 "Non Critical Blue LED" 26 "Non Critical Grey LED" 28 "Critical Yellow LED" 29 "Critical Red LED" 30 "Critical Blue LED" 31 "Critical Grey LED";
VAL_ 2652524544 Status 0 "OK" 1 "Disabled" 2 "Initializing" 3 "Heating" 4 "WB_Active" 5 "Too Cold" 6 "Too Hot" 7 "Unplugged" 8 "Slow!" 9 "Uncal Yellow" 10 "Uncal Red" 11 "Replace" 12 "Disabled" 13 "Shorted" 14 "Open" 15 "Over Range" 16 "Under Range" 17 "Undefined" 18 "Error!" 19 "Low Error" 20 "High Error" 21 "Non Critical No LED" 27 "Critical Green LED" 32 "Stall!" 33 "Synchronized" 34 "Syncing" 35 "Error!" 36 "Error!" 37 "Uncalibrated" 38 "Open Loop" 39 "Closed Loop" 40 "Not Learn" 41 "Learning" 42 "Off" 43 "On" 44 "Not Rev Limiting" 45 "Rev Limit" 46 "No Cut Off" 47 "CutOff!" 48 "Off" 49 "Warning!" 50 "Caution!" 51 "No Timing modifier" 52 "Timing is being modified" 53 "Timing Value is being replaced" 54 "Acq Sat" 55 "No GPS" 56 "No Data" 22 "Non Critical Green LED" 23 "Non Critical Yellow LED" 24 "Non Critical Red LED" 25 "Non Critical Blue LED" 26 "Non Critical Grey LED" 28 "Critical Yellow LED" 29 "Critical Red LED" 30 "Critical Blue LED" 31 "Critical Grey LED";
VAL_ 2652540928 Status 0 "OK" 1 "Disabled" 2 "Initializing" 3 "Heating" 4 "WB_Active" 5 "Too Cold" 6 "Too Hot" 7 "Unplugged" 8 "Slow!" 9 "Uncal Yellow" 10 "Uncal Red" 11 "Replace" 12 "Disabled" 13 "Shorted" 14 "Open" 15 "Over Range" 16 "Under Range" 17 "Undefined" 18 "Error!" 19 "Low Error" 20 "High Error" 21 "Non Critical No LED" 27 "Critical Green LED" 32 "Stall!" 33 "Synchronized" 34 "Syncing" 35 "Error!" 36 "Error!" 37 "Uncalibrated" 38 "Open Loop" 39 "Closed Loop" 40 "Not Learn" 41 "Learning" 42 "Off" 43 "On" 44 "Not Rev Limiting" 45 "Rev Limit" 46 "No Cut Off" 47 "CutOff!" 48 "Off" 49 "Warning!" 50 "Caution!" 51 "No Timing modifier" 52 "Timing is being modified" 53 "Timing Value is being replaced" 54 "Acq Sat" 55 "No GPS" 56 "No Data" 22 "Non Critical Green LED" 23 "Non Critical Yellow LED" 24 "Non Critical Red LED" 25 "Non Critical Blue LED" 26 "Non Critical Grey LED" 28 "Critical Yellow LED" 29 "Critical Red LED" 30 "Critical Blue LED" 31 "Critical Grey LED";
VAL_ 2652557312 Status 0 "OK" 1 "Disabled" 2 "Initializing" 3 "Heating" 4 "WB_Active" 5 "Too Cold" 6 "Too Hot" 7 "Unplugged" 8 "Slow!" 9 "Uncal Yellow" 10 "Uncal Red" 11 "Replace" 12 "Disabled" 13 "Shorted" 14 "Open" 15 "Over Range" 16 "Under Range" 17 "Undefined" 18 "Error!" 19 "Low Error" 20 "High Error" 21 "Non Critical No LED" 27 "Critical Green LED" 32 "Stall!" 33 "Synchronized" 34 "Syncing" 35 "Error!" 36 "Error!" 37 "Uncalibrated" 38 "Open Loop" 39 "Closed Loop" 40 "Not Learn" 41 "Learning" 42 "Off" 43 "On" 44 "Not Rev Limiting" 45 "Rev Limit" 46 "No Cut Off" 47 "CutOff!" 48 "Off" 49 "Warning!" 50 "Caution!" 51 "No Timing modifier" 52 "Timing is being modified" 53 "Timing Value is being replaced" 54 "Acq Sat" 55 "No GPS" 56 "No Data" 22 "Non Critical Green LED" 23 "Non Critical Yellow LED" 24 "Non Critical Red LED" 25 "Non Critical Blue LED" 26 "Non Critical Grey LED" 28 "Critical Yellow LED" 29 "Critical Red LED" 30 "Critical Blue LED" 31 "Critical Grey LED";
VAL_ 2652573696 Status 0 "OK" 1 "Disabled" 2 "Initializing" 3 "Heating" 4 "WB_Active" 5 "Too Cold" 6 "Too Hot" 7 "Unplugged" 8 "Slow!" 9 "Uncal Yellow" 10 "Uncal Red" 11 "Replace" 12 "Disabled" 13 "Shorted" 14 "Open" 15 "Over Range" 16 "Under Range" 17 "Undefined" 18 "Error!" 19 "Low Error" 20 "High Error" 21 "Non Critical No LED" 27 "Critical Green LED" 32 "Stall!" 33 "Synchronized" 34 "Syncing" 35 "Error!" 36 "Error!" 37 "Uncalibrated" 38 "Open Loop" 39 "Closed Loop" 40 "Not Learn" 41 "Learning" 42 "Off" 43 "On" 44 "Not Rev Limiting" 45 "Rev Limit" 46 "No Cut Off" 47 "CutOff!" 48 "Off" 49 "Warning!" 50 "Caution!" 51 "No Timing modifier" 52 "Timing is being modified" 53 "Timing Value is being replaced" 54 "Acq Sat" 55 "No GPS" 56 "No Data" 22 "Non Critical Green LED" 23 "Non Critical Yellow LED" 24 "Non Critical Red LED" 25 "Non Critical Blue LED" 26 "Non Critical Grey LED" 28 "Critical Yellow LED" 29 "Critical Red LED" 30 "Critical Blue LED" 31 "Critical Grey LED";
VAL_ 2652590080 Status 0 "OK" 1 "Disabled" 2 "Initializing" 3 "Heating" 4 "WB_Active" 5 "Too Cold" 6 "Too Hot" 7 "Unplugged" 8 "Slow!" 9 "Uncal Yellow" 10 "Uncal Red" 11 "Replace" 12 "Disabled" 13 "Shorted" 14 "Open" 15 "Over Range" 16 "Under Range" 17 "Undefined" 18 "Error!" 19 "Low Error" 20 "High Error" 21 "Non Critical No LED" 27 "Critical Green LED" 32 "Stall!" 33 "Synchronized" 34 "Syncing" 35 "Error!" 36 "Error!" 37 "Uncalibrated" 38 "Open Loop" 39 "Closed Loop" 40 "Not Learn" 41 "Learning" 42 "Off" 43 "On" 44 "Not Rev Limiting" 45 "Rev Limit" 46 "No Cut Off" 47 "CutOff!" 48 "Off" 49 "Warning!" 50 "Caution!" 51 "No Timing modifier" 52 "Timing is being modified" 53 "Timing Value is being replaced" 54 "Acq Sat" 55 "No GPS" 56 "No Data" 22 "Non Critical Green LED" 23 "Non Critical Yellow LED" 24 "Non Critical Red LED" 25 "Non Critical Blue LED" 26 "Non Critical Grey LED" 28 "Critical Yellow LED" 29 "Critical Red LED" 30 "Critical Blue LED" 31 "Critical Grey LED";
VAL_ 2652606464 Status 0 "OK" 1 "Disabled" 2 "Initializing" 3 "Heating" 4 "WB_Active" 5 "Too Cold" 6 "Too Hot" 7 "Unplugged" 8 "Slow!" 9 "Uncal Yellow" 10 "Uncal Red" 11 "Replace" 12 "Disabled" 13 "Shorted" 14 "Open" 15 "Over Range" 16 "Under Range" 17 "Undefined" 18 "Error!" 19 "Low Error" 20 "High Error" 21 "Non Critical No LED" 27 "Critical Green LED" 32 "Stall!" 33 "Synchronized" 34 "Syncing" 35 "Error!" 36 "Error!" 37 "Uncalibrated" 38 "Open Loop" 39 "Closed Loop" 40 "Not Learn" 41 "Learning" 42 "Off" 43 "On" 44 "Not Rev Limiting" 45 "Rev Limit" 46 "No Cut Off" 47 "CutOff!" 48 "Off" 49 "Warning!" 50 "Caution!" 51 "No Timing modifier" 52 "Timing is being modified" 53 "Timing Value is being replaced" 54 "Acq Sat" 55 "No GPS" 56 "No Data" 22 "Non Critical Green LED" 23 "Non Critical Yellow LED" 24 "Non Critical Red LED" 25 "Non Critical Blue LED" 26 "Non Critical Grey LED" 28 "Critical Yellow LED" 29 "Critical Red LED" 30 "Critical Blue LED" 31 "Critical Grey LED";
VAL_ 2652622848 Status 0 "OK" 1 "Disabled" 2 "Initializing" 3 "Heating" 4 "WB_Active" 5 "Too Cold" 6 "Too Hot" 7 "Unplugged" 8 "Slow!" 9 "Uncal Yellow" 10 "Uncal Red" 11 "Replace" 12 "Disabled" 13 "Shorted" 14 "Open" 15 "Over Range" 16 "Under Range" 17 "Undefined" 18 "Error!" 19 "Low Error" 20 "High Error" 21 "Non Critical No LED" 27 "Critical Green LED" 32 "Stall!" 33 "Synchronized" 34 "Syncing" 35 "Error!" 36 "Error!" 37 "Uncalibrated" 38 "Open Loop" 39 "Closed Loop" 40 "Not Learn" 41 "Learning" 42 "Off" 43 "On" 44 "Not Rev Limiting" 45 "Rev Limit" 46 "No Cut Off" 47 "CutOff!" 48 "Off" 49 "Warning!" 50 "Caution!" 51 "No Timing modifier" 52 "Timing is being modified" 53 "Timing Value is being replaced" 54 "Acq Sat" 55 "No GPS" 56 "No Data" 22 "Non Critical Green LED" 23 "Non Critical Yellow LED" 24 "Non Critical Red LED" 25 "Non Critical Blue LED" 26 "Non Critical Grey LED" 28 "Critical Yellow LED" 29 "Critical Red LED" 30 "Critical Blue LED" 31 "Critical Grey LED";
VAL_ 2652639232 Status 0 "OK" 1 "Disabled" 2 "Initializing" 3 "Heating" 4 "WB_Active" 5 "Too Cold" 6 "Too Hot" 7 "Unplugged" 8 "Slow!" 9 "Uncal Yellow" 10 "Uncal Red" 11 "Replace" 12 "Disabled" 13 "Shorted" 14 "Open" 15 "Over Range" 16 "Under Range" 17 "Undefined" 18 "Error!" 19 "Low Error" 20 "High Error" 21 "Non Critical No LED" 27 "Critical Green LED" 32 "Stall!" 33 "Synchronized" 34 "Syncing" 35 "Error!" 36 "Error!" 37 "Uncalibrated" 38 "Open Loop" 39 "Closed Loop" 40 "Not Learn" 41 "Learning" 42 "Off" 43 "On" 44 "Not Rev Limiting" 45 "Rev Limit" 46 "No Cut Off" 47 "CutOff!" 48 "Off" 49 "Warning!" 50 "Caution!" 51 "No Timing modifier" 52 "Timing is being modified" 53 "Timing Value is being replaced" 54 "Acq Sat" 55 "No GPS" 56 "No Data" 22 "Non Critical Green LED" 23 "Non Critical Yellow LED" 24 "Non Critical Red LED" 25 "Non Critical Blue LED" 26 "Non Critical Grey LED" 28 "Critical Yellow LED" 29 "Critical Red LED" 30 "Critical Blue LED" 31 "Critical Grey LED";
VAL_ 2652655616 Status 0 "OK" 1 "Disabled" 2 "Initializing" 3 "Heating" 4 "WB_Active" 5 "Too Cold" 6 "Too Hot" 7 "Unplugged" 8 "Slow!" 9 "Uncal Yellow" 10 "Uncal Red" 11 "Replace" 12 "Disabled" 13 "Shorted" 14 "Open" 15 "Over Range" 16 "Under Range" 17 "Undefined" 18 "Error!" 19 "Low Error" 20 "High Error" 21 "Non Critical No LED" 27 "Critical Green LED" 32 "Stall!" 33 "Synchronized" 34 "Syncing" 35 "Error!" 36 "Error!" 37 "Uncalibrated" 38 "Open Loop" 39 "Closed Loop" 40 "Not Learn" 41 "Learning" 42 "Off" 43 "On" 44 "Not Rev Limiting" 45 "Rev Limit" 46 "No Cut Off" 47 "CutOff!" 48 "Off" 49 "Warning!" 50 "Caution!" 51 "No Timing modifier" 52 "Timing is being modified" 53 "Timing Value is being replaced" 54 "Acq Sat" 55 "No GPS" 56 "No Data" 22 "Non Critical Green LED" 23 "Non Critical Yellow LED" 24 "Non Critical Red LED" 25 "Non Critical Blue LED" 26 "Non Critical Grey LED" 28 "Critical Yellow LED" 29 "Critical Red LED" 30 "Critical Blue LED" 31 "Critical Grey LED";
VAL_ 2652672000 Status 0 "OK" 1 "Disabled" 2 "Initializing" 3 "Heating" 4 "WB_Active" 5 "Too Cold" 6 "Too Hot" 7 "Unplugged" 8 "Slow!" 9 "Uncal Yellow" 10 "Uncal Red" 11 "Replace" 12 "Disabled" 13 "Shorted" 14 "Open" 15 "Over Range" 16 "Under Range" 17 "Undefined" 18 "Error!" 19 "Low Error" 20 "High Error" 21 "Non Critical No LED" 27 "Critical Green LED" 32 "Stall!" 33 "Synchronized" 34 "Syncing" 35 "Error!" 36 "Error!" 37 "Uncalibrated" 38 "Open Loop" 39 "Closed Loop" 40 "Not Learn" 41 "Learning" 42 "Off" 43 "On" 44 "Not Rev Limiting" 45 "Rev Limit" 46 "No Cut Off" 47 "CutOff!" 48 "Off" 49 "Warning!" 50 "Caution!" 51 "No Timing modifier" 52 "Timing is being modified" 53 "Timing Value is being replaced" 54 "Acq Sat" 55 "No GPS" 56 "No Data" 22 "Non Critical Green LED" 23 "Non Critical Yellow LED" 24 "Non Critical Red LED" 25 "Non Critical Blue LED" 26 "Non Critical Grey LED" 28 "Critical Yellow LED" 29 "Critical Red LED" 30 "Critical Blue LED" 31 "Critical Grey LED";
VAL_ 2652688384 Status 0 "OK" 1 "Disabled" 2 "Initializing" 3 "Heating" 4 "WB_Active" 5 "Too Cold" 6 "Too Hot" 7 "Unplugged" 8 "Slow!" 9 "Uncal Yellow" 10 "Uncal Red" 11 "Replace" 12 "Disabled" 13 "Shorted" 14 "Open" 15 "Over Range" 16 "Under Range" 17 "Undefined" 18 "Error!" 19 "Low Error" 20 "High Error" 21 "Non Critical No LED" 27 "Critical Green LED" 32 "Stall!" 33 "Synchronized" 34 "Syncing" 35 "Error!" 36 "Error!" 37 "Uncalibrated" 38 "Open Loop" 39 "Closed Loop" 40 "Not Learn" 41 "Learning" 42 "Off" 43 "On" 44 "Not Rev Limiting" 45 "Rev Limit" 46 "No Cut Off" 47 "CutOff!" 48 "Off" 49 "Warning!" 50 "Caution!" 51 "No Timing modifier" 52 "Timing is being modified" 53 "Timing Value is being replaced" 54 "Acq Sat" 55 "No GPS" 56 "No Data" 22 "Non Critical Green LED" 23 "Non Critical Yellow LED" 24 "Non Critical Red LED" 25 "Non Critical Blue LED" 26 "Non Critical Grey LED" 28 "Critical Yellow LED" 29 "Critical Red LED" 30 "Critical Blue LED" 31 "Critical Grey LED";
VAL_ 2652704768 Status 0 "OK" 1 "Disabled" 2 "Initializing" 3 "Heating" 4 "WB_Active" 5 "Too Cold" 6 "Too Hot" 7 "Unplugged" 8 "Slow!" 9 "Uncal Yellow" 10 "Uncal Red" 11 "Replace" 12 "Disabled" 13 "Shorted" 14 "Open" 15 "Over Range" 16 "Under Range" 17 "Undefined" 18 "Error!" 19 "Low Error" 20 "High Error" 21 "Non Critical No LED" 27 "Critical Green LED" 32 "Stall!" 33 "Synchronized" 34 "Syncing" 35 "Error!" 36 "Error!" 37 "Uncalibrated" 38 "Open Loop" 39 "Closed Loop" 40 "Not Learn" 41 "Learning" 42 "Off" 43 "On" 44 "Not Rev Limiting" 45 "Rev Limit" 46 "No Cut Off" 47 "CutOff!" 48 "Off" 49 "Warning!" 50 "Caution!" 51 "No Timing modifier" 52 "Timing is being modified" 53 "Timing Value is being replaced" 54 "Acq Sat" 55 "No GPS" 56 "No Data" 22 "Non Critical Green LED" 23 "Non Critical Yellow LED" 24 "Non Critical Red LED" 25 "Non Critical Blue LED" 26 "Non Critical Grey LED" 28 "Critical Yellow LED" 29 "Critical Red LED" 30 "Critical Blue LED" 31 "Critical Grey LED";
VAL_ 2652721152 Status 0 "OK" 1 "Disabled" 2 "Initializing" 3 "Heating" 4 "WB_Active" 5 "Too Cold" 6 "Too Hot" 7 "Unplugged" 8 "Slow!" 9 "Uncal Yellow" 10 "Uncal Red" 11 "Replace" 12 "Disabled" 13 "Shorted" 14 "Open" 15 "Over Range" 16 "Under Range" 17 "Undefined" 18 "Error!" 19 "Low Error" 20 "High Error" 21 "Non Critical No LED" 27 "Critical Green LED" 32 "Stall!" 33 "Synchronized" 34 "Syncing" 35 "Error!" 36 "Error!" 37 "Uncalibrated" 38 "Open Loop" 39 "Closed Loop" 40 "Not Learn" 41 "Learning" 42 "Off" 43 "On" 44 "Not Rev Limiting" 45 "Rev Limit" 46 "No Cut Off" 47 "CutOff!" 48 "Off" 49 "Warning!" 50 "Caution!" 51 "No Timing modifier" 52 "Timing is being modified" 53 "Timing Value is being replaced" 54 "Acq Sat" 55 "No GPS" 56 "No Data" 22 "Non Critical Green LED" 23 "Non Critical Yellow LED" 24 "Non Critical Red LED" 25 "Non Critical Blue LED" 26 "Non Critical Grey LED" 28 "Critical Yellow LED" 29 "Critical Red LED" 30 "Critical Blue LED" 31 "Critical Grey LED";
VAL_ 2652737536 Status 0 "OK" 1 "Disabled" 2 "Initializing" 3 "Heating" 4 "WB_Active" 5 "Too Cold" 6 "Too Hot" 7 "Unplugged" 8 "Slow!" 9 "Uncal Yellow" 10 "Uncal Red" 11 "Replace" 12 "Disabled" 13 "Shorted" 14 "Open" 15 "Over Range" 16 "Under Range" 17 "Undefined" 18 "Error!" 19 "Low Error" 20 "High Error" 21 "Non Critical No LED" 27 "Critical Green LED" 32 "Stall!" 33 "Synchronized" 34 "Syncing" 35 "Error!" 36 "Error!" 37 "Uncalibrated" 38 "Open Loop" 39 "Closed Loop" 40 "Not Learn" 41 "Learning" 42 "Off" 43 "On" 44 "Not Rev Limiting" 45 "Rev Limit" 46 "No Cut Off" 47 "CutOff!" 48 "Off" 49 "Warning!" 50 "Caution!" 51 "No Timing modifier" 52 "Timing is being modified" 53 "Timing Value is being replaced" 54 "Acq Sat" 55 "No GPS" 56 "No Data" 22 "Non Critical Green LED" 23 "Non Critical Yellow LED" 24 "Non Critical Red LED" 25 "Non Critical Blue LED" 26 "Non Critical Grey LED" 28 "Critical Yellow LED" 29 "Critical Red LED" 30 "Critical Blue LED" 31 "Critical Grey LED";
VAL_ 2652753920 Status 0 "OK" 1 "Disabled" 2 "Initializing" 3 "Heating" 4 "WB_Active" 5 "Too Cold" 6 "Too Hot" 7 "Unplugged" 8 "Slow!" 9 "Uncal Yellow" 10 "Uncal Red" 11 "Replace" 12 "Disabled" 13 "Shorted" 14 "Open" 15 "Over Range" 16 "Under Range" 17 "Undefined" 18 "Error!" 19 "Low Error" 20 "High Error" 21 "Non Critical No LED" 27 "Critical Green LED" 32 "Stall!" 33 "Synchronized" 34 "Syncing" 35 "Error!" 36 "Error!" 37 "Uncalibrated" 38 "Open Loop" 39 "Closed Loop" 40 "Not Learn" 41 "Learning" 42 "Off" 43 "On" 44 "Not Rev Limiting" 45 "Rev Limit" 46 "No Cut Off" 47 "CutOff!" 48 "Off" 49 "Warning!" 50 "Caution!" 51 "No Timing modifier" 52 "Timing is being modified" 53 "Timing Value is being replaced" 54 "Acq Sat" 55 "No GPS" 56 "No Data" 22 "Non Critical Green LED" 23 "Non Critical Yellow LED" 24 "Non Critical Red LED" 25 "Non Critical Blue LED" 26 "Non Critical Grey LED" 28 "Critical Yellow LED" 29 "Critical Red LED" 30 "Critical Blue LED" 31 "Critical Grey LED";
VAL_ 2652770304 Status 0 "OK" 1 "Disabled" 2 "Initializing" 3 "Heating" 4 "WB_Active" 5 "Too Cold" 6 "Too Hot" 7 "Unplugged" 8 "Slow!" 9 "Uncal Yellow" 10 "Uncal Red" 11 "Replace" 12 "Disabled" 13 "Shorted" 14 "Open" 15 "Over Range" 16 "Under Range" 17 "Undefined" 18 "Error!" 19 "Low Error" 20 "High Error" 21 "Non Critical No LED" 27 "Critical Green LED" 32 "Stall!" 33 "Synchronized" 34 "Syncing" 35 "Error!" 36 "Error!" 37 "Uncalibrated" 38 "Open Loop" 39 "Closed Loop" 40 "Not Learn" 41 "Learning" 42 "Off" 43 "On" 44 "Not Rev Limiting" 45 "Rev Limit" 46 "No Cut Off" 47 "CutOff!" 48 "Off" 49 "Warning!" 50 "Caution!" 51 "No Timing modifier" 52 "Timing is being modified" 53 "Timing Value is being replaced" 54 "Acq Sat" 55 "No GPS" 56 "No Data" 22 "Non Critical Green LED" 23 "Non Critical Yellow LED" 24 "Non Critical Red LED" 25 "Non Critical Blue LED" 26 "Non Critical Grey LED" 28 "Critical Yellow LED" 29 "Critical Red LED" 30 "Critical Blue LED" 31 "Critical Grey LED";
VAL_ 2652786688 Status 0 "OK" 1 "Disabled" 2 "Initializing" 3 "Heating" 4 "WB_Active" 5 "Too Cold" 6 "Too Hot" 7 "Unplugged" 8 "Slow!" 9 "Uncal Yellow" 10 "Uncal Red" 11 "Replace" 12 "Disabled" 13 "Shorted" 14 "Open" 15 "Over Range" 16 "Under Range" 17 "Undefined" 18 "Error!" 19 "Low Error" 20 "High Error" 21 "Non Critical No LED" 27 "Critical Green LED" 32 "Stall!" 33 "Synchronized" 34 "Syncing" 35 "Error!" 36 "Error!" 37 "Uncalibrated" 38 "Open Loop" 39 "Closed Loop" 40 "Not Learn" 41 "Learning" 42 "Off" 43 "On" 44 "Not Rev Limiting" 45 "Rev Limit" 46 "No Cut Off" 47 "CutOff!" 48 "Off" 49 "Warning!" 50 "Caution!" 51 "No Timing modifier" 52 "Timing is being modified" 53 "Timing Value is being replaced" 54 "Acq Sat" 55 "No GPS" 56 "No Data" 22 "Non Critical Green LED" 23 "Non Critical Yellow LED" 24 "Non Critical Red LED" 25 "Non Critical Blue LED" 26 "Non Critical Grey LED" 28 "Critical Yellow LED" 29 "Critical Red LED" 30 "Critical Blue LED" 31 "Critical Grey LED";
VAL_ 2652803072 Status 0 "OK" 1 "Disabled" 2 "Initializing" 3 "Heating" 4 "WB_Active" 5 "Too Cold" 6 "Too Hot" 7 "Unplugged" 8 "Slow!" 9 "Uncal Yellow" 10 "Uncal Red" 11 "Replace" 12 "Disabled" 13 "Shorted" 14 "Open" 15 "Over Range" 16 "Under Range" 17 "Undefined" 18 "Error!" 19 "Low Error" 20 "High Error" 21 "Non Critical No LED" 27 "Critical Green LED" 32 "Stall!" 33 "Synchronized" 34 "Syncing" 35 "Error!" 36 "Error!" 37 "Uncalibrated" 38 "Open Loop" 39 "Closed Loop" 40 "Not Learn" 41 "Learning" 42 "Off" 43 "On" 44 "Not Rev Limiting" 45 "Rev Limit" 46 "No Cut Off" 47 "CutOff!" 48 "Off" 49 "Warning!" 50 "Caution!" 51 "No Timing modifier" 52 "Timing is being modified" 53 "Timing Value is being replaced" 54 "Acq Sat" 55 "No GPS" 56 "No Data" 22 "Non Critical Green LED" 23 "Non Critical Yellow LED" 24 "Non Critical Red LED" 25 "Non Critical Blue LED" 26 "Non Critical Grey LED" 28 "Critical Yellow LED" 29 "Critical Red LED" 30 "Critical Blue LED" 31 "Critical Grey LED";
VAL_ 2652819456 Status 0 "OK" 1 "Disabled" 2 "Initializing" 3 "Heating" 4 "WB_Active" 5 "Too Cold" 6 "Too Hot" 7 "Unplugged" 8 "Slow!" 9 "Uncal Yellow" 10 "Uncal Red" 11 "Replace" 12 "Disabled" 13 "Shorted" 14 "Open" 15 "Over Range" 16 "Under Range" 17 "Undefined" 18 "Error!" 19 "Low Error" 20 "High Error" 21 "Non Critical No LED" 27 "Critical Green LED" 32 "Stall!" 33 "Synchronized" 34 "Syncing" 35 "Error!" 36 "Error!" 37 "Uncalibrated" 38 "Open Loop" 39 "Closed Loop" 40 "Not Learn" 41 "Learning" 42 "Off" 43 "On" 44 "Not Rev Limiting" 45 "Rev Limit" 46 "No Cut Off" 47 "CutOff!" 48 "Off" 49 "Warning!" 50 "Caution!" 51 "No Timing modifier" 52 "Timing is being modified" 53 "Timing Value is being replaced" 54 "Acq Sat" 55 "No GPS" 56 "No Data" 22 "Non Critical Green LED" 23 "Non Critical Yellow LED" 24 "Non Critical Red LED" 25 "Non Critical Blue LED" 26 "Non Critical Grey LED" 28 "Critical Yellow LED" 29 "Critical Red LED" 30 "Critical Blue LED" 31 "Critical Grey LED";
VAL_ 2652835840 Status 0 "OK" 1 "Disabled" 2 "Initializing" 3 "Heating" 4 "WB_Active" 5 "Too Cold" 6 "Too Hot" 7 "Unplugged" 8 "Slow!" 9 "Uncal Yellow" 10 "Uncal Red" 11 "Replace" 12 "Disabled" 13 "Shorted" 14 "Open" 15 "Over Range" 16 "Under Range" 17 "Undefined" 18 "Error!" 19 "Low Error" 20 "High Error" 21 "Non Critical No LED" 27 "Critical Green LED" 32 "Stall!" 33 "Synchronized" 34 "Syncing" 35 "Error!" 36 "Error!" 37 "Uncalibrated" 38 "Open Loop" 39 "Closed Loop" 40 "Not Learn" 41 "Learning" 42 "Off" 43 "On" 44 "Not Rev Limiting" 45 "Rev Limit" 46 "No Cut Off" 47 "CutOff!" 48 "Off" 49 "Warning!" 50 "Caution!" 51 "No Timing modifier" 52 "Timing is being modified" 53 "Timing Value is being replaced" 54 "Acq Sat" 55 "No GPS" 56 "No Data" 22 "Non Critical Green LED" 23 "Non Critical Yellow LED" 24 "Non Critical Red LED" 25 "Non Critical Blue LED" 26 "Non Critical Grey LED" 28 "Critical Yellow LED" 29 "Critical Red LED" 30 "Critical Blue LED" 31 "Critical Grey LED";
VAL_ 2652852224 Status 0 "OK" 1 "Disabled" 2 "Initializing" 3 "Heating" 4 "WB_Active" 5 "Too Cold" 6 "Too Hot" 7 "Unplugged" 8 "Slow!" 9 "Uncal Yellow" 10 "Uncal Red" 11 "Replace" 12 "Disabled" 13 "Shorted" 14 "Open" 15 "Over Range" 16 "Under Range" 17 "Undefined" 18 "Error!" 19 "Low Error" 20 "High Error" 21 "Non Critical No LED" 27 "Critical Green LED" 32 "Stall!" 33 "Synchronized" 34 "Syncing" 35 "Error!" 36 "Error!" 37 "Uncalibrated" 38 "Open Loop" 39 "Closed Loop" 40 "Not Learn" 41 "Learning" 42 "Off" 43 "On" 44 "Not Rev Limiting" 45 "Rev Limit" 46 "No Cut Off" 47 "CutOff!" 48 "Off" 49 "Warning!" 50 "Caution!" 51 "No Timing modifier" 52 "Timing is being modified" 53 "Timing Value is being replaced" 54 "Acq Sat" 55 "No GPS" 56 "No Data" 22 "Non Critical Green LED" 23 "Non Critical Yellow LED" 24 "Non Critical Red LED" 25 "Non Critical Blue LED" 26 "Non Critical Grey LED" 28 "Critical Yellow LED" 29 "Critical Red LED" 30 "Critical Blue LED" 31 "Critical Grey LED";
VAL_ 2652868608 Status 0 "OK" 1 "Disabled" 2 "Initializing" 3 "Heating" 4 "WB_Active" 5 "Too Cold" 6 "Too Hot" 7 "Unplugged" 8 "Slow!" 9 "Uncal Yellow" 10 "Uncal Red" 11 "Replace" 12 "Disabled" 13 "Shorted" 14 "Open" 15 "Over Range" 16 "Under Range" 17 "Undefined" 18 "Error!" 19 "Low Error" 20 "High Error" 21 "Non Critical No LED" 27 "Critical Green LED" 32 "Stall!" 33 "Synchronized" 34 "Syncing" 35 "Error!" 36 "Error!" 37 "Uncalibrated" 38 "Open Loop" 39 "Closed Loop" 40 "Not Learn" 41 "Learning" 42 "Off" 43 "On" 44 "Not Rev Limiting" 45 "Rev Limit" 46 "No Cut Off" 47 "CutOff!" 48 "Off" 49 "Warning!" 50 "Caution!" 51 "No Timing modifier" 52 "Timing is being modified" 53 "Timing Value is being replaced" 54 "Acq Sat" 55 "No GPS" 56 "No Data" 22 "Non Critical Green LED" 23 "Non Critical Yellow LED" 24 "Non Critical Red LED" 25 "Non Critical Blue LED" 26 "Non Critical Grey LED" 28 "Critical Yellow LED" 29 "Critical Red LED" 30 "Critical Blue LED" 31 "Critical Grey LED";
VAL_ 2652934144 Status 0 "OK" 1 "Disabled" 2 "Initializing" 3 "Heating" 4 "WB_Active" 5 "Too Cold" 6 "Too Hot" 7 "Unplugged" 8 "Slow!" 9 "Uncal Yellow" 10 "Uncal Red" 11 "Replace" 12 "Disabled" 13 "Shorted" 14 "Open" 15 "Over Range" 16 "Under Range" 17 "Undefined" 18 "Error!" 19 "Low Error" 20 "High Error" 21 "Non Critical No LED" 27 "Critical Green LED" 32 "Stall!" 33 "Synchronized" 34 "Syncing" 35 "Error!" 36 "Error!" 37 "Uncalibrated" 38 "Open Loop" 39 "Closed Loop" 40 "Not Learn" 41 "Learning" 42 "Off" 43 "On" 44 "Not Rev Limiting" 45 "Rev Limit" 46 "No Cut Off" 47 "CutOff!" 48 "Off" 49 "Warning!" 50 "Caution!" 51 "No Timing modifier" 52 "Timing is being modified" 53 "Timing Value is being replaced" 54 "Acq Sat" 55 "No GPS" 56 "No Data" 22 "Non Critical Green LED" 23 "Non Critical Yellow LED" 24 "Non Critical Red LED" 25 "Non Critical Blue LED" 26 "Non Critical Grey LED" 28 "Critical Yellow LED" 29 "Critical Red LED" 30 "Critical Blue LED" 31 "Critical Grey LED";
VAL_ 2652950528 Status 0 "OK" 1 "Disabled" 2 "Initializing" 3 "Heating" 4 "WB_Active" 5 "Too Cold" 6 "Too Hot" 7 "Unplugged" 8 "Slow!" 9 "Uncal Yellow" 10 "Uncal Red" 11 "Replace" 12 "Disabled" 13 "Shorted" 14 "Open" 15 "Over Range" 16 "Under Range" 17 "Undefined" 18 "Error!" 19 "Low Error" 20 "High Error" 21 "Non Critical No LED" 27 "Critical Green LED" 32 "Stall!" 33 "Synchronized" 34 "Syncing" 35 "Error!" 36 "Error!" 37 "Uncalibrated" 38 "Open Loop" 39 "Closed Loop" 40 "Not Learn" 41 "Learning" 42 "Off" 43 "On" 44 "Not Rev Limiting" 45 "Rev Limit" 46 "No Cut Off" 47 "CutOff!" 48 "Off" 49 "Warning!" 50 "Caution!" 51 "No Timing modifier" 52 "Timing is being modified" 53 "Timing Value is being replaced" 54 "Acq Sat" 55 "No GPS" 56 "No Data" 22 "Non Critical Green LED" 23 "Non Critical Yellow LED" 24 "Non Critical Red LED" 25 "Non Critical Blue LED" 26 "Non Critical Grey LED" 28 "Critical Yellow LED" 29 "Critical Red LED" 30 "Critical Blue LED" 31 "Critical Grey LED";
VAL_ 2652966912 Status 0 "OK" 1 "Disabled" 2 "Initializing" 3 "Heating" 4 "WB_Active" 5 "Too Cold" 6 "Too Hot" 7 "Unplugged" 8 "Slow!" 9 "Uncal Yellow" 10 "Uncal Red" 11 "Replace" 12 "Disabled" 13 "Shorted" 14 "Open" 15 "Over Range" 16 "Under Range" 17 "Undefined" 18 "Error!" 19 "Low Error" 20 "High Error" 21 "Non Critical No LED" 27 "Critical Green LED" 32 "Stall!" 33 "Synchronized" 34 "Syncing" 35 "Error!" 36 "Error!" 37 "Uncalibrated" 38 "Open Loop" 39 "Closed Loop" 40 "Not Learn" 41 "Learning" 42 "Off" 43 "On" 44 "Not Rev Limiting" 45 "Rev Limit" 46 "No Cut Off" 47 "CutOff!" 48 "Off" 49 "Warning!" 50 "Caution!" 51 "No Timing modifier" 52 "Timing is being modified" 53 "Timing Value is being replaced" 54 "Acq Sat" 55 "No GPS" 56 "No Data" 22 "Non Critical Green LED" 23 "Non Critical Yellow LED" 24 "Non Critical Red LED" 25 "Non Critical Blue LED" 26 "Non Critical Grey LED" 28 "Critical Yellow LED" 29 "Critical Red LED" 30 "Critical Blue LED" 31 "Critical Grey LED";
VAL_ 2652983296 Status 0 "OK" 1 "Disabled" 2 "Initializing" 3 "Heating" 4 "WB_Active" 5 "Too Cold" 6 "Too Hot" 7 "Unplugged" 8 "Slow!" 9 "Uncal Yellow" 10 "Uncal Red" 11 "Replace" 12 "Disabled" 13 "Shorted" 14 "Open" 15 "Over Range" 16 "Under Range" 17 "Undefined" 18 "Error!" 19 "Low Error" 20 "High Error" 21 "Non Critical No LED" 27 "Critical Green LED" 32 "Stall!" 33 "Synchronized" 34 "Syncing" 35 "Error!" 36 "Error!" 37 "Uncalibrated" 38 "Open Loop" 39 "Closed Loop" 40 "Not Learn" 41 "Learning" 42 "Off" 43 "On" 44 "Not Rev Limiting" 45 "Rev Limit" 46 "No Cut Off" 47 "CutOff!" 48 "Off" 49 "Warning!" 50 "Caution!" 51 "No Timing modifier" 52 "Timing is being modified" 53 "Timing Value is being replaced" 54 "Acq Sat" 55 "No GPS" 56 "No Data" 22 "Non Critical Green LED" 23 "Non Critical Yellow LED" 24 "Non Critical Red LED" 25 "Non Critical Blue LED" 26 "Non Critical Grey LED" 28 "Critical Yellow LED" 29 "Critical Red LED" 30 "Critical Blue LED" 31 "Critical Grey LED";
VAL_ 2652999680 Status 0 "OK" 1 "Disabled" 2 "Initializing" 3 "Heating" 4 "WB_Active" 5 "Too Cold" 6 "Too Hot" 7 "Unplugged" 8 "Slow!" 9 "Uncal Yellow" 10 "Uncal Red" 11 "Replace" 12 "Disabled" 13 "Shorted" 14 "Open" 15 "Over Range" 16 "Under Range" 17 "Undefined" 18 "Error!" 19 "Low Error" 20 "High Error" 21 "Non Critical No LED" 27 "Critical Green LED" 32 "Stall!" 33 "Synchronized" 34 "Syncing" 35 "Error!" 36 "Error!" 37 "Uncalibrated" 38 "Open Loop" 39 "Closed Loop" 40 "Not Learn" 41 "Learning" 42 "Off" 43 "On" 44 "Not Rev Limiting" 45 "Rev Limit" 46 "No Cut Off" 47 "CutOff!" 48 "Off" 49 "Warning!" 50 "Caution!" 51 "No Timing modifier" 52 "Timing is being modified" 53 "Timing Value is being replaced" 54 "Acq Sat" 55 "No GPS" 56 "No Data" 22 "Non Critical Green LED" 23 "Non Critical Yellow LED" 24 "Non Critical Red LED" 25 "Non Critical Blue LED" 26 "Non Critical Grey LED" 28 "Critical Yellow LED" 29 "Critical Red LED" 30 "Critical Blue LED" 31 "Critical Grey LED";
VAL_ 2653016064 Status 0 "OK" 1 "Disabled" 2 "Initializing" 3 "Heating" 4 "WB_Active" 5 "Too Cold" 6 "Too Hot" 7 "Unplugged" 8 "Slow!" 9 "Uncal Yellow" 10 "Uncal Red" 11 "Replace" 12 "Disabled" 13 "Shorted" 14 "Open" 15 "Over Range" 16 "Under Range" 17 "Undefined" 18 "Error!" 19 "Low Error" 20 "High Error" 21 "Non Critical No LED" 27 "Critical Green LED" 32 "Stall!" 33 "Synchronized" 34 "Syncing" 35 "Error!" 36 "Error!" 37 "Uncalibrated" 38 "Open Loop" 39 "Closed Loop" 40 "Not Learn" 41 "Learning" 42 "Off" 43 "On" 44 "Not Rev Limiting" 45 "Rev Limit" 46 "No Cut Off" 47 "CutOff!" 48 "Off" 49 "Warning!" 50 "Caution!" 51 "No Timing modifier" 52 "Timing is being modified" 53 "Timing Value is being replaced" 54 "Acq Sat" 55 "No GPS" 56 "No Data" 22 "Non Critical Green LED" 23 "Non Critical Yellow LED" 24 "Non Critical Red LED" 25 "Non Critical Blue LED" 26 "Non Critical Grey LED" 28 "Critical Yellow LED" 29 "Critical Red LED" 30 "Critical Blue LED" 31 "Critical Grey LED";
VAL_ 2653032448 Status 0 "OK" 1 "Disabled" 2 "Initializing" 3 "Heating" 4 "WB_Active" 5 "Too Cold" 6 "Too Hot" 7 "Unplugged" 8 "Slow!" 9 "Uncal Yellow" 10 "Uncal Red" 11 "Replace" 12 "Disabled" 13 "Shorted" 14 "Open" 15 "Over Range" 16 "Under Range" 17 "Undefined" 18 "Error!" 19 "Low Error" 20 "High Error" 21 "Non Critical No LED" 27 "Critical Green LED" 32 "Stall!" 33 "Synchronized" 34 "Syncing" 35 "Error!" 36 "Error!" 37 "Uncalibrated" 38 "Open Loop" 39 "Closed Loop" 40 "Not Learn" 41 "Learning" 42 "Off" 43 "On" 44 "Not Rev Limiting" 45 "Rev Limit" 46 "No Cut Off" 47 "CutOff!" 48 "Off" 49 "Warning!" 50 "Caution!" 51 "No Timing modifier" 52 "Timing is being modified" 53 "Timing Value is being replaced" 54 "Acq Sat" 55 "No GPS" 56 "No Data" 22 "Non Critical Green LED" 23 "Non Critical Yellow LED" 24 "Non Critical Red LED" 25 "Non Critical Blue LED" 26 "Non Critical Grey LED" 28 "Critical Yellow LED" 29 "Critical Red LED" 30 "Critical Blue LED" 31 "Critical Grey LED";
VAL_ 2653048832 Status 0 "OK" 1 "Disabled" 2 "Initializing" 3 "Heating" 4 "WB_Active" 5 "Too Cold" 6 "Too Hot" 7 "Unplugged" 8 "Slow!" 9 "Uncal Yellow" 10 "Uncal Red" 11 "Replace" 12 "Disabled" 13 "Shorted" 14 "Open" 15 "Over Range" 16 "Under Range" 17 "Undefined" 18 "Error!" 19 "Low Error" 20 "High Error" 21 "Non Critical No LED" 27 "Critical Green LED" 32 "Stall!" 33 "Synchronized" 34 "Syncing" 35 "Error!" 36 "Error!" 37 "Uncalibrated" 38 "Open Loop" 39 "Closed Loop" 40 "Not Learn" 41 "Learning" 42 "Off" 43 "On" 44 "Not Rev Limiting" 45 "Rev Limit" 46 "No Cut Off" 47 "CutOff!" 48 "Off" 49 "Warning!" 50 "Caution!" 51 "No Timing modifier" 52 "Timing is being modified" 53 "Timing Value is being replaced" 54 "Acq Sat" 55 "No GPS" 56 "No Data" 22 "Non Critical Green LED" 23 "Non Critical Yellow LED" 24 "Non Critical Red LED" 25 "Non Critical Blue LED" 26 "Non Critical Grey LED" 28 "Critical Yellow LED" 29 "Critical Red LED" 30 "Critical Blue LED" 31 "Critical Grey LED";
VAL_ 2653065216 Status 0 "OK" 1 "Disabled" 2 "Initializing" 3 "Heating" 4 "WB_Active" 5 "Too Cold" 6 "Too Hot" 7 "Unplugged" 8 "Slow!" 9 "Uncal Yellow" 10 "Uncal Red" 11 "Replace" 12 "Disabled" 13 "Shorted" 14 "Open" 15 "Over Range" 16 "Under Range" 17 "Undefined" 18 "Error!" 19 "Low Error" 20 "High Error" 21 "Non Critical No LED" 27 "Critical Green LED" 32 "Stall!" 33 "Synchronized" 34 "Syncing" 35 "Error!" 36 "Error!" 37 "Uncalibrated" 38 "Open Loop" 39 "Closed Loop" 40 "Not Learn" 41 "Learning" 42 "Off" 43 "On" 44 "Not Rev Limiting" 45 "Rev Limit" 46 "No Cut Off" 47 "CutOff!" 48 "Off" 49 "Warning!" 50 "Caution!" 51 "No Timing modifier" 52 "Timing is being modified" 53 "Timing Value is being replaced" 54 "Acq Sat" 55 "No GPS" 56 "No Data" 22 "Non Critical Green LED" 23 "Non Critical Yellow LED" 24 "Non Critical Red LED" 25 "Non Critical Blue LED" 26 "Non Critical Grey LED" 28 "Critical Yellow LED" 29 "Critical Red LED" 30 "Critical Blue LED" 31 "Critical Grey LED";
VAL_ 2653081600 Status 0 "OK" 1 "Disabled" 2 "Initializing" 3 "Heating" 4 "WB_Active" 5 "Too Cold" 6 "Too Hot" 7 "Unplugged" 8 "Slow!" 9 "Uncal Yellow" 10 "Uncal Red" 11 "Replace" 12 "Disabled" 13 "Shorted" 14 "Open" 15 "Over Range" 16 "Under Range" 17 "Undefined" 18 "Error!" 19 "Low Error" 20 "High Error" 21 "Non Critical No LED" 27 "Critical Green LED" 32 "Stall!" 33 "Synchronized" 34 "Syncing" 35 "Error!" 36 "Error!" 37 "Uncalibrated" 38 "Open Loop" 39 "Closed Loop" 40 "Not Learn" 41 "Learning" 42 "Off" 43 "On" 44 "Not Rev Limiting" 45 "Rev Limit" 46 "No Cut Off" 47 "CutOff!" 48 "Off" 49 "Warning!" 50 "Caution!" 51 "No Timing modifier" 52 "Timing is being modified" 53 "Timing Value is being replaced" 54 "Acq Sat" 55 "No GPS" 56 "No Data" 22 "Non Critical Green LED" 23 "Non Critical Yellow LED" 24 "Non Critical Red LED" 25 "Non Critical Blue LED" 26 "Non Critical Grey LED" 28 "Critical Yellow LED" 29 "Critical Red LED" 30 "Critical Blue LED" 31 "Critical Grey LED";
VAL_ 2653097984 Status 0 "OK" 1 "Disabled" 2 "Initializing" 3 "Heating" 4 "WB_Active" 5 "Too Cold" 6 "Too Hot" 7 "Unplugged" 8 "Slow!" 9 "Uncal Yellow" 10 "Uncal Red" 11 "Replace" 12 "Disabled" 13 "Shorted" 14 "Open" 15 "Over Range" 16 "Under Range" 17 "Undefined" 18 "Error!" 19 "Low Error" 20 "High Error" 21 "Non Critical No LED" 27 "Critical Green LED" 32 "Stall!" 33 "Synchronized" 34 "Syncing" 35 "Error!" 36 "Error!" 37 "Uncalibrated" 38 "Open Loop" 39 "Closed Loop" 40 "Not Learn" 41 "Learning" 42 "Off" 43 "On" 44 "Not Rev Limiting" 45 "Rev Limit" 46 "No Cut Off" 47 "CutOff!" 48 "Off" 49 "Warning!" 50 "Caution!" 51 "No Timing modifier" 52 "Timing is being modified" 53 "Timing Value is being replaced" 54 "Acq Sat" 55 "No GPS" 56 "No Data" 22 "Non Critical Green LED" 23 "Non Critical Yellow LED" 24 "Non Critical Red LED" 25 "Non Critical Blue LED" 26 "Non Critical Grey LED" 28 "Critical Yellow LED" 29 "Critical Red LED" 30 "Critical Blue LED" 31 "Critical Grey LED";
VAL_ 2653114368 Status 0 "OK" 1 "Disabled" 2 "Initializing" 3 "Heating" 4 "WB_Active" 5 "Too Cold" 6 "Too Hot" 7 "Unplugged" 8 "Slow!" 9 "Uncal Yellow" 10 "Uncal Red" 11 "Replace" 12 "Disabled" 13 "Shorted" 14 "Open" 15 "Over Range" 16 "Under Range" 17 "Undefined" 18 "Error!" 19 "Low Error" 20 "High Error" 21 "Non Critical No LED" 27 "Critical Green LED" 32 "Stall!" 33 "Synchronized" 34 "Syncing" 35 "Error!" 36 "Error!" 37 "Uncalibrated" 38 "Open Loop" 39 "Closed Loop" 40 "Not Learn" 41 "Learning" 42 "Off" 43 "On" 44 "Not Rev Limiting" 45 "Rev Limit" 46 "No Cut Off" 47 "CutOff!" 48 "Off" 49 "Warning!" 50 "Caution!" 51 "No Timing modifier" 52 "Timing is being modified" 53 "Timing Value is being replaced" 54 "Acq Sat" 55 "No GPS" 56 "No Data" 22 "Non Critical Green LED" 23 "Non Critical Yellow LED" 24 "Non Critical Red LED" 25 "Non Critical Blue LED" 26 "Non Critical Grey LED" 28 "Critical Yellow LED" 29 "Critical Red LED" 30 "Critical Blue LED" 31 "Critical Grey LED";
VAL_ 2653130752 Status 0 "OK" 1 "Disabled" 2 "Initializing" 3 "Heating" 4 "WB_Active" 5 "Too Cold" 6 "Too Hot" 7 "Unplugged" 8 "Slow!" 9 "Uncal Yellow" 10 "Uncal Red" 11 "Replace" 12 "Disabled" 13 "Shorted" 14 "Open" 15 "Over Range" 16 "Under Range" 17 "Undefined" 18 "Error!" 19 "Low Error" 20 "High Error" 21 "Non Critical No LED" 27 "Critical Green LED" 32 "Stall!" 33 "Synchronized" 34 "Syncing" 35 "Error!" 36 "Error!" 37 "Uncalibrated" 38 "Open Loop" 39 "Closed Loop" 40 "Not Learn" 41 "Learning" 42 "Off" 43 "On" 44 "Not Rev Limiting" 45 "Rev Limit" 46 "No Cut Off" 47 "CutOff!" 48 "Off" 49 "Warning!" 50 "Caution!" 51 "No Timing modifier" 52 "Timing is being modified" 53 "Timing Value is being replaced" 54 "Acq Sat" 55 "No GPS" 56 "No Data" 22 "Non Critical Green LED" 23 "Non Critical Yellow LED" 24 "Non Critical Red LED" 25 "Non Critical Blue LED" 26 "Non Critical Grey LED" 28 "Critical Yellow LED" 29 "Critical Red LED" 30 "Critical Blue LED" 31 "Critical Grey LED";
VAL_ 2653147136 Status 0 "OK" 1 "Disabled" 2 "Initializing" 3 "Heating" 4 "WB_Active" 5 "Too Cold" 6 "Too Hot" 7 "Unplugged" 8 "Slow!" 9 "Uncal Yellow" 10 "Uncal Red" 11 "Replace" 12 "Disabled" 13 "Shorted" 14 "Open" 15 "Over Range" 16 "Under Range" 17 "Undefined" 18 "Error!" 19 "Low Error" 20 "High Error" 21 "Non Critical No LED" 27 "Critical Green LED" 32 "Stall!" 33 "Synchronized" 34 "Syncing" 35 "Error!" 36 "Error!" 37 "Uncalibrated" 38 "Open Loop" 39 "Closed Loop" 40 "Not Learn" 41 "Learning" 42 "Off" 43 "On" 44 "Not Rev Limiting" 45 "Rev Limit" 46 "No Cut Off" 47 "CutOff!" 48 "Off" 49 "Warning!" 50 "Caution!" 51 "No Timing modifier" 52 "Timing is being modified" 53 "Timing Value is being replaced" 54 "Acq Sat" 55 "No GPS" 56 "No Data" 22 "Non Critical Green LED" 23 "Non Critical Yellow LED" 24 "Non Critical Red LED" 25 "Non Critical Blue LED" 26 "Non Critical Grey LED" 28 "Critical Yellow LED" 29 "Critical Red LED" 30 "Critical Blue LED" 31 "Critical Grey LED";
VAL_ 2653163520 Status 0 "OK" 1 "Disabled" 2 "Initializing" 3 "Heating" 4 "WB_Active" 5 "Too Cold" 6 "Too Hot" 7 "Unplugged" 8 "Slow!" 9 "Uncal Yellow" 10 "Uncal Red" 11 "Replace" 12 "Disabled" 13 "Shorted" 14 "Open" 15 "Over Range" 16 "Under Range" 17 "Undefined" 18 "Error!" 19 "Low Error" 20 "High Error" 21 "Non Critical No LED" 27 "Critical Green LED" 32 "Stall!" 33 "Synchronized" 34 "Syncing" 35 "Error!" 36 "Error!" 37 "Uncalibrated" 38 "Open Loop" 39 "Closed Loop" 40 "Not Learn" 41 "Learning" 42 "Off" 43 "On" 44 "Not Rev Limiting" 45 "Rev Limit" 46 "No Cut Off" 47 "CutOff!" 48 "Off" 49 "Warning!" 50 "Caution!" 51 "No Timing modifier" 52 "Timing is being modified" 53 "Timing Value is being replaced" 54 "Acq Sat" 55 "No GPS" 56 "No Data" 22 "Non Critical Green LED" 23 "Non Critical Yellow LED" 24 "Non Critical Red LED" 25 "Non Critical Blue LED" 26 "Non Critical Grey LED" 28 "Critical Yellow LED" 29 "Critical Red LED" 30 "Critical Blue LED" 31 "Critical Grey LED";
VAL_ 2653179904 Status 0 "OK" 1 "Disabled" 2 "Initializing" 3 "Heating" 4 "WB_Active" 5 "Too Cold" 6 "Too Hot" 7 "Unplugged" 8 "Slow!" 9 "Uncal Yellow" 10 "Uncal Red" 11 "Replace" 12 "Disabled" 13 "Shorted" 14 "Open" 15 "Over Range" 16 "Under Range" 17 "Undefined" 18 "Error!" 19 "Low Error" 20 "High Error" 21 "Non Critical No LED" 27 "Critical Green LED" 32 "Stall!" 33 "Synchronized" 34 "Syncing" 35 "Error!" 36 "Error!" 37 "Uncalibrated" 38 "Open Loop" 39 "Closed Loop" 40 "Not Learn" 41 "Learning" 42 "Off" 43 "On" 44 "Not Rev Limiting" 45 "Rev Limit" 46 "No Cut Off" 47 "CutOff!" 48 "Off" 49 "Warning!" 50 "Caution!" 51 "No Timing modifier" 52 "Timing is being modified" 53 "Timing Value is being replaced" 54 "Acq Sat" 55 "No GPS" 56 "No Data" 22 "Non Critical Green LED" 23 "Non Critical Yellow LED" 24 "Non Critical Red LED" 25 "Non Critical Blue LED" 26 "Non Critical Grey LED" 28 "Critical Yellow LED" 29 "Critical Red LED" 30 "Critical Blue LED" 31 "Critical Grey LED";
VAL_ 2653196288 Status 0 "OK" 1 "Disabled" 2 "Initializing" 3 "Heating" 4 "WB_Active" 5 "Too Cold" 6 "Too Hot" 7 "Unplugged" 8 "Slow!" 9 "Uncal Yellow" 10 "Uncal Red" 11 "Replace" 12 "Disabled" 13 "Shorted" 14 "Open" 15 "Over Range" 16 "Under Range" 17 "Undefined" 18 "Error!" 19 "Low Error" 20 "High Error" 21 "Non Critical No LED" 27 "Critical Green LED" 32 "Stall!" 33 "Synchronized" 34 "Syncing" 35 "Error!" 36 "Error!" 37 "Uncalibrated" 38 "Open Loop" 39 "Closed Loop" 40 "Not Learn" 41 "Learning" 42 "Off" 43 "On" 44 "Not Rev Limiting" 45 "Rev Limit" 46 "No Cut Off" 47 "CutOff!" 48 "Off" 49 "Warning!" 50 "Caution!" 51 "No Timing modifier" 52 "Timing is being modified" 53 "Timing Value is being replaced" 54 "Acq Sat" 55 "No GPS" 56 "No Data" 22 "Non Critical Green LED" 23 "Non Critical Yellow LED" 24 "Non Critical Red LED" 25 "Non Critical Blue LED" 26 "Non Critical Grey LED" 28 "Critical Yellow LED" 29 "Critical Red LED" 30 "Critical Blue LED" 31 "Critical Grey LED";
VAL_ 2653212672 Status 0 "OK" 1 "Disabled" 2 "Initializing" 3 "Heating" 4 "WB_Active" 5 "Too Cold" 6 "Too Hot" 7 "Unplugged" 8 "Slow!" 9 "Uncal Yellow" 10 "Uncal Red" 11 "Replace" 12 "Disabled" 13 "Shorted" 14 "Open" 15 "Over Range" 16 "Under Range" 17 "Undefined" 18 "Error!" 19 "Low Error" 20 "High Error" 21 "Non Critical No LED" 27 "Critical Green LED" 32 "Stall!" 33 "Synchronized" 34 "Syncing" 35 "Error!" 36 "Error!" 37 "Uncalibrated" 38 "Open Loop" 39 "Closed Loop" 40 "Not Learn" 41 "Learning" 42 "Off" 43 "On" 44 "Not Rev Limiting" 45 "Rev Limit" 46 "No Cut Off" 47 "CutOff!" 48 "Off" 49 "Warning!" 50 "Caution!" 51 "No Timing modifier" 52 "Timing is being modified" 53 "Timing Value is being replaced" 54 "Acq Sat" 55 "No GPS" 56 "No Data" 22 "Non Critical Green LED" 23 "Non Critical Yellow LED" 24 "Non Critical Red LED" 25 "Non Critical Blue LED" 26 "Non Critical Grey LED" 28 "Critical Yellow LED" 29 "Critical Red LED" 30 "Critical Blue LED" 31 "Critical Grey LED";
VAL_ 2653229056 Status 0 "OK" 1 "Disabled" 2 "Initializing" 3 "Heating" 4 "WB_Active" 5 "Too Cold" 6 "Too Hot" 7 "Unplugged" 8 "Slow!" 9 "Uncal Yellow" 10 "Uncal Red" 11 "Replace" 12 "Disabled" 13 "Shorted" 14 "Open" 15 "Over Range" 16 "Under Range" 17 "Undefined" 18 "Error!" 19 "Low Error" 20 "High Error" 21 "Non Critical No LED" 27 "Critical Green LED" 32 "Stall!" 33 "Synchronized" 34 "Syncing" 35 "Error!" 36 "Error!" 37 "Uncalibrated" 38 "Open Loop" 39 "Closed Loop" 40 "Not Learn" 41 "Learning" 42 "Off" 43 "On" 44 "Not Rev Limiting" 45 "Rev Limit" 46 "No Cut Off" 47 "CutOff!" 48 "Off" 49 "Warning!" 50 "Caution!" 51 "No Timing modifier" 52 "Timing is being modified" 53 "Timing Value is being replaced" 54 "Acq Sat" 55 "No GPS" 56 "No Data" 22 "Non Critical Green LED" 23 "Non Critical Yellow LED" 24 "Non Critical Red LED" 25 "Non Critical Blue LED" 26 "Non Critical Grey LED" 28 "Critical Yellow LED" 29 "Critical Red LED" 30 "Critical Blue LED" 31 "Critical Grey LED";
VAL_ 2653245440 Status 0 "OK" 1 "Disabled" 2 "Initializing" 3 "Heating" 4 "WB_Active" 5 "Too Cold" 6 "Too Hot" 7 "Unplugged" 8 "Slow!" 9 "Uncal Yellow" 10 "Uncal Red" 11 "Replace" 12 "Disabled" 13 "Shorted" 14 "Open" 15 "Over Range" 16 "Under Range" 17 "Undefined" 18 "Error!" 19 "Low Error" 20 "High Error" 21 "Non Critical No LED" 27 "Critical Green LED" 32 "Stall!" 33 "Synchronized" 34 "Syncing" 35 "Error!" 36 "Error!" 37 "Uncalibrated" 38 "Open Loop" 39 "Closed Loop" 40 "Not Learn" 41 "Learning" 42 "Off" 43 "On" 44 "Not Rev Limiting" 45 "Rev Limit" 46 "No Cut Off" 47 "CutOff!" 48 "Off" 49 "Warning!" 50 "Caution!" 51 "No Timing modifier" 52 "Timing is being modified" 53 "Timing Value is being replaced" 54 "Acq Sat" 55 "No GPS" 56 "No Data" 22 "Non Critical Green LED" 23 "Non Critical Yellow LED" 24 "Non Critical Red LED" 25 "Non Critical Blue LED" 26 "Non Critical Grey LED" 28 "Critical Yellow LED" 29 "Critical Red LED" 30 "Critical Blue LED" 31 "Critical Grey LED";
VAL_ 2653261824 Status 0 "OK" 1 "Disabled" 2 "Initializing" 3 "Heating" 4 "WB_Active" 5 "Too Cold" 6 "Too Hot" 7 "Unplugged" 8 "Slow!" 9 "Uncal Yellow" 10 "Uncal Red" 11 "Replace" 12 "Disabled" 13 "Shorted" 14 "Open" 15 "Over Range" 16 "Under Range" 17 "Undefined" 18 "Error!" 19 "Low Error" 20 "High Error" 21 "Non Critical No LED" 27 "Critical Green LED" 32 "Stall!" 33 "Synchronized" 34 "Syncing" 35 "Error!" 36 "Error!" 37 "Uncalibrated" 38 "Open Loop" 39 "Closed Loop" 40 "Not Learn" 41 "Learning" 42 "Off" 43 "On" 44 "Not Rev Limiting" 45 "Rev Limit" 46 "No Cut Off" 47 "CutOff!" 48 "Off" 49 "Warning!" 50 "Caution!" 51 "No Timing modifier" 52 "Timing is being modified" 53 "Timing Value is being replaced" 54 "Acq Sat" 55 "No GPS" 56 "No Data" 22 "Non Critical Green LED" 23 "Non Critical Yellow LED" 24 "Non Critical Red LED" 25 "Non Critical Blue LED" 26 "Non Critical Grey LED" 28 "Critical Yellow LED" 29 "Critical Red LED" 30 "Critical Blue LED" 31 "Critical Grey LED";
VAL_ 2653278208 Status 0 "OK" 1 "Disabled" 2 "Initializing" 3 "Heating" 4 "WB_Active" 5 "Too Cold" 6 "Too Hot" 7 "Unplugged" 8 "Slow!" 9 "Uncal Yellow" 10 "Uncal Red" 11 "Replace" 12 "Disabled" 13 "Shorted" 14 "Open" 15 "Over Range" 16 "Under Range" 17 "Undefined" 18 "Error!" 19 "Low Error" 20 "High Error" 21 "Non Critical No LED" 27 "Critical Green LED" 32 "Stall!" 33 "Synchronized" 34 "Syncing" 35 "Error!" 36 "Error!" 37 "Uncalibrated" 38 "Open Loop" 39 "Closed Loop" 40 "Not Learn" 41 "Learning" 42 "Off" 43 "On" 44 "Not Rev Limiting" 45 "Rev Limit" 46 "No Cut Off" 47 "CutOff!" 48 "Off" 49 "Warning!" 50 "Caution!" 51 "No Timing modifier" 52 "Timing is being modified" 53 "Timing Value is being replaced" 54 "Acq Sat" 55 "No GPS" 56 "No Data" 22 "Non Critical Green LED" 23 "Non Critical Yellow LED" 24 "Non Critical Red LED" 25 "Non Critical Blue LED" 26 "Non Critical Grey LED" 28 "Critical Yellow LED" 29 "Critical Red LED" 30 "Critical Blue LED" 31 "Critical Grey LED";
VAL_ 2653294592 Status 0 "OK" 1 "Disabled" 2 "Initializing" 3 "Heating" 4 "WB_Active" 5 "Too Cold" 6 "Too Hot" 7 "Unplugged" 8 "Slow!" 9 "Uncal Yellow" 10 "Uncal Red" 11 "Replace" 12 "Disabled" 13 "Shorted" 14 "Open" 15 "Over Range" 16 "Under Range" 17 "Undefined" 18 "Error!" 19 "Low Error" 20 "High Error" 21 "Non Critical No LED" 27 "Critical Green LED" 32 "Stall!" 33 "Synchronized" 34 "Syncing" 35 "Error!" 36 "Error!" 37 "Uncalibrated" 38 "Open Loop" 39 "Closed Loop" 40 "Not Learn" 41 "Learning" 42 "Off" 43 "On" 44 "Not Rev Limiting" 45 "Rev Limit" 46 "No Cut Off" 47 "CutOff!" 48 "Off" 49 "Warning!" 50 "Caution!" 51 "No Timing modifier" 52 "Timing is being modified" 53 "Timing Value is being replaced" 54 "Acq Sat" 55 "No GPS" 56 "No Data" 22 "Non Critical Green LED" 23 "Non Critical Yellow LED" 24 "Non Critical Red LED" 25 "Non Critical Blue LED" 26 "Non Critical Grey LED" 28 "Critical Yellow LED" 29 "Critical Red LED" 30 "Critical Blue LED" 31 "Critical Grey LED";
VAL_ 2653310976 Status 0 "OK" 1 "Disabled" 2 "Initializing" 3 "Heating" 4 "WB_Active" 5 "Too Cold" 6 "Too Hot" 7 "Unplugged" 8 "Slow!" 9 "Uncal Yellow" 10 "Uncal Red" 11 "Replace" 12 "Disabled" 13 "Shorted" 14 "Open" 15 "Over Range" 16 "Under Range" 17 "Undefined" 18 "Error!" 19 "Low Error" 20 "High Error" 21 "Non Critical No LED" 27 "Critical Green LED" 32 "Stall!" 33 "Synchronized" 34 "Syncing" 35 "Error!" 36 "Error!" 37 "Uncalibrated" 38 "Open Loop" 39 "Closed Loop" 40 "Not Learn" 41 "Learning" 42 "Off" 43 "On" 44 "Not Rev Limiting" 45 "Rev Limit" 46 "No Cut Off" 47 "CutOff!" 48 "Off" 49 "Warning!" 50 "Caution!" 51 "No Timing modifier" 52 "Timing is being modified" 53 "Timing Value is being replaced" 54 "Acq Sat" 55 "No GPS" 56 "No Data" 22 "Non Critical Green LED" 23 "Non Critical Yellow LED" 24 "Non Critical Red LED" 25 "Non Critical Blue LED" 26 "Non Critical Grey LED" 28 "Critical Yellow LED" 29 "Critical Red LED" 30 "Critical Blue LED" 31 "Critical Grey LED";
VAL_ 2653327360 Status 0 "OK" 1 "Disabled" 2 "Initializing" 3 "Heating" 4 "WB_Active" 5 "Too Cold" 6 "Too Hot" 7 "Unplugged" 8 "Slow!" 9 "Uncal Yellow" 10 "Uncal Red" 11 "Replace" 12 "Disabled" 13 "Shorted" 14 "Open" 15 "Over Range" 16 "Under Range" 17 "Undefined" 18 "Error!" 19 "Low Error" 20 "High Error" 21 "Non Critical No LED" 27 "Critical Green LED" 32 "Stall!" 33 "Synchronized" 34 "Syncing" 35 "Error!" 36 "Error!" 37 "Uncalibrated" 38 "Open Loop" 39 "Closed Loop" 40 "Not Learn" 41 "Learning" 42 "Off" 43 "On" 44 "Not Rev Limiting" 45 "Rev Limit" 46 "No Cut Off" 47 "CutOff!" 48 "Off" 49 "Warning!" 50 "Caution!" 51 "No Timing modifier" 52 "Timing is being modified" 53 "Timing Value is being replaced" 54 "Acq Sat" 55 "No GPS" 56 "No Data" 22 "Non Critical Green LED" 23 "Non Critical Yellow LED" 24 "Non Critical Red LED" 25 "Non Critical Blue LED" 26 "Non Critical Grey LED" 28 "Critical Yellow LED" 29 "Critical Red LED" 30 "Critical Blue LED" 31 "Critical Grey LED";
VAL_ 2653343744 Status 0 "OK" 1 "Disabled" 2 "Initializing" 3 "Heating" 4 "WB_Active" 5 "Too Cold" 6 "Too Hot" 7 "Unplugged" 8 "Slow!" 9 "Uncal Yellow" 10 "Uncal Red" 11 "Replace" 12 "Disabled" 13 "Shorted" 14 "Open" 15 "Over Range" 16 "Under Range" 17 "Undefined" 18 "Error!" 19 "Low Error" 20 "High Error" 21 "Non Critical No LED" 27 "Critical Green LED" 32 "Stall!" 33 "Synchronized" 34 "Syncing" 35 "Error!" 36 "Error!" 37 "Uncalibrated" 38 "Open Loop" 39 "Closed Loop" 40 "Not Learn" 41 "Learning" 42 "Off" 43 "On" 44 "Not Rev Limiting" 45 "Rev Limit" 46 "No Cut Off" 47 "CutOff!" 48 "Off" 49 "Warning!" 50 "Caution!" 51 "No Timing modifier" 52 "Timing is being modified" 53 "Timing Value is being replaced" 54 "Acq Sat" 55 "No GPS" 56 "No Data" 22 "Non Critical Green LED" 23 "Non Critical Yellow LED" 24 "Non Critical Red LED" 25 "Non Critical Blue LED" 26 "Non Critical Grey LED" 28 "Critical Yellow LED" 29 "Critical Red LED" 30 "Critical Blue LED" 31 "Critical Grey LED";
VAL_ 2653360128 Status 0 "OK" 1 "Disabled" 2 "Initializing" 3 "Heating" 4 "WB_Active" 5 "Too Cold" 6 "Too Hot" 7 "Unplugged" 8 "Slow!" 9 "Uncal Yellow" 10 "Uncal Red" 11 "Replace" 12 "Disabled" 13 "Shorted" 14 "Open" 15 "Over Range" 16 "Under Range" 17 "Undefined" 18 "Error!" 19 "Low Error" 20 "High Error" 21 "Non Critical No LED" 27 "Critical Green LED" 32 "Stall!" 33 "Synchronized" 34 "Syncing" 35 "Error!" 36 "Error!" 37 "Uncalibrated" 38 "Open Loop" 39 "Closed Loop" 40 "Not Learn" 41 "Learning" 42 "Off" 43 "On" 44 "Not Rev Limiting" 45 "Rev Limit" 46 "No Cut Off" 47 "CutOff!" 48 "Off" 49 "Warning!" 50 "Caution!" 51 "No Timing modifier" 52 "Timing is being modified" 53 "Timing Value is being replaced" 54 "Acq Sat" 55 "No GPS" 56 "No Data" 22 "Non Critical Green LED" 23 "Non Critical Yellow LED" 24 "Non Critical Red LED" 25 "Non Critical Blue LED" 26 "Non Critical Grey LED" 28 "Critical Yellow LED" 29 "Critical Red LED" 30 "Critical Blue LED" 31 "Critical Grey LED";
VAL_ 2653376512 Status 0 "OK" 1 "Disabled" 2 "Initializing" 3 "Heating" 4 "WB_Active" 5 "Too Cold" 6 "Too Hot" 7 "Unplugged" 8 "Slow!" 9 "Uncal Yellow" 10 "Uncal Red" 11 "Replace" 12 "Disabled" 13 "Shorted" 14 "Open" 15 "Over Range" 16 "Under Range" 17 "Undefined" 18 "Error!" 19 "Low Error" 20 "High Error" 21 "Non Critical No LED" 27 "Critical Green LED" 32 "Stall!" 33 "Synchronized" 34 "Syncing" 35 "Error!" 36 "Error!" 37 "Uncalibrated" 38 "Open Loop" 39 "Closed Loop" 40 "Not Learn" 41 "Learning" 42 "Off" 43 "On" 44 "Not Rev Limiting" 45 "Rev Limit" 46 "No Cut Off" 47 "CutOff!" 48 "Off" 49 "Warning!" 50 "Caution!" 51 "No Timing modifier" 52 "Timing is being modified" 53 "Timing Value is being replaced" 54 "Acq Sat" 55 "No GPS" 56 "No Data" 22 "Non Critical Green LED" 23 "Non Critical Yellow LED" 24 "Non Critical Red LED" 25 "Non Critical Blue LED" 26 "Non Critical Grey LED" 28 "Critical Yellow LED" 29 "Critical Red LED" 30 "Critical Blue LED" 31 "Critical Grey LED";
VAL_ 2653425664 Status 0 "OK" 1 "Disabled" 2 "Initializing" 3 "Heating" 4 "WB_Active" 5 "Too Cold" 6 "Too Hot" 7 "Unplugged" 8 "Slow!" 9 "Uncal Yellow" 10 "Uncal Red" 11 "Replace" 12 "Disabled" 13 "Shorted" 14 "Open" 15 "Over Range" 16 "Under Range" 17 "Undefined" 18 "Error!" 19 "Low Error" 20 "High Error" 21 "Non Critical No LED" 27 "Critical Green LED" 32 "Stall!" 33 "Synchronized" 34 "Syncing" 35 "Error!" 36 "Error!" 37 "Uncalibrated" 38 "Open Loop" 39 "Closed Loop" 40 "Not Learn" 41 "Learning" 42 "Off" 43 "On" 44 "Not Rev Limiting" 45 "Rev Limit" 46 "No Cut Off" 47 "CutOff!" 48 "Off" 49 "Warning!" 50 "Caution!" 51 "No Timing modifier" 52 "Timing is being modified" 53 "Timing Value is being replaced" 54 "Acq Sat" 55 "No GPS" 56 "No Data" 22 "Non Critical Green LED" 23 "Non Critical Yellow LED" 24 "Non Critical Red LED" 25 "Non Critical Blue LED" 26 "Non Critical Grey LED" 28 "Critical Yellow LED" 29 "Critical Red LED" 30 "Critical Blue LED" 31 "Critical Grey LED";
VAL_ 2653442048 Status 0 "OK" 1 "Disabled" 2 "Initializing" 3 "Heating" 4 "WB_Active" 5 "Too Cold" 6 "Too Hot" 7 "Unplugged" 8 "Slow!" 9 "Uncal Yellow" 10 "Uncal Red" 11 "Replace" 12 "Disabled" 13 "Shorted" 14 "Open" 15 "Over Range" 16 "Under Range" 17 "Undefined" 18 "Error!" 19 "Low Error" 20 "High Error" 21 "Non Critical No LED" 27 "Critical Green LED" 32 "Stall!" 33 "Synchronized" 34 "Syncing" 35 "Error!" 36 "Error!" 37 "Uncalibrated" 38 "Open Loop" 39 "Closed Loop" 40 "Not Learn" 41 "Learning" 42 "Off" 43 "On" 44 "Not Rev Limiting" 45 "Rev Limit" 46 "No Cut Off" 47 "CutOff!" 48 "Off" 49 "Warning!" 50 "Caution!" 51 "No Timing modifier" 52 "Timing is being modified" 53 "Timing Value is being replaced" 54 "Acq Sat" 55 "No GPS" 56 "No Data" 22 "Non Critical Green LED" 23 "Non Critical Yellow LED" 24 "Non Critical Red LED" 25 "Non Critical Blue LED" 26 "Non Critical Grey LED" 28 "Critical Yellow LED" 29 "Critical Red LED" 30 "Critical Blue LED" 31 "Critical Grey LED";
VAL_ 2653458432 Status 0 "OK" 1 "Disabled" 2 "Initializing" 3 "Heating" 4 "WB_Active" 5 "Too Cold" 6 "Too Hot" 7 "Unplugged" 8 "Slow!" 9 "Uncal Yellow" 10 "Uncal Red" 11 "Replace" 12 "Disabled" 13 "Shorted" 14 "Open" 15 "Over Range" 16 "Under Range" 17 "Undefined" 18 "Error!" 19 "Low Error" 20 "High Error" 21 "Non Critical No LED" 27 "Critical Green LED" 32 "Stall!" 33 "Synchronized" 34 "Syncing" 35 "Error!" 36 "Error!" 37 "Uncalibrated" 38 "Open Loop" 39 "Closed Loop" 40 "Not Learn" 41 "Learning" 42 "Off" 43 "On" 44 "Not Rev Limiting" 45 "Rev Limit" 46 "No Cut Off" 47 "CutOff!" 48 "Off" 49 "Warning!" 50 "Caution!" 51 "No Timing modifier" 52 "Timing is being modified" 53 "Timing Value is being replaced" 54 "Acq Sat" 55 "No GPS" 56 "No Data" 22 "Non Critical Green LED" 23 "Non Critical Yellow LED" 24 "Non Critical Red LED" 25 "Non Critical Blue LED" 26 "Non Critical Grey LED" 28 "Critical Yellow LED" 29 "Critical Red LED" 30 "Critical Blue LED" 31 "Critical Grey LED";
VAL_ 2653474816 Status 0 "OK" 1 "Disabled" 2 "Initializing" 3 "Heating" 4 "WB_Active" 5 "Too Cold" 6 "Too Hot" 7 "Unplugged" 8 "Slow!" 9 "Uncal Yellow" 10 "Uncal Red" 11 "Replace" 12 "Disabled" 13 "Shorted" 14 "Open" 15 "Over Range" 16 "Under Range" 17 "Undefined" 18 "Error!" 19 "Low Error" 20 "High Error" 21 "Non Critical No LED" 27 "Critical Green LED" 32 "Stall!" 33 "Synchronized" 34 "Syncing" 35 "Error!" 36 "Error!" 37 "Uncalibrated" 38 "Open Loop" 39 "Closed Loop" 40 "Not Learn" 41 "Learning" 42 "Off" 43 "On" 44 "Not Rev Limiting" 45 "Rev Limit" 46 "No Cut Off" 47 "CutOff!" 48 "Off" 49 "Warning!" 50 "Caution!" 51 "No Timing modifier" 52 "Timing is being modified" 53 "Timing Value is being replaced" 54 "Acq Sat" 55 "No GPS" 56 "No Data" 22 "Non Critical Green LED" 23 "Non Critical Yellow LED" 24 "Non Critical Red LED" 25 "Non Critical Blue LED" 26 "Non Critical Grey LED" 28 "Critical Yellow LED" 29 "Critical Red LED" 30 "Critical Blue LED" 31 "Critical Grey LED";
VAL_ 2653491200 Status 0 "OK" 1 "Disabled" 2 "Initializing" 3 "Heating" 4 "WB_Active" 5 "Too Cold" 6 "Too Hot" 7 "Unplugged" 8 "Slow!" 9 "Uncal Yellow" 10 "Uncal Red" 11 "Replace" 12 "Disabled" 13 "Shorted" 14 "Open" 15 "Over Range" 16 "Under Range" 17 "Undefined" 18 "Error!" 19 "Low Error" 20 "High Error" 21 "Non Critical No LED" 27 "Critical Green LED" 32 "Stall!" 33 "Synchronized" 34 "Syncing" 35 "Error!" 36 "Error!" 37 "Uncalibrated" 38 "Open Loop" 39 "Closed Loop" 40 "Not Learn" 41 "Learning" 42 "Off" 43 "On" 44 "Not Rev Limiting" 45 "Rev Limit" 46 "No Cut Off" 47 "CutOff!" 48 "Off" 49 "Warning!" 50 "Caution!" 51 "No Timing modifier" 52 "Timing is being modified" 53 "Timing Value is being replaced" 54 "Acq Sat" 55 "No GPS" 56 "No Data" 22 "Non Critical Green LED" 23 "Non Critical Yellow LED" 24 "Non Critical Red LED" 25 "Non Critical Blue LED" 26 "Non Critical Grey LED" 28 "Critical Yellow LED" 29 "Critical Red LED" 30 "Critical Blue LED" 31 "Critical Grey LED";
VAL_ 2653507584 Status 0 "OK" 1 "Disabled" 2 "Initializing" 3 "Heating" 4 "WB_Active" 5 "Too Cold" 6 "Too Hot" 7 "Unplugged" 8 "Slow!" 9 "Uncal Yellow" 10 "Uncal Red" 11 "Replace" 12 "Disabled" 13 "Shorted" 14 "Open" 15 "Over Range" 16 "Under Range" 17 "Undefined" 18 "Error!" 19 "Low Error" 20 "High Error" 21 "Non Critical No LED" 27 "Critical Green LED" 32 "Stall!" 33 "Synchronized" 34 "Syncing" 35 "Error!" 36 "Error!" 37 "Uncalibrated" 38 "Open Loop" 39 "Closed Loop" 40 "Not Learn" 41 "Learning" 42 "Off" 43 "On" 44 "Not Rev Limiting" 45 "Rev Limit" 46 "No Cut Off" 47 "CutOff!" 48 "Off" 49 "Warning!" 50 "Caution!" 51 "No Timing modifier" 52 "Timing is being modified" 53 "Timing Value is being replaced" 54 "Acq Sat" 55 "No GPS" 56 "No Data" 22 "Non Critical Green LED" 23 "Non Critical Yellow LED" 24 "Non Critical Red LED" 25 "Non Critical Blue LED" 26 "Non Critical Grey LED" 28 "Critical Yellow LED" 29 "Critical Red LED" 30 "Critical Blue LED" 31 "Critical Grey LED";
VAL_ 2653523968 Status 0 "OK" 1 "Disabled" 2 "Initializing" 3 "Heating" 4 "WB_Active" 5 "Too Cold" 6 "Too Hot" 7 "Unplugged" 8 "Slow!" 9 "Uncal Yellow" 10 "Uncal Red" 11 "Replace" 12 "Disabled" 13 "Shorted" 14 "Open" 15 "Over Range" 16 "Under Range" 17 "Undefined" 18 "Error!" 19 "Low Error" 20 "High Error" 21 "Non Critical No LED" 27 "Critical Green LED" 32 "Stall!" 33 "Synchronized" 34 "Syncing" 35 "Error!" 36 "Error!" 37 "Uncalibrated" 38 "Open Loop" 39 "Closed Loop" 40 "Not Learn" 41 "Learning" 42 "Off" 43 "On" 44 "Not Rev Limiting" 45 "Rev Limit" 46 "No Cut Off" 47 "CutOff!" 48 "Off" 49 "Warning!" 50 "Caution!" 51 "No Timing modifier" 52 "Timing is being modified" 53 "Timing Value is being replaced" 54 "Acq Sat" 55 "No GPS" 56 "No Data" 22 "Non Critical Green LED" 23 "Non Critical Yellow LED" 24 "Non Critical Red LED" 25 "Non Critical Blue LED" 26 "Non Critical Grey LED" 28 "Critical Yellow LED" 29 "Critical Red LED" 30 "Critical Blue LED" 31 "Critical Grey LED";
VAL_ 2653540352 Status 0 "OK" 1 "Disabled" 2 "Initializing" 3 "Heating" 4 "WB_Active" 5 "Too Cold" 6 "Too Hot" 7 "Unplugged" 8 "Slow!" 9 "Uncal Yellow" 10 "Uncal Red" 11 "Replace" 12 "Disabled" 13 "Shorted" 14 "Open" 15 "Over Range" 16 "Under Range" 17 "Undefined" 18 "Error!" 19 "Low Error" 20 "High Error" 21 "Non Critical No LED" 27 "Critical Green LED" 32 "Stall!" 33 "Synchronized" 34 "Syncing" 35 "Error!" 36 "Error!" 37 "Uncalibrated" 38 "Open Loop" 39 "Closed Loop" 40 "Not Learn" 41 "Learning" 42 "Off" 43 "On" 44 "Not Rev Limiting" 45 "Rev Limit" 46 "No Cut Off" 47 "CutOff!" 48 "Off" 49 "Warning!" 50 "Caution!" 51 "No Timing modifier" 52 "Timing is being modified" 53 "Timing Value is being replaced" 54 "Acq Sat" 55 "No GPS" 56 "No Data" 22 "Non Critical Green LED" 23 "Non Critical Yellow LED" 24 "Non Critical Red LED" 25 "Non Critical Blue LED" 26 "Non Critical Grey LED" 28 "Critical Yellow LED" 29 "Critical Red LED" 30 "Critical Blue LED" 31 "Critical Grey LED";
VAL_ 2653556736 Status 0 "OK" 1 "Disabled" 2 "Initializing" 3 "Heating" 4 "WB_Active" 5 "Too Cold" 6 "Too Hot" 7 "Unplugged" 8 "Slow!" 9 "Uncal Yellow" 10 "Uncal Red" 11 "Replace" 12 "Disabled" 13 "Shorted" 14 "Open" 15 "Over Range" 16 "Under Range" 17 "Undefined" 18 "Error!" 19 "Low Error" 20 "High Error" 21 "Non Critical No LED" 27 "Critical Green LED" 32 "Stall!" 33 "Synchronized" 34 "Syncing" 35 "Error!" 36 "Error!" 37 "Uncalibrated" 38 "Open Loop" 39 "Closed Loop" 40 "Not Learn" 41 "Learning" 42 "Off" 43 "On" 44 "Not Rev Limiting" 45 "Rev Limit" 46 "No Cut Off" 47 "CutOff!" 48 "Off" 49 "Warning!" 50 "Caution!" 51 "No Timing modifier" 52 "Timing is being modified" 53 "Timing Value is being replaced" 54 "Acq Sat" 55 "No GPS" 56 "No Data" 22 "Non Critical Green LED" 23 "Non Critical Yellow LED" 24 "Non Critical Red LED" 25 "Non Critical Blue LED" 26 "Non Critical Grey LED" 28 "Critical Yellow LED" 29 "Critical Red LED" 30 "Critical Blue LED" 31 "Critical Grey LED";
VAL_ 2653573120 Status 0 "OK" 1 "Disabled" 2 "Initializing" 3 "Heating" 4 "WB_Active" 5 "Too Cold" 6 "Too Hot" 7 "Unplugged" 8 "Slow!" 9 "Uncal Yellow" 10 "Uncal Red" 11 "Replace" 12 "Disabled" 13 "Shorted" 14 "Open" 15 "Over Range" 16 "Under Range" 17 "Undefined" 18 "Error!" 19 "Low Error" 20 "High Error" 21 "Non Critical No LED" 27 "Critical Green LED" 32 "Stall!" 33 "Synchronized" 34 "Syncing" 35 "Error!" 36 "Error!" 37 "Uncalibrated" 38 "Open Loop" 39 "Closed Loop" 40 "Not Learn" 41 "Learning" 42 "Off" 43 "On" 44 "Not Rev Limiting" 45 "Rev Limit" 46 "No Cut Off" 47 "CutOff!" 48 "Off" 49 "Warning!" 50 "Caution!" 51 "No Timing modifier" 52 "Timing is being modified" 53 "Timing Value is being replaced" 54 "Acq Sat" 55 "No GPS" 56 "No Data" 22 "Non Critical Green LED" 23 "Non Critical Yellow LED" 24 "Non Critical Red LED" 25 "Non Critical Blue LED" 26 "Non Critical Grey LED" 28 "Critical Yellow LED" 29 "Critical Red LED" 30 "Critical Blue LED" 31 "Critical Grey LED";
VAL_ 2653589504 Status 0 "OK" 1 "Disabled" 2 "Initializing" 3 "Heating" 4 "WB_Active" 5 "Too Cold" 6 "Too Hot" 7 "Unplugged" 8 "Slow!" 9 "Uncal Yellow" 10 "Uncal Red" 11 "Replace" 12 "Disabled" 13 "Shorted" 14 "Open" 15 "Over Range" 16 "Under Range" 17 "Undefined" 18 "Error!" 19 "Low Error" 20 "High Error" 21 "Non Critical No LED" 27 "Critical Green LED" 32 "Stall!" 33 "Synchronized" 34 "Syncing" 35 "Error!" 36 "Error!" 37 "Uncalibrated" 38 "Open Loop" 39 "Closed Loop" 40 "Not Learn" 41 "Learning" 42 "Off" 43 "On" 44 "Not Rev Limiting" 45 "Rev Limit" 46 "No Cut Off" 47 "CutOff!" 48 "Off" 49 "Warning!" 50 "Caution!" 51 "No Timing modifier" 52 "Timing is being modified" 53 "Timing Value is being replaced" 54 "Acq Sat" 55 "No GPS" 56 "No Data" 22 "Non Critical Green LED" 23 "Non Critical Yellow LED" 24 "Non Critical Red LED" 25 "Non Critical Blue LED" 26 "Non Critical Grey LED" 28 "Critical Yellow LED" 29 "Critical Red LED" 30 "Critical Blue LED" 31 "Critical Grey LED";
VAL_ 2653605888 Status 0 "OK" 1 "Disabled" 2 "Initializing" 3 "Heating" 4 "WB_Active" 5 "Too Cold" 6 "Too Hot" 7 "Unplugged" 8 "Slow!" 9 "Uncal Yellow" 10 "Uncal Red" 11 "Replace" 12 "Disabled" 13 "Shorted" 14 "Open" 15 "Over Range" 16 "Under Range" 17 "Undefined" 18 "Error!" 19 "Low Error" 20 "High Error" 21 "Non Critical No LED" 27 "Critical Green LED" 32 "Stall!" 33 "Synchronized" 34 "Syncing" 35 "Error!" 36 "Error!" 37 "Uncalibrated" 38 "Open Loop" 39 "Closed Loop" 40 "Not Learn" 41 "Learning" 42 "Off" 43 "On" 44 "Not Rev Limiting" 45 "Rev Limit" 46 "No Cut Off" 47 "CutOff!" 48 "Off" 49 "Warning!" 50 "Caution!" 51 "No Timing modifier" 52 "Timing is being modified" 53 "Timing Value is being replaced" 54 "Acq Sat" 55 "No GPS" 56 "No Data" 22 "Non Critical Green LED" 23 "Non Critical Yellow LED" 24 "Non Critical Red LED" 25 "Non Critical Blue LED" 26 "Non Critical Grey LED" 28 "Critical Yellow LED" 29 "Critical Red LED" 30 "Critical Blue LED" 31 "Critical Grey LED";
VAL_ 2653622272 Status 0 "OK" 1 "Disabled" 2 "Initializing" 3 "Heating" 4 "WB_Active" 5 "Too Cold" 6 "Too Hot" 7 "Unplugged" 8 "Slow!" 9 "Uncal Yellow" 10 "Uncal Red" 11 "Replace" 12 "Disabled" 13 "Shorted" 14 "Open" 15 "Over Range" 16 "Under Range" 17 "Undefined" 18 "Error!" 19 "Low Error" 20 "High Error" 21 "Non Critical No LED" 27 "Critical Green LED" 32 "Stall!" 33 "Synchronized" 34 "Syncing" 35 "Error!" 36 "Error!" 37 "Uncalibrated" 38 "Open Loop" 39 "Closed Loop" 40 "Not Learn" 41 "Learning" 42 "Off" 43 "On" 44 "Not Rev Limiting" 45 "Rev Limit" 46 "No Cut Off" 47 "CutOff!" 48 "Off" 49 "Warning!" 50 "Caution!" 51 "No Timing modifier" 52 "Timing is being modified" 53 "Timing Value is being replaced" 54 "Acq Sat" 55 "No GPS" 56 "No Data" 22 "Non Critical Green LED" 23 "Non Critical Yellow LED" 24 "Non Critical Red LED" 25 "Non Critical Blue LED" 26 "Non Critical Grey LED" 28 "Critical Yellow LED" 29 "Critical Red LED" 30 "Critical Blue LED" 31 "Critical Grey LED";
VAL_ 2653638656 Status 0 "OK" 1 "Disabled" 2 "Initializing" 3 "Heating" 4 "WB_Active" 5 "Too Cold" 6 "Too Hot" 7 "Unplugged" 8 "Slow!" 9 "Uncal Yellow" 10 "Uncal Red" 11 "Replace" 12 "Disabled" 13 "Shorted" 14 "Open" 15 "Over Range" 16 "Under Range" 17 "Undefined" 18 "Error!" 19 "Low Error" 20 "High Error" 21 "Non Critical No LED" 27 "Critical Green LED" 32 "Stall!" 33 "Synchronized" 34 "Syncing" 35 "Error!" 36 "Error!" 37 "Uncalibrated" 38 "Open Loop" 39 "Closed Loop" 40 "Not Learn" 41 "Learning" 42 "Off" 43 "On" 44 "Not Rev Limiting" 45 "Rev Limit" 46 "No Cut Off" 47 "CutOff!" 48 "Off" 49 "Warning!" 50 "Caution!" 51 "No Timing modifier" 52 "Timing is being modified" 53 "Timing Value is being replaced" 54 "Acq Sat" 55 "No GPS" 56 "No Data" 22 "Non Critical Green LED" 23 "Non Critical Yellow LED" 24 "Non Critical Red LED" 25 "Non Critical Blue LED" 26 "Non Critical Grey LED" 28 "Critical Yellow LED" 29 "Critical Red LED" 30 "Critical Blue LED" 31 "Critical Grey LED";

SIG_VALTYPE_ 2650820608 RPM : 1;
SIG_VALTYPE_ 2650836992 Inj_PW : 1;
SIG_VALTYPE_ 2650853376 Duty_Cycle : 1;
SIG_VALTYPE_ 2650869760 CL_Comp : 1;
SIG_VALTYPE_ 2650886144 Target_AFR : 1;
SIG_VALTYPE_ 2650902528 AFR_Left : 1;
SIG_VALTYPE_ 2650918912 AFR_Right : 1;
SIG_VALTYPE_ 2650935296 AFR_Average : 1;
SIG_VALTYPE_ 2650951680 Air_Temp_Enr : 1;
SIG_VALTYPE_ 2650968064 Coolant_Enr : 1;
SIG_VALTYPE_ 2650984448 Coolant_AFR_Offset : 1;
SIG_VALTYPE_ 2651000832 Afterstart_Enr : 1;
SIG_VALTYPE_ 2651017216 Current_Learn : 1;
SIG_VALTYPE_ 2651033600 CL_Status : 1;
SIG_VALTYPE_ 2651049984 Learn_Status : 1;
SIG_VALTYPE_ 2651066368 Fuel_Economy : 1;
SIG_VALTYPE_ 2651082752 Fuel_Flow : 1;
SIG_VALTYPE_ 2651099136 MAP_RoC : 1;
SIG_VALTYPE_ 2651115520 TPS_RoC : 1;
SIG_VALTYPE_ 2651131904 Tuning_Change : 1;
SIG_VALTYPE_ 2651148288 Estimated_VE : 1;
SIG_VALTYPE_ 2651164672 Ignition_Timing : 1;
SIG_VALTYPE_ 2651181056 Knock_Retard : 1;
SIG_VALTYPE_ 2651197440 Knock_Level : 1;
SIG_VALTYPE_ 2651230208 IAC_Position : 1;
SIG_VALTYPE_ 2651246592 Target_Idle_Speed : 1;
SIG_VALTYPE_ 2651262976 MAP : 1;
SIG_VALTYPE_ 2651279360 TPS : 1;
SIG_VALTYPE_ 2651295744 MAT : 1;
SIG_VALTYPE_ 2651312128 CTS : 1;
SIG_VALTYPE_ 2651328512 Baro : 1;
SIG_VALTYPE_ 2651344896 Battery : 1;
SIG_VALTYPE_ 2651361280 Oil_Pressure : 1;
SIG_VALTYPE_ 2651377664 Fuel_Pressure : 1;
SIG_VALTYPE_ 2651394048 Pedal_Position : 1;
SIG_VALTYPE_ 2651410432 Main_Rev_Limit : 1;
SIG_VALTYPE_ 2651426816 Rev_Limit_1 : 1;
SIG_VALTYPE_ 2651443200 Rev_Limit_2 : 1;
SIG_VALTYPE_ 2651459584 AC_Kick : 1;
SIG_VALTYPE_ 2651475968 Timing_Retard_1 : 1;
SIG_VALTYPE_ 2651492352 Timing_Retard_2 : 1;
SIG_VALTYPE_ 2651508736 Timing_Retard_3 : 1;
SIG_VALTYPE_ 2651525120 Fan_1 : 1;
SIG_VALTYPE_ 2651541504 Fan_2 : 1;
SIG_VALTYPE_ 2651557888 Fuel_Pump_2 : 1;
SIG_VALTYPE_ 2651574272 AC_Shutdown : 1;
SIG_VALTYPE_ 2651590656 TCC_Lockup : 1;
SIG_VALTYPE_ 2651607040 Sensor_Warning : 1;
SIG_VALTYPE_ 2651623424 Sensor_Caution : 1;
SIG_VALTYPE_ 2651639808 Base_Fuel_lbhr : 1;
SIG_VALTYPE_ 2651656192 Base_Fuel_VE : 1;
SIG_VALTYPE_ 2651672576 Base_Timing : 1;
SIG_VALTYPE_ 2651688960 Base_Target_AFR : 1;
SIG_VALTYPE_ 2651705344 Base_Ign_Dwell : 1;
SIG_VALTYPE_ 2651721728 Vol_Comp_Ign_Dwell : 1;
SIG_VALTYPE_ 2651738112 Inj_End_Angle : 1;
SIG_VALTYPE_ 2651754496 ECU_Log_Trigger : 1;
SIG_VALTYPE_ 2651770880 Timing_vs_Air : 1;
SIG_VALTYPE_ 2651787264 Timing_vs_Cool : 1;
SIG_VALTYPE_ 2651803648 Status_1 : 1;
SIG_VALTYPE_ 2651820032 Status_2 : 1;
SIG_VALTYPE_ 2651836416 Status_3 : 1;
SIG_VALTYPE_ 2651852800 Status_4 : 1;
SIG_VALTYPE_ 2651869184 Status_5 : 1;
SIG_VALTYPE_ 2651885568 Status_6 : 1;
SIG_VALTYPE_ 2651901952 Status_7 : 1;
SIG_VALTYPE_ 2651918336 Status_8 : 1;
SIG_VALTYPE_ 2651934720 Injector_1_PPH : 1;
SIG_VALTYPE_ 2651951104 Injector_2_PPH : 1;
SIG_VALTYPE_ 2651967488 Injector_3_PPH : 1;
SIG_VALTYPE_ 2651983872 Injector_4_PPH : 1;
SIG_VALTYPE_ 2652000256 Injector_5_PPH : 1;
SIG_VALTYPE_ 2652016640 Injector_6_PPH : 1;
SIG_VALTYPE_ 2652033024 Injector_7_PPH : 1;
SIG_VALTYPE_ 2652049408 Injector_8_PPH : 1;
SIG_VALTYPE_ 2652065792 Injector_9_PPH : 1;
SIG_VALTYPE_ 2652082176 Injector_10_PPH : 1;
SIG_VALTYPE_ 2652098560 Injector_11_PPH : 1;
SIG_VALTYPE_ 2652114944 Injector_12_PPH : 1;
SIG_VALTYPE_ 2652131328 Injector_1_PW : 1;
SIG_VALTYPE_ 2652147712 Injector_2_PW : 1;
SIG_VALTYPE_ 2652164096 Injector_3_PW : 1;
SIG_VALTYPE_ 2652180480 Injector_4_PW : 1;
SIG_VALTYPE_ 2652196864 Injector_5_PW : 1;
SIG_VALTYPE_ 2652213248 Injector_6_PW : 1;
SIG_VALTYPE_ 2652229632 Injector_7_PW : 1;
SIG_VALTYPE_ 2652246016 Injector_8_PW : 1;
SIG_VALTYPE_ 2652262400 Injector_9_PW : 1;
SIG_VALTYPE_ 2652278784 Injector_10_PW : 1;
SIG_VALTYPE_ 2652295168 Injector_11_PW : 1;
SIG_VALTYPE_ 2652311552 Injector_12_PW : 1;
SIG_VALTYPE_ 2652327936 Cyl_1_Fuel_Cor : 1;
SIG_VALTYPE_ 2652344320 Cyl_2_Fuel_Cor : 1;
SIG_VALTYPE_ 2652360704 Cyl_3_Fuel_Cor : 1;
SIG_VALTYPE_ 2652377088 Cyl_4_Fuel_Cor : 1;
SIG_VALTYPE_ 2652393472 Cyl_5_Fuel_Cor : 1;
SIG_VALTYPE_ 2652409856 Cyl_6_Fuel_Cor : 1;
SIG_VALTYPE_ 2652426240 Cyl_7_Fuel_Cor : 1;
SIG_VALTYPE_ 2652442624 Cyl_8_Fuel_Cor : 1;
SIG_VALTYPE_ 2652459008 Cyl_9_Fuel_Cor : 1;
SIG_VALTYPE_ 2652475392 Cyl_10_Fuel_Cor : 1;
SIG_VALTYPE_ 2652491776 Cyl_11_Fuel_Cor : 1;
SIG_VALTYPE_ 2652508160 Cyl_12_Fuel_Cor : 1;
SIG_VALTYPE_ 2652524544 Cyl_13_Fuel_Cor : 1;
SIG_VALTYPE_ 2652540928 Cyl_14_Fuel_Cor : 1;
SIG_VALTYPE_ 2652557312 Cyl_15_Fuel_Cor : 1;
SIG_VALTYPE_ 2652573696 Cyl_16_Fuel_Cor : 1;
SIG_VALTYPE_ 2652590080 Cyl_1_Timing_Cor : 1;
SIG_VALTYPE_ 2652606464 Cyl_2_Timing_Cor : 1;
SIG_VALTYPE_ 2652622848 Cyl_3_Timing_Cor : 1;
SIG_VALTYPE_ 2652639232 Cyl_4_Timing_Cor : 1;
SIG_VALTYPE_ 2652655616 Cyl_5_Timing_Cor : 1;
SIG_VALTYPE_ 2652672000 Cyl_6_Timing_Cor : 1;
SIG_VALTYPE_ 2652688384 Cyl_7_Timing_Cor : 1;
SIG_VALTYPE_ 2652704768 Cyl_8_Timing_Cor : 1;
SIG_VALTYPE_ 2652721152 Cyl_9_Timing_Cor : 1;
SIG_VALTYPE_ 2652737536 Cyl_10_Timing_Cor : 1;
SIG_VALTYPE_ 2652753920 Cyl_11_Timing_Cor : 1;
SIG_VALTYPE_ 2652770304 Cyl_12_Timing_Cor : 1;
SIG_VALTYPE_ 2652786688 Cyl_13_Timing_Cor : 1;
SIG_VALTYPE_ 2652803072 Cyl_14_Timing_Cor : 1;
SIG_VALTYPE_ 2652819456 Cyl_15_Timing_Cor : 1;
SIG_VALTYPE_ 2652835840 Cyl_16_Timing_Cor : 1;
SIG_VALTYPE_ 2652852224 DI_Target_FP : 1;
SIG_VALTYPE_ 2652868608 Boost_PSIG : 1;
SIG_VALTYPE_ 2652934144 Boost_Gear : 1;
SIG_VALTYPE_ 2652950528 Boost_Stage : 1;
SIG_VALTYPE_ 2652966912 Boost : 1;
SIG_VALTYPE_ 2652983296 Boost_Speed : 1;
SIG_VALTYPE_ 2652999680 Boost_Time : 1;
SIG_VALTYPE_ 2653016064 Target_Boost : 1;
SIG_VALTYPE_ 2653032448 Trans_Brake : 1;
SIG_VALTYPE_ 2653048832 Boost_Scramble_ : 1;
SIG_VALTYPE_ 2653065216 Boost_Scramble__ : 1;
SIG_VALTYPE_ 2653081600 Manual_Boost_Build : 1;
SIG_VALTYPE_ 2653097984 Manual_Boost_Reset : 1;
SIG_VALTYPE_ 2653114368 Boost_Build : 1;
SIG_VALTYPE_ 2653130752 Boost_Solenoid_Duty : 1;
SIG_VALTYPE_ 2653147136 Boost_Safety : 1;
SIG_VALTYPE_ 2653163520 Boost_Master_Enbl : 1;
SIG_VALTYPE_ 2653179904 Boost_Man_Shift_Inp : 1;
SIG_VALTYPE_ 2653196288 Boost_Man_Stage_Inp : 1;
SIG_VALTYPE_ 2653212672 Boost_Fill_Sol_DC : 1;
SIG_VALTYPE_ 2653229056 Boost_Vent_Sol_DC : 1;
SIG_VALTYPE_ 2653245440 WM_Injection : 1;
SIG_VALTYPE_ 2653261824 WM_Manual_Enable : 1;
SIG_VALTYPE_ 2653278208 WM_Low_Fluid : 1;
SIG_VALTYPE_ 2653294592 WM_Pump : 1;
SIG_VALTYPE_ 2653310976 WM_Sol_1_Flow : 1;
SIG_VALTYPE_ 2653327360 WM_Sol_2_Flow : 1;
SIG_VALTYPE_ 2653343744 WM_Flow_Total : 1;
SIG_VALTYPE_ 2653360128 WM_Sol_1_DC : 1;
SIG_VALTYPE_ 2653376512 WM_Sol_2_DC : 1;
SIG_VALTYPE_ 2653425664 N2O_Stage_1 : 1;
SIG_VALTYPE_ 2653442048 N2O_Stage_2 : 1;
SIG_VALTYPE_ 2653458432 N2O_Stage_3 : 1;
SIG_VALTYPE_ 2653474816 N2O_Stage_4 : 1;
SIG_VALTYPE_ 2653491200 N2O_Stage_5 : 1;
SIG_VALTYPE_ 2653507584 N2O_Stage_6 : 1;
SIG_VALTYPE_ 2653523968 N2O_Stage_7 : 1;
SIG_VALTYPE_ 2653540352 N2O_Stage_8 : 1;
SIG_VALTYPE_ 2653556736 GPO_1 : 1;
SIG_VALTYPE_ 2653573120 GPO_2 : 1;
SIG_VALTYPE_ 2653589504 GPO_3 : 1;
SIG_VALTYPE_ 2653605888 GPO_4 : 1;
SIG_VALTYPE_ 2653622272 GPO_5 : 1;
SIG_VALTYPE_ 2653638656 GPO_6 : 1;
